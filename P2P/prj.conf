## CMakeLists.txt
```
cmake_minimum_required(VERSION 3.13.1)

#Board selection
#set(BOARD nrf52840dk_nrf52840)
#set(BOARD nrf5340pdk_nrf5340_cpunet)
set(BOARD nrf52840dongle_nrf52840)

#For zephyr build
find_package(Zephyr HINTS $ENV{ZEPHYR_BASE})
project(NONE)

target_sources(app PRIVATE src/main.cpp src/simple_nrf_radio.cpp src/Timer_sync.c)
target_include_directories(app PRIVATE include)
```

## prj.conf
```kconfig
#
# Copyright (c) 2020 Nordic Semiconductor
#
# SPDX-License-Identifier: LicenseRef-BSD-5-Clause-Nordic
#

CONFIG_CONSOLE_HANDLER=y
CONFIG_SHELL=y
#CONFIG_FLASH_SHELL=y
CONFIG_PRINTK=y
CONFIG_CONSOLE=y
CONFIG_UART_CONSOLE=y
#CONFIG_UART_INTERRUPT_DRIVEN=y

#CONFIG_BOARD_HAS_NRF5_BOOTLOADER=n

#RTT Logging
#CONFIG_USE_SEGGER_RTT=y
#CONFIG_RTT_CONSOLE=y
#CONFIG_UART_CONSOLE=n

CONFIG_DYNAMIC_INTERRUPTS=y

CONFIG_ENTROPY_GENERATOR=y
CONFIG_ENTROPY_DEVICE_RANDOM_GENERATOR=y

CONFIG_NEWLIB_LIBC=y
CONFIG_CPLUSPLUS=y
CONFIG_LIB_CPLUSPLUS=y

CONFIG_NRFX_TIMER=y
CONFIG_NRFX_TIMER4=y

CONFIG_DEBUG=y
```

## nrf52840dongle_nrf52840.overlay
```dts
&uart0 {
    tx-pin = < 0x13 >;
	rx-pin = < 0x15 >;
};
```

## include/Simple_nrf_radio.h
```c
/*
This file is part of P2P-Benchamrk.

P2P-Benchamrk is free software: you can redistribute it and/or modify
it under the terms of the GNU General Public License as published by
the Free Software Foundation, either version 3 of the License, or
(at your option) any later version.

P2P-Benchamrk is distributed in the hope that it will be useful,
but WITHOUT ANY WARRANTY; without even the implied warranty of
MERCHANTABILITY or FITNESS FOR A PARTICULAR PURPOSE.  See the
GNU General Public License for more details.

You should have received a copy of the GNU General Public License
along with P2P-Benchamrk.  If not, see <http://www.gnu.org/licenses/>.
*/

/* Author: Raffael  */

#ifndef SIMPLE_NRF_RADIO_H
#define SIMPLE_NRF_RADIO_H

#include <stdlib.h>
#include <string.h>
#include <zephyr.h>
#include <hal/nrf_radio.h>
#include <drivers/clock_control.h>
#include <drivers/clock_control/nrf_clock_control.h>



/** Maximum radio RX or TX payload. */
#define RADIO_MAX_PAYLOAD_LEN 256
/** IEEE 802.15.4 maximum payload length. */
#define IEEE_MAX_PAYLOAD_LEN 127

struct RADIO_PACKET
{
	uint8_t length = 0;
	u8_t *PDU;			// Pointer to PDU
	u8_t Rx_RSSI = 174; // Received RSSI of Packet
};

struct TxPktStatLog
{
	u16_t Pktcnt = 0;
	bool act = false; // true if Logging is enabled
};

struct RxPktStatLog
{
	u16_t CRCOKcnt = 0;
	u16_t CRCErrcnt = 0;
	u16_t RSSI_Sum_Avg = 174; //Thermal Noise
	bool act = false; // true if Logging is enabled
};

struct Radio_Handler_Context
{
	RxPktStatLog rx_stat;
	k_tid_t* thread_id; //Pointer for Thread ID waiting for ISR
};

class Simple_nrf_radio
{
private:
	int BLE_CH_freq[40] = {2404, 2406, 2408, 2410, 2412, 2414, 2416, 2418, 2420, 2422, 2424, 2428, 2430, 2432, 2434, 2436, 2438, 2440, 2442, 2444, 2446, 2448, 2450, 2452, 2454, 2456, 2458, 2460, 2462, 2464, 2466, 2468, 2470, 2472, 2474, 2476, 2478, 2402, 2426, 2480};
	int IEEE802_15_4_CH_freq[16] = {2405, 2410, 2415, 2420, 2425, 2430, 2435, 2440, 2445, 2450, 2455, 2460, 2465, 2470, 2475, 2480}; // List of IEEE802.15.4 Channels
	k_tid_t ISR_Thread_ID;																											 //Thread ID waiting for ISR
	k_tid_t *ISR_Thread_ID_ptr;																										 //Pointer for Thread ID waiting for ISR
	Radio_Handler_Context rhctx;
	/* Define the Packet PDU which is sent or received by the radio */
	/* For info about Packing and unpacking see 
	https://www.geeksforgeeks.org/structure-member-alignment-padding-and-data-packing/?ref=rp
	*/
	struct PACKET_PDU_ALIGNED
	{
		uint8_t length;
		u8_t PDU[RADIO_MAX_PAYLOAD_LEN - sizeof(length)] = {}; // Max Size of PDU
	} __attribute__((packed)) tx_pkt_aligned;				   // Attribute informing compiler to pack all members to 8bits or 1byte
	/* For IEEE The address has to be transmitted explicit */
	struct PACKET_PDU_ALIGNED_IEEE
	{
		uint8_t length;
		u32_t address;
		u8_t PDU[IEEE_MAX_PAYLOAD_LEN - sizeof(address) - sizeof(length)] = {}; // Max Size of PDU
	} __attribute__((packed)) tx_pkt_aligned_IEEE;								// Attribute informing compiler to pack all members to 8bits or 1byte
	/* Define Packet Buffers */
	u8_t *tx_buf;								 // Pointer to the used Tx Buffer Payload
	uint8_t tx_buf_len;							 // Length of the Tx Buffer
	u8_t rx_buf_ieee[IEEE_MAX_PAYLOAD_LEN] = {}; // Rx Buffer for IEEE operation
	u8_t rx_buf[RADIO_MAX_PAYLOAD_LEN] = {};	 // Rx Buffer for BLE operation
	u8_t *rx_buf_ptr;
	u32_t address; // Storing the Access Address
public:
    /**
	 * Init the Radio
	 *
	 */
	Simple_nrf_radio();
	/**
	 * Radio ISR caused by radio interrupts
	 *
	 * @param context Data Container for the ISR.
	 */
	static void radio_handler(void *context);
	/**
	 * Enable HFCLK 
	 *
	 */
	static void clock_init(void);
	/**
	 * Meassure RSSI Value
	 *
	 * @param cycles Number of samples to average
	 */
	static int RSSI(u8_t cycles);
	/**
	 * Send a Payload
	 *
	 * @param tx_pkt Radio Paket to Send
	 * @param CCA_Mode 0 = Disabled / 1 = Mode 1 (energy above threshold) / 2 = Mode 2 (carrier sense only) / 3 = Mode 3 (carrier sense and threshold) / 4 = Mode 4 (carrier sense or threshold)
	 */
	void Send(RADIO_PACKET tx_pkt, u8_t CCA_Mode);
	/**
	 * Burst send out the same packet till timeout
	 *
	 * @param tx_pkt Radio Paket to Send
	 * @param CCA_Mode 0 = Disabled / 1 = Mode 1 (energy above threshold) / 2 = Mode 2 (carrier sense only) / 3 = Mode 3 (carrier sense and threshold) / 4 = Mode 4 (carrier sense or threshold)
	 * @param timeout Waittimeout in ms for bursting
     * @return Number of Packeets sent
	 */
	s32_t Receive(RADIO_PACKET *rx_pkt, k_timeout_t timeout);
	/**
	 * Receive Packets and only Log Data
	 *
	 * @param timeout Waittimeout in ms packet to be received and logged
     * 
	 * @return Struct of Log Data CRCOKcnt, CRCErrcnt, RSSIAvg
	 */
	RxPktStatLog ReceivePktStatLog(k_timeout_t timeout);
	/**
	 * Set the Radio Mode.
	 *
	 * @param m NRF Radio Mode to select (BLE or IEEE etc.)
	 */
	void setMode(nrf_radio_mode_t m);
	/**
	 * Set the Radio Channel
	 *
	 * @param CH Radio Channel to set (for BLE from 0-39 and IEEE802.15.4 from 11-26)
	 */
	void setCH(u8_t CH);
	/**
	 * Set the Tx Power of the Radio
	 *
	 * @param TxP TxPower to select
	 */
	void setTxP(nrf_radio_txpower_t TxP);
	/**
	 * Set the AccessAddress of the Radio
	 *
	 * @param aa AccessAddress to send or receive from. 
	 */
	void setAA(u32_t aa);
	/**
	 * Disable the Radio
	 *
	 */
	static void radio_disable(void);
};

#endif
```

## include/Timer_sync.h
```c
/*
This file is part of P2P-Benchamrk.

P2P-Benchamrk is free software: you can redistribute it and/or modify
it under the terms of the GNU General Public License as published by
the Free Software Foundation, either version 3 of the License, or
(at your option) any later version.

P2P-Benchamrk is distributed in the hope that it will be useful,
but WITHOUT ANY WARRANTY; without even the implied warranty of
MERCHANTABILITY or FITNESS FOR A PARTICULAR PURPOSE.  See the
GNU General Public License for more details.

You should have received a copy of the GNU General Public License
along with P2P-Benchamrk.  If not, see <http://www.gnu.org/licenses/>.
*/

/* Author: Raffael  */

#ifdef __cplusplus
extern "C" {
#endif

#ifndef TIMER_SYNC_H
#define TIMER_SYNC_H

#include <stdlib.h>
#include <string.h>
#include <zephyr.h>

#include <nrfx_timer.h>
#include <hal/nrf_timer.h>
#include <hal/nrf_radio.h>

#if defined(DPPI_PRESENT) || defined(__NRFX_DOXYGEN__)
#include <nrfx_dppi.h>
#else
#include <nrfx_ppi.h>
/** PreDefined PPI Channel from RADIO->EVENTS_END */
#define nRF52_PreDefinedPPICH_Tx NRF_PPI_CHANNEL27
/** PreDefined PPI Channel from RADIO->EVENTS_ADDRESS */
#define nRF52_PreDefinedPPICH_Rx NRF_PPI_CHANNEL26
#endif // defined(DPPI_PRESENT) || defined(__NRFX_DOXYGEN__)

/* Timer used for Synchronisation */
extern NRF_TIMER_Type * synctimer;
extern uint64_t Timestamp_Slave;
extern uint64_t Timestamp_Master;
extern uint64_t Timestamp_Diff;

/**
* Init the Sync Timer
*
*/
extern void synctimer_init();

/**
* Timestamp Capture clear
*
*/
extern void synctimer_TimeStampCapture_clear();

/**
* Timestamp Capture enable
*
*/
extern void synctimer_TimeStampCapture_enable();
/**
* Timestamp Capture disable
*
*/
extern void synctimer_TimeStampCapture_disable();


/**
* Clears and starts the timer
*/
extern void synctimer_start();

/**
* Stops and clears the timer
*/
extern void synctimer_stop();
/**
* Get previous Tx sync timestamp
*
* @return Latest Tx Timestamp
*/
extern uint64_t synctimer_getTxTimeStamp();
/**
* Get previous Rx sync timestamp
*
* @return Latest Rx Timestamp
*/
extern uint64_t synctimer_getRxTimeStamp();
/**
* Synchronise the timer with the received offset Timestamp
*
* @param TxMasterTimeStamp Latest 
*/
extern void synctimer_setSync(uint64_t TxMasterTimeStamp);
/**
* Get Synchronised Timestamp
*
* @return Synchronised Timestamp
*/
extern uint64_t synctimer_getSyncTime();
/**
* Sets a synced Time Compare Interrupt (with respect of Synced Time)
*
* @param ts Timestamp for Interrupt
* @param cc_cb Callback on Interrupt
*/
extern void synctimer_setSyncTimeCompareInt(uint64_t ts ,void (*cc_cb)());

extern void config_debug_ppi_and_gpiote_radio_state();

#endif

#ifdef __cplusplus
}
#endif
```

## src/Simple_nrf_radio.cpp
```c
/*
This file is part of P2P-Benchamrk.

P2P-Benchamrk is free software: you can redistribute it and/or modify
it under the terms of the GNU General Public License as published by
the Free Software Foundation, either version 3 of the License, or
(at your option) any later version.

P2P-Benchamrk is distributed in the hope that it will be useful,
but WITHOUT ANY WARRANTY; without even the implied warranty of
MERCHANTABILITY or FITNESS FOR A PARTICULAR PURPOSE.  See the
GNU General Public License for more details.

You should have received a copy of the GNU General Public License
along with P2P-Benchamrk.  If not, see <http://www.gnu.org/licenses/>.
*/

/* Author: Raffael  */

#include "Simple_nrf_radio.h"

/**
	 * Init the Radio
	 *
	 */
Simple_nrf_radio::Simple_nrf_radio()
{
    // Enable the High Frequency clock on the processor. This is a pre-requisite for
    // the RADIO module. Without this clock, no communication is possible.
    clock_init();
    nrf_radio_power_set(NRF_RADIO, 1);                            // Power ON Radio
    radio_disable();                                              // Disable Radio
    setMode(NRF_RADIO_MODE_BLE_1MBIT);                            // Set Mode to BLE 1MBITS
    setAA(0x8E89BED6);                                            // Default Advertisment Address BLE 0x8E89BED6
    setCH(11);                                                    // Default Advertisment Channel
    setTxP(NRF_RADIO_TXPOWER_0DBM);                               // Set Tx Power to 0dbm
    rhctx.thread_id = &ISR_Thread_ID;                             // store address of ISR_Thread_ID in pointer variable
    irq_connect_dynamic(RADIO_IRQn, 7, radio_handler, &rhctx, 0); // Connect Radio ISR
    irq_enable(RADIO_IRQn);                                       // Enable Radio ISR
}
/**
	 * Radio ISR caused by radio interrupts
	 *
	 * @param context Data Container for the ISR.
	 */
void Simple_nrf_radio::radio_handler(void *context)
{
    Radio_Handler_Context *c_rhctx = (Radio_Handler_Context *)context;
    //printk("Interrupt\n");
    if (nrf_radio_event_check(NRF_RADIO, NRF_RADIO_EVENT_RSSIEND))
    {
        nrf_radio_task_trigger(NRF_RADIO, NRF_RADIO_TASK_RSSISTOP); // Stop RSSI
        nrf_radio_event_clear(NRF_RADIO, NRF_RADIO_EVENT_RSSIEND);    // Clear ISR Event
        return;
    } else if (nrf_radio_event_check(NRF_RADIO, NRF_RADIO_EVENT_CRCOK))
    {
        /* Check Address in payload of IEEE802.15.4 */
        if ((nrf_radio_mode_get(NRF_RADIO) == NRF_RADIO_MODE_IEEE802154_250KBIT))
        {
            u8_t *payload = ((u8_t *)nrf_radio_packetptr_get(NRF_RADIO));
            if ((payload[4] == (nrf_radio_prefix0_get(NRF_RADIO) & 0x000000FF) and payload[3] == (nrf_radio_base0_get(NRF_RADIO) >> 24) and payload[2] == ((nrf_radio_base0_get(NRF_RADIO) & 0x00FF0000) >> 16) and payload[1] == ((nrf_radio_base0_get(NRF_RADIO) & 0x0000FF00) >> 8))==false)
            {
                //printk("Wrong Address Received\n");
                nrf_radio_event_clear(NRF_RADIO, NRF_RADIO_EVENT_CRCOK);    // Clear ISR Event CRCOK
                return; // Return 
            }
        }
        if(c_rhctx->rx_stat.act){
            c_rhctx->rx_stat.CRCOKcnt++;
            c_rhctx->rx_stat.RSSI_Sum_Avg += nrf_radio_rssi_sample_get(NRF_RADIO); // RSSI should be done
            //nrf_radio_task_trigger(NRF_RADIO, NRF_RADIO_TASK_RSSISTOP);
            nrf_radio_event_clear(NRF_RADIO, NRF_RADIO_EVENT_CRCOK);    // Clear ISR Event CRCOK
            return;
        }
        nrf_radio_event_clear(NRF_RADIO, NRF_RADIO_EVENT_CRCOK);    // Clear ISR Event CRCOK
        k_wakeup((k_tid_t) * (c_rhctx->thread_id));                 // Wake up the sleeping Thread waiting for the ISR
        return;
    } else if(nrf_radio_event_check(NRF_RADIO, NRF_RADIO_EVENT_CRCERROR))
    {
        if(c_rhctx->rx_stat.act){
            c_rhctx->rx_stat.CRCErrcnt++;
            //c_rhctx->rx_stat.RSSI_Sum_Avg += nrf_radio_rssi_sample_get(NRF_RADIO); // RSSI should be done
            //nrf_radio_task_trigger(NRF_RADIO, NRF_RADIO_TASK_RSSISTOP);
            nrf_radio_event_clear(NRF_RADIO, NRF_RADIO_EVENT_CRCERROR);    // Clear ISR Event CRCERROR
            return;
        }
    } else if(nrf_radio_event_check(NRF_RADIO, NRF_RADIO_EVENT_END) || nrf_radio_event_check(NRF_RADIO, NRF_RADIO_EVENT_PHYEND))
    {
        nrf_radio_event_clear(NRF_RADIO, NRF_RADIO_EVENT_END);    // Clear ISR Events
        nrf_radio_event_clear(NRF_RADIO, NRF_RADIO_EVENT_PHYEND);    // Clear ISR Events
        k_wakeup((k_tid_t) * (c_rhctx->thread_id));                 // Wake up the sleeping Thread waiting for the ISR
        return;
    }
}
/**
	 * Enable HFCLK 
	 *
	 */
void Simple_nrf_radio::clock_init(void)
{
    NRF_CLOCK->TASKS_HFCLKSTART = 1;    //Start high frequency clock
    NRF_CLOCK->EVENTS_HFCLKSTARTED = 0; //Clear event
}
/**
	 * Meassure RSSI Value
	 *
	 * @param cycles Number of samples to average
	 */
int Simple_nrf_radio::RSSI(u8_t cycles)
{
    if (cycles < 1)
    {
        cycles = 1;
    };
    int RSSIres = 0;
    nrf_radio_shorts_enable(NRF_RADIO, NRF_RADIO_SHORT_READY_START_MASK); // Start after Ready
    nrf_radio_task_trigger(NRF_RADIO, NRF_RADIO_TASK_RXEN);
    while (nrf_radio_state_get(NRF_RADIO) != NRF_RADIO_STATE_RX)
        ; // Wait for RX State
    for (u8_t i = 1; i <= cycles; i++)
    {
        nrf_radio_task_trigger(NRF_RADIO, NRF_RADIO_TASK_RSSISTART); // Start RSSI Measurment
        while (nrf_radio_event_check(NRF_RADIO, NRF_RADIO_EVENT_RSSIEND) != true)
            ;                                                       // Wait for RSSI end
        nrf_radio_task_trigger(NRF_RADIO, NRF_RADIO_TASK_RSSISTOP); // Stop RSSI Measurment
        RSSIres = RSSIres + nrf_radio_rssi_sample_get(NRF_RADIO);
        nrf_radio_event_clear(NRF_RADIO, NRF_RADIO_EVENT_RSSIEND); // Clear Event
    }
    nrf_radio_task_trigger(NRF_RADIO, NRF_RADIO_TASK_DISABLE);
    while (nrf_radio_state_get(NRF_RADIO) != NRF_RADIO_STATE_DISABLED)
        ; // Wait for Disable State
    radio_disable();
    return RSSIres / cycles;
    ; // Average the RSSI over cycles
}
/**
	 * Send a Payload
	 *
	 * @param tx_pkt Radio Paket to Send
	 */
void Simple_nrf_radio::Send(RADIO_PACKET tx_pkt, u8_t CCA_Mode)
{
    radio_disable(); // Disable the Radio
    /* Setup Paket */
    if (nrf_radio_mode_get(NRF_RADIO) == NRF_RADIO_MODE_IEEE802154_250KBIT)
    {
        //memset((u8_t *)&tx_pkt_aligned_IEEE, 0, sizeof((u8_t *)&tx_pkt_aligned_IEEE));     // Initialize Data Structure
        tx_pkt_aligned_IEEE.length = tx_pkt.length + 2 + sizeof(address);                  // Because Length includes CRC Field
        tx_pkt_aligned_IEEE.address = address;                                             // Save  address because IEEE wont transmit it by itself
        memset(tx_pkt_aligned_IEEE.PDU, 0, sizeof(tx_pkt_aligned_IEEE.PDU));               // Initialize Data Structure
        memcpy(tx_pkt_aligned_IEEE.PDU, tx_pkt.PDU, tx_pkt.length);                        // Copy the MAC PDU to the RAM PDU
        tx_buf = (u8_t *)&tx_pkt_aligned_IEEE;                                             // Set the Tx Buffer Pointer
        tx_buf_len = tx_pkt.length + sizeof(address) + sizeof(tx_pkt_aligned_IEEE.length); // Save the Size of the tx_buf
    }
    else
    {
        //memset((u8_t *)&tx_pkt_aligned, 0, sizeof((u8_t *)&tx_pkt_aligned)); // Initialize Data Structure
        tx_pkt_aligned.length = tx_pkt.length;
        memset(tx_pkt_aligned.PDU, 0, sizeof(tx_pkt_aligned.PDU));          // Initialize Data Structure
        memcpy(tx_pkt_aligned.PDU, tx_pkt.PDU, tx_pkt.length);              // Copy the MAC PDU to the RAM PDU
        tx_buf = (u8_t *)&tx_pkt_aligned;                                   // Set the Tx Buffer Pointer
        tx_buf_len = tx_pkt_aligned.length + sizeof(tx_pkt_aligned.length); // Save the Size of the tx_buf
    }
    nrf_radio_packetptr_set(NRF_RADIO, tx_buf);
    nrf_radio_event_clear(NRF_RADIO, NRF_RADIO_EVENT_END);                                                                                         // Clear END Event
    nrf_radio_event_clear(NRF_RADIO, NRF_RADIO_EVENT_PHYEND);                                                                                      // Clear PHYEND Event
    nrf_radio_int_enable(NRF_RADIO, NRF_RADIO_INT_END_MASK | NRF_RADIO_INT_PHYEND_MASK);                                                           // Enable END Event and PHYEND interrupt
    ISR_Thread_ID = k_current_get();                                                                                                               // Set Interrupt Thread to wakeup
    nrf_radio_event_clear(NRF_RADIO, NRF_RADIO_EVENT_DISABLED);
    if ((nrf_radio_mode_get(NRF_RADIO) == NRF_RADIO_MODE_IEEE802154_250KBIT) && (CCA_Mode != 0)) {
        nrf_radio_shorts_enable(NRF_RADIO, NRF_RADIO_SHORT_RXREADY_CCASTART_MASK | NRF_RADIO_SHORT_CCAIDLE_TXEN_MASK | NRF_RADIO_SHORT_TXREADY_START_MASK | NRF_RADIO_SHORT_END_DISABLE_MASK | NRF_RADIO_SHORT_CCABUSY_DISABLE_MASK);
        nrf_radio_task_trigger(NRF_RADIO, NRF_RADIO_TASK_RXEN);
    } else {
        nrf_radio_shorts_enable(NRF_RADIO, NRF_RADIO_SHORT_READY_START_MASK | NRF_RADIO_SHORT_END_DISABLE_MASK | NRF_RADIO_SHORT_PHYEND_DISABLE_MASK); // Start after Ready and Disable after END or PHY-End
        nrf_radio_task_trigger(NRF_RADIO, NRF_RADIO_TASK_TXEN);
    } 
    k_sleep(K_MSEC(1000)); // Wait for interrupt (Fail Safe never take longer than one Second)
    radio_disable();
}
/**
	 * Receive a Payload
	 *
	 * @param payload Pointer where to store received payload
	 * @param timeout Waittimeout in ms for a packet to be received
     * 
	 * @return Zero of timeout occured or number of miliseconds till timeout occurs
	 */
s32_t Simple_nrf_radio::Receive(RADIO_PACKET *rx_pkt, k_timeout_t timeout)
{
    radio_disable();
    /* Initialize Rx Buffer */
    if (nrf_radio_mode_get(NRF_RADIO) == NRF_RADIO_MODE_IEEE802154_250KBIT)
    {
        memset(rx_buf_ieee, 0, sizeof(rx_buf_ieee)); // Erase old Rx buffer content
        rx_buf_ptr = rx_buf_ieee;
    }
    else
    {
        memset(rx_buf, 0, sizeof(rx_buf)); // Erase old Rx buffer content
        rx_buf_ptr = rx_buf;
    }
    //memset(rx_buf_ptr, 0, sizeof(rx_buf_ptr)); // Erase old Rx buffer content
    nrf_radio_packetptr_set(NRF_RADIO, rx_buf_ptr);
    nrf_radio_event_clear(NRF_RADIO, NRF_RADIO_EVENT_CRCOK);                                                                                                                            // Clear CRCOK Event
    nrf_radio_int_enable(NRF_RADIO, NRF_RADIO_INT_CRCOK_MASK);                                                                                                                          // Enable CRCOK Event interrupt
    ISR_Thread_ID = k_current_get();                                                                                                                                                    // Set Interrupt Thread to wakeup
    nrf_radio_shorts_enable(NRF_RADIO, NRF_RADIO_SHORT_READY_START_MASK | NRF_RADIO_SHORT_ADDRESS_RSSISTART_MASK | NRF_RADIO_SHORT_PHYEND_START_MASK | NRF_RADIO_SHORT_END_START_MASK); // Start after Ready and Start after END -> wait for CRCOK Event otherwise keep on receiving
    nrf_radio_task_trigger(NRF_RADIO, NRF_RADIO_TASK_RXEN);
    s32_t ret = k_sleep(timeout); // Wait for interrupt and check if it was a timeout
    if (ret > 0)
    {
        //printk("Received Sample RSSI: %d \n", nrf_radio_rssi_sample_get(NRF_RADIO));
        rx_pkt->Rx_RSSI = nrf_radio_rssi_sample_get(NRF_RADIO);
        /* Parse Paket */
        if (nrf_radio_mode_get(NRF_RADIO) == NRF_RADIO_MODE_IEEE802154_250KBIT)
        {
            PACKET_PDU_ALIGNED_IEEE *rx_pkt_pdu_ieee;                       // Create new Pointer
            rx_pkt_pdu_ieee = (PACKET_PDU_ALIGNED_IEEE *)rx_buf_ptr;        // Revert Received Payload
            rx_pkt->length = rx_pkt_pdu_ieee->length - 2 - sizeof(address); // Copy length field -2 because includes CRC Field
            //memcpy(rx_pkt.PDU, rx_pkt_pdu_ieee->PDU, rx_pkt_pdu_ieee->length); // Copy the PDU field
            rx_pkt->PDU = rx_pkt_pdu_ieee->PDU;
        }
        else
        {
            PACKET_PDU_ALIGNED *rx_pkt_pdu;                // Create new Pointer
            rx_pkt_pdu = (PACKET_PDU_ALIGNED *)rx_buf_ptr; // Revert Received Payload
            rx_pkt->length = rx_pkt_pdu->length;           // Copy length field
            //memcpy(rx_pkt.PDU, rx_pkt_pdu->PDU, rx_pkt_pdu->length); // Copy the PDU field
            rx_pkt->PDU = rx_pkt_pdu->PDU;
        }
    }
    else
    {
        //printk("Timeout nothing received \n");
    }
    nrf_radio_task_trigger(NRF_RADIO, NRF_RADIO_TASK_RSSISTOP);
    radio_disable();
    return ret;
}
/**
	 * Receive Packets and only Log Data
	 *
	 * @param timeout Waittimeout in ms packet to be received and logged
     * 
	 * @return Struct of Log Data CRCOKcnt, CRCErrcnt, RSSIAvg
	 */
RxPktStatLog Simple_nrf_radio::ReceivePktStatLog(k_timeout_t timeout)
{
    radio_disable();
    nrf_radio_packetptr_set(NRF_RADIO, rx_buf);
    nrf_radio_task_trigger(NRF_RADIO, NRF_RADIO_TASK_RSSISTOP);
    nrf_radio_event_clear(NRF_RADIO, NRF_RADIO_EVENT_CRCOK); // Clear CRCOK Event
    nrf_radio_event_clear(NRF_RADIO, NRF_RADIO_EVENT_CRCERROR); // Clear CRCERROR Event
    nrf_radio_event_clear(NRF_RADIO, NRF_RADIO_EVENT_RSSIEND); // Clear RSSIEND Event
    nrf_radio_int_enable(NRF_RADIO, NRF_RADIO_INT_CRCOK_MASK | NRF_RADIO_INT_CRCERROR_MASK | NRF_RADIO_INT_RSSIEND_MASK);                                                                                                                         // Enable CRCOK Event interrupt
    ISR_Thread_ID = k_current_get();   // Set Interrupt Thread to wakeup
    if (nrf_radio_mode_get(NRF_RADIO) == NRF_RADIO_MODE_BLE_LR125KBIT || nrf_radio_mode_get(NRF_RADIO) == NRF_RADIO_MODE_BLE_LR500KBIT){
        nrf_radio_shorts_enable(NRF_RADIO, NRF_RADIO_SHORT_READY_START_MASK | NRF_RADIO_SHORT_ADDRESS_RSSISTART_MASK | NRF_RADIO_SHORT_PHYEND_DISABLE_MASK | NRF_RADIO_SHORT_END_DISABLE_MASK | NRF_RADIO_SHORT_DISABLED_RXEN_MASK); // Slow things Down for LR Becasuse using regular short leads to Packet loss
    } else {
        nrf_radio_shorts_enable(NRF_RADIO, NRF_RADIO_SHORT_READY_START_MASK | NRF_RADIO_SHORT_ADDRESS_RSSISTART_MASK | NRF_RADIO_SHORT_PHYEND_START_MASK | NRF_RADIO_SHORT_END_START_MASK); // Start after Ready and Start after END -> wait for CRCOK Event otherwise keep on receiving
    }
    rhctx.rx_stat.CRCErrcnt = 0;
    rhctx.rx_stat.CRCOKcnt = 0;
    rhctx.rx_stat.RSSI_Sum_Avg = 174; //Thermal Noise
    rhctx.rx_stat.act = true;
    nrf_radio_task_trigger(NRF_RADIO, NRF_RADIO_TASK_RXEN);
    k_sleep(timeout); // Wait for interrupt and check if it was a timeout
    rhctx.rx_stat.act = false;
    radio_disable();
    if ((rhctx.rx_stat.CRCOKcnt) != 0)
    {
        rhctx.rx_stat.RSSI_Sum_Avg = (rhctx.rx_stat.RSSI_Sum_Avg-174) / (rhctx.rx_stat.CRCOKcnt);
    } 
    nrf_radio_task_trigger(NRF_RADIO, NRF_RADIO_TASK_RSSISTOP);
    return rhctx.rx_stat;
}
/**
	 * Set the Radio Mode.
	 *
	 * @param m NRF Radio Mode to select (BLE or IEEE etc.)
	 */
void Simple_nrf_radio::setMode(nrf_radio_mode_t m)
{
    // Set the desired Radio Mode
    nrf_radio_mode_set(NRF_RADIO, m);
    // Enable Fast Ramp Up (no TIFS) and set Tx Default mode to Center
    nrf_radio_modecnf0_set(NRF_RADIO, true, RADIO_MODECNF0_DTX_Center);
    // CRC16-CCITT Conform
    nrf_radio_crc_configure(NRF_RADIO, RADIO_CRCCNF_LEN_Three, NRF_RADIO_CRC_ADDR_SKIP, 0x00065B);
    nrf_radio_crcinit_set(NRF_RADIO, 0x555555);
    // Packet configuration
    nrf_radio_packet_conf_t packet_conf;
    memset(&packet_conf, 0, sizeof(packet_conf));
    packet_conf.plen = NRF_RADIO_PREAMBLE_LENGTH_8BIT; // 8-bit preamble
    packet_conf.lflen = 8;                             // lengthfield size = 8 bits
    packet_conf.s0len = 0;                             // S0 size = 0 bytes
    packet_conf.s1len = 0;                             // S1 size = 0 bits
    packet_conf.maxlen = 255;                          // max 255-byte payload
    packet_conf.statlen = 0;                           // 0-byte static length
    packet_conf.balen = 3;                             // 3-byte base address length (4-byte full address length)
    packet_conf.big_endian = false;                        // Bit 24: 1 Small endian
    packet_conf.whiteen = true;                        // Bit 25: 1 Whitening enabled
    packet_conf.crcinc = 0;                            // Indicates if LENGTH field contains CRC or not
    switch (m)
    {
    case NRF_RADIO_MODE_BLE_1MBIT:
        // Nothing to be done :)
        break;
    case NRF_RADIO_MODE_BLE_2MBIT:
        packet_conf.plen = NRF_RADIO_PREAMBLE_LENGTH_16BIT; // 16-bit preamble
        break;
    case NRF_RADIO_MODE_BLE_LR500KBIT:
    case NRF_RADIO_MODE_BLE_LR125KBIT:
        packet_conf.plen = NRF_RADIO_PREAMBLE_LENGTH_LONG_RANGE; // 10-bit preamble
        packet_conf.cilen = 2;                                   // Length of code indicator (Bits) - long range
        packet_conf.termlen = 3;                                 // Length of TERM field (Bits) in Long Range operation
        packet_conf.maxlen = IEEE_MAX_PAYLOAD_LEN;                // max byte payload
        // Enable Fast Ramp Up (no TIFS) and set Tx Defalut mode to Center
        nrf_radio_modecnf0_set(NRF_RADIO, true, RADIO_MODECNF0_DTX_Center);
        // CRC24-Bit
        nrf_radio_crc_configure(NRF_RADIO, RADIO_CRCCNF_LEN_Three, NRF_RADIO_CRC_ADDR_SKIP, 0);
        break;
    case NRF_RADIO_MODE_IEEE802154_250KBIT:
        packet_conf.plen = NRF_RADIO_PREAMBLE_LENGTH_32BIT_ZERO; // 32-bit preamble
        packet_conf.balen = 0;                                   // --> Address Matching is not suppported in IEEE802.15.4 mode
        packet_conf.maxlen = IEEE_MAX_PAYLOAD_LEN;               // max 127-byte payload
        packet_conf.lflen = 8;                                   // lengthfield size = 8 bits
        packet_conf.crcinc = 1;                                  // Indicates if LENGTH field contains CRC or not
        // Enable Fast Ramp Up (no TIFS) and set Tx Defalut mode to Center
        nrf_radio_modecnf0_set(NRF_RADIO, true, RADIO_MODECNF0_DTX_Center);
        // CRC 16-bit ITU-T conform
        nrf_radio_crc_configure(NRF_RADIO, RADIO_CRCCNF_LEN_Two, NRF_RADIO_CRC_ADDR_IEEE802154, 0x11021);
        nrf_radio_crcinit_set(NRF_RADIO, 0x5555);
    default:
        break;
    }
    nrf_radio_packet_configure(NRF_RADIO, &packet_conf);
}
/**
	 * Set the Radio Channel
	 *
	 * @param CH Radio Channel to set (for BLE from 0-39 and IEEE802.15.4 from 11-26)
	 */
void Simple_nrf_radio::setCH(u8_t CH)
{
    // Accept only numbers within 0-39 for BLE Channels
    if ((39 >= CH and CH >= 0) and nrf_radio_mode_get(NRF_RADIO) != NRF_RADIO_MODE_IEEE802154_250KBIT)
    {
        nrf_radio_frequency_set(NRF_RADIO, BLE_CH_freq[CH]);
        nrf_radio_datawhiteiv_set(NRF_RADIO, CH);
        //printk("Set Frequency to %d\n", BLE_CH_freq[CH]);
    }
    else if (26 >= CH and CH >= 11) // Accept only numbers within 11-26 for IEEE802.15.4 Channels
    {
        nrf_radio_frequency_set(NRF_RADIO, IEEE802_15_4_CH_freq[CH - 11]);
    }
}
/**
	 * Set the Tx Power of the Radio
	 *
	 * @param TxP TxPower to select
	 */
void Simple_nrf_radio::setTxP(nrf_radio_txpower_t TxP)
{
    nrf_radio_txpower_set(NRF_RADIO, TxP);
}
/**
	 * Set the AccessAddress of the Radio
	 *
	 * @param aa AccessAddress to send or receive from. 
	 */
void Simple_nrf_radio::setAA(u32_t aa)
{
    address = aa; // Store the Access Address
    /* Set the device address 0 to use when transmitting. */
    nrf_radio_txaddress_set(NRF_RADIO, 0);
    /* Enable the device address 0 to use to select which addresses to
	 	* receive
	 	*/
    nrf_radio_rxaddresses_set(NRF_RADIO, 1);
    /* Set the access address */
    nrf_radio_prefix0_set(NRF_RADIO, (aa >> 24) & RADIO_PREFIX0_AP0_Msk);
    nrf_radio_base0_set(NRF_RADIO, (aa << 8) & 0xFFFFFF00);
    //nrf_radio_sfd_set(NRF_RADIO, (aa >> 24) & RADIO_PREFIX0_AP0_Msk); // Set the SFD for the IEEE Radio Mode to the Prefix (first byte of Address) -> Dont do because of CCA Carrier Mode
}
/**
	 * Disable the Radio
	 *
	 */
void Simple_nrf_radio::radio_disable(void)
{
    nrf_radio_shorts_set(NRF_RADIO, 0);
    nrf_radio_int_disable(NRF_RADIO, ~0);
    nrf_radio_event_clear(NRF_RADIO, NRF_RADIO_EVENT_DISABLED);

    nrf_radio_task_trigger(NRF_RADIO, NRF_RADIO_TASK_DISABLE);
    while (!nrf_radio_event_check(NRF_RADIO, NRF_RADIO_EVENT_DISABLED))
    {
        /* Do nothing */
    }
    nrf_radio_event_clear(NRF_RADIO, NRF_RADIO_EVENT_DISABLED);
}
```

## src/Simple_nrf_radio.h
```c
#ifndef SIMPLE_NRF_RADIO_H
#define SIMPLE_NRF_RADIO_H

#include <stdlib.h>
#include <string.h>
#include <zephyr.h>
#include <hal/nrf_radio.h>
#include <drivers/clock_control.h>
#include <drivers/clock_control/nrf_clock_control.h>


/** Maximum radio RX or TX payload. */
#define RADIO_MAX_PAYLOAD_LEN 256
/** IEEE 802.15.4 maximum payload length. */
#define IEEE_MAX_PAYLOAD_LEN 127

struct RADIO_PACKET
{
	uint8_t length = 0;
	u8_t *PDU;			// Pointer to PDU
	u8_t Rx_RSSI = 174; // Received RSSI of Packet
};

class Simple_nrf_radio
{
private:
	int BLE_CH_freq[40] = {2404, 2406, 2408, 2410, 2412, 2414, 2416, 2418, 2420, 2422, 2424, 2428, 2430, 2432, 2434, 2436, 2438, 2440, 2442, 2444, 2446, 2448, 2450, 2452, 2454, 2456, 2458, 2460, 2462, 2464, 2466, 2468, 2470, 2472, 2474, 2476, 2478, 2402, 2426, 2480};
	int IEEE802_15_4_CH_freq[16] = {2405, 2410, 2415, 2420, 2425, 2430, 2435, 2440, 2445, 2450, 2455, 2460, 2465, 2470, 2475, 2480}; // List of IEEE802.15.4 Channels
	k_tid_t ISR_Thread_ID;																											 //Thread ID waiting for ISR
	k_tid_t *ISR_Thread_ID_ptr;																										 //Pointer for Thread ID waiting for ISR
	/* Define the Packet PDU which is sent or received by the radio */
	/* For info about Packing and unpacking see 
	https://www.geeksforgeeks.org/structure-member-alignment-padding-and-data-packing/?ref=rp
	*/
	struct PACKET_PDU_ALIGNED
	{
		uint8_t length;
		u8_t PDU[RADIO_MAX_PAYLOAD_LEN - sizeof(length)] = {}; // Max Size of PDU
	} __attribute__((packed)) tx_pkt_aligned;				   // Attribute informing compiler to pack all members to 8bits or 1byte
	/* For IEEE The address has to be transmitted explicit */
	struct PACKET_PDU_ALIGNED_IEEE
	{
		uint8_t length;
		u32_t address;
		u8_t PDU[IEEE_MAX_PAYLOAD_LEN - sizeof(address) - sizeof(length)] = {}; // Max Size of PDU
	} __attribute__((packed)) tx_pkt_aligned_IEEE;								// Attribute informing compiler to pack all members to 8bits or 1byte
	/* Define Packet Buffers */
	u8_t *tx_buf;								 // Pointer to the used Tx Buffer Payload
	uint8_t tx_buf_len;							 // Length of the Tx Buffer
	u8_t rx_buf_ieee[IEEE_MAX_PAYLOAD_LEN] = {}; // Rx Buffer for IEEE operation
	u8_t rx_buf[RADIO_MAX_PAYLOAD_LEN] = {};	 // Rx Buffer for BLE operation
	u8_t *rx_buf_ptr;
	u32_t address; // Storing the Access Address
public:
    /**
	 * Init the Radio
	 *
	 */
	Simple_nrf_radio();
	/**
	 * Radio ISR caused by radio interrupts
	 *
	 * @param context Data Container for the ISR.
	 */
	static void radio_handler(void *context);
	/**
	 * Enable HFCLK 
	 *
	 */
	static void clock_init(void);
	/**
	 * Meassure RSSI Value
	 *
	 * @param cycles Number of samples to average
	 */
	static int RSSI(u8_t cycles);
	/**
	 * Send a Payload
	 *
	 * @param payload Pointer what payload to send
	 * @param size Length of the Payload to Send
	 * @param timeout Waittimeout in ms for a packet to be sent
	 */
	void Send(RADIO_PACKET tx_pkt, int timeout);
	/**
	 * Receive a Payload
	 *
	 * @param payload Pointer where to store received payload
	 * @param timeout Waittimeout in ms for a packet to be received
	 * 
	 * @return Zero of timeout occured or number of miliseconds till timeout occurs
	 */
	s32_t Receive(RADIO_PACKET *rx_pkt, int timeout);
	/**
	 * Set the Radio Mode.
	 *
	 * @param m NRF Radio Mode to select (BLE or IEEE etc.)
	 */
	void setMode(nrf_radio_mode_t m);
	/**
	 * Set the Radio Channel
	 *
	 * @param CH Radio Channel to set (for BLE from 0-39 and IEEE802.15.4 from 11-26)
	 */
	void setCH(u8_t CH);
	/**
	 * Set the Tx Power of the Radio
	 *
	 * @param TxP TxPower to select
	 */
	void setTxP(nrf_radio_txpower_t TxP);
	/**
	 * Set the AccessAddress of the Radio
	 *
	 * @param aa AccessAddress to send or receive from. 
	 */
	void setAA(u32_t aa);
	/**
	 * Disable the Radio
	 *
	 */
	static void radio_disable(void);
};

#endif
```

## src/Timer_sync.c
```c
/*
This file is part of P2P-Benchamrk.

P2P-Benchamrk is free software: you can redistribute it and/or modify
it under the terms of the GNU General Public License as published by
the Free Software Foundation, either version 3 of the License, or
(at your option) any later version.

P2P-Benchamrk is distributed in the hope that it will be useful,
but WITHOUT ANY WARRANTY; without even the implied warranty of
MERCHANTABILITY or FITNESS FOR A PARTICULAR PURPOSE.  See the
GNU General Public License for more details.

You should have received a copy of the GNU General Public License
along with P2P-Benchamrk.  If not, see <http://www.gnu.org/licenses/>.
*/

/* Author: Raffael  */

#include "Timer_sync.h"

NRF_TIMER_Type * synctimer = NRF_TIMER4;
uint64_t Timestamp_Slave = 0;
uint64_t Timestamp_Master = 0;
uint64_t Timestamp_Diff = 0;
static uint32_t OverflowCNT = 0;
static uint32_t OverflowCNT_int_synced_ts = 0;
static const uint32_t RxChainDelay_us = 35; // Meassured Chain Delay (40 with IEEE803.4.15)

static void (*sync_compare_callback)();


ISR_DIRECT_DECLARE(timer_handler)
{
		// Overflow Handler
	if (synctimer->EVENTS_COMPARE[5] == true)
	{
		synctimer->EVENTS_COMPARE[5] = false;
		OverflowCNT++;
	}
	if (synctimer->EVENTS_COMPARE[4] == true)
	{
		synctimer->EVENTS_COMPARE[4] = false;
		if ((sync_compare_callback != NULL) && (OverflowCNT == OverflowCNT_int_synced_ts)){
			sync_compare_callback();
		}
	}
	ISR_DIRECT_PM();
	return 1;
}


/*
static void synctimer_handler(){
	// Overflow Handler
	if (synctimer->EVENTS_COMPARE[5] == true)
	{
		synctimer->EVENTS_COMPARE[5] = false;
		OverflowCNT++;
	}
	if (synctimer->EVENTS_COMPARE[4] == true)
	{
		synctimer->EVENTS_COMPARE[4] = false;
		if ((sync_compare_callback != NULL) && (OverflowCNT == OverflowCNT_int_synced_ts)){
			sync_compare_callback();
		}
	}
	printk("hoi\n");
}
*/

/* Timer init */
extern void synctimer_init()
{
	// Takes 4294s / 71min to expire
	nrf_timer_bit_width_set(synctimer,NRF_TIMER_BIT_WIDTH_32);
	nrf_timer_frequency_set(synctimer,NRF_TIMER_FREQ_1MHz);
	nrf_timer_mode_set(synctimer,NRF_TIMER_MODE_TIMER);
	//irq_connect_dynamic(TIMER3_IRQn, 7, synctimer_handler, NULL, 0); 	// Connect Radio ISR
	IRQ_DIRECT_CONNECT(TIMER4_IRQn, 6, timer_handler, 0);
    irq_enable(TIMER4_IRQn);                                        // Enable Radio ISR
	nrf_timer_task_trigger(synctimer, NRF_TIMER_TASK_CLEAR);
	nrf_timer_cc_set(synctimer,NRF_TIMER_CC_CHANNEL1,0);
	nrf_timer_cc_set(synctimer,NRF_TIMER_CC_CHANNEL2,0);
	nrf_timer_cc_set(synctimer,NRF_TIMER_CC_CHANNEL5,0xFFFFFFFF); // For Overflow Detection
	synctimer->INTENSET |= (uint32_t) NRF_TIMER_INT_COMPARE5_MASK; // Enable Compare Event 5 Interrupt
	OverflowCNT = 0;
}

/* Timestamp Capture Clear */
void synctimer_TimeStampCapture_clear()
{
	synctimer->CC[1] = 0;
	synctimer->CC[2] = 0;
}

/* Timestamp Capture Enable */
extern void synctimer_TimeStampCapture_enable()
{
#if defined(DPPI_PRESENT) || defined(__NRFX_DOXYGEN__)
	/* Setup DPPI for Sending and Receiving Timesync Packet */
	NRF_DPPIC->CHEN |= 1 << 0; // Enable Channel 0 DPPI
	NRF_DPPIC->CHEN |= 1 << 1; // Enable Channel 1 DPPI
	nrf_timer_subscribe_set(synctimer, NRF_TIMER_TASK_CAPTURE1, 0);
	NRF_RADIO->PUBLISH_END |= 1 << 31; // Enable Publishing on CH0
	nrf_timer_subscribe_set(synctimer, NRF_TIMER_TASK_CAPTURE2, 1);
	NRF_RADIO->PUBLISH_CRCOK |= 1 << 31; // Enable Publishing
	NRF_RADIO->PUBLISH_CRCOK |= 1 << 0;	 // Enable Publishing on CH1
#else
	/* Setup PPI for Sending and Receiving Timesync Packet */
	//nrfx_ppi_channel_fork_assign(nRF52_PreDefinedPPICH_Tx, (uint32_t)synctimer.p_reg->TASKS_CAPTURE[1]);
	NRF_PPI->CH[18].EEP = (uint32_t) & (NRF_RADIO->EVENTS_END);
	NRF_PPI->CH[18].TEP = (uint32_t) & (synctimer->TASKS_CAPTURE[1]);
	NRF_PPI->CHENSET |= (PPI_CHENSET_CH18_Set << PPI_CHENSET_CH18_Pos);
	//nrfx_ppi_channel_enable(nRF52_PreDefinedPPICH_Tx);
	//nrfx_ppi_channel_fork_assign(nRF52_PreDefinedPPICH_Rx, (uint32_t)synctimer.p_reg->TASKS_START);
	//nrfx_ppi_channel_enable(nRF52_PreDefinedPPICH_Rx);
	//NRF_PPI->FORK[26].TEP = (uint32_t)&(synctimer.p_reg->TASKS_CAPTURE[1]);
	//NRF_PPI->CHENSET = (PPI_CHENSET_CH26_Set << PPI_CHENSET_CH26_Pos);
	NRF_PPI->CH[19].EEP = (uint32_t) & (NRF_RADIO->EVENTS_CRCOK); // 40us Delay
	NRF_PPI->CH[19].TEP = (uint32_t) & (synctimer->TASKS_CAPTURE[2]);
	NRF_PPI->CHENSET |= (PPI_CHENSET_CH19_Set << PPI_CHENSET_CH19_Pos);
#endif // defined(DPPI_PRESENT) || defined(__NRFX_DOXYGEN__)
}

/* Timestamp Capture Disable */
extern void synctimer_TimeStampCapture_disable()
{
#if defined(DPPI_PRESENT) || defined(__NRFX_DOXYGEN__)
	/* Setup DPPI for Sending and Receiving Timesync Packet */
	nrf_timer_subscribe_clear(synctimer, NRF_TIMER_TASK_CAPTURE1);
	NRF_RADIO->PUBLISH_END &= ~(1 << 31); // Disable Publishing on CH0
	nrf_timer_subscribe_clear(synctimer, NRF_TIMER_TASK_CAPTURE2);
	NRF_RADIO->PUBLISH_CRCOK &= ~(1 << 31); // Disable Publishing
	NRF_RADIO->PUBLISH_CRCOK &= ~(1 << 0);	 // Disable Publishing on CH1
	NRF_DPPIC->CHEN &= ~(1 << 0);			 // Disable Channel 0 DPPI
	NRF_DPPIC->CHEN &= ~(1 << 1);			 // Disable Channel 1 DPPI
#else
	/* Reset PPI for Sending and Receiving Timesync Packet */
	NRF_PPI->CH[18].EEP = 0;
	NRF_PPI->CH[18].TEP = 0;
	NRF_PPI->CHENSET &= ~(1 << PPI_CHENSET_CH18_Pos);
	NRF_PPI->CH[19].EEP = 0;
	NRF_PPI->CH[19].TEP = 0;
	NRF_PPI->CHENSET &= ~(1 << PPI_CHENSET_CH19_Pos);
#endif // defined(DPPI_PRESENT) || defined(__NRFX_DOXYGEN__)
}

/* Clears and starts the timer */
extern void synctimer_start()
{
	// Start the Synctimer
	nrf_timer_task_trigger(synctimer, NRF_TIMER_TASK_CLEAR);
	nrf_timer_task_trigger(synctimer, NRF_TIMER_TASK_START);
	OverflowCNT = 0;
}

/* Stops and clears the timer */
extern void synctimer_stop()
{
	// Stop the Synctimer
	nrf_timer_task_trigger(synctimer, NRF_TIMER_TASK_SHUTDOWN);
	nrf_timer_task_trigger(synctimer, NRF_TIMER_TASK_CLEAR);
	OverflowCNT = 0;
}

/* Get previous Tx sync timestamp */
extern uint64_t synctimer_getTxTimeStamp()
{
	return ((uint64_t) OverflowCNT << 32 | nrf_timer_cc_get(synctimer, NRF_TIMER_CC_CHANNEL1));
}

/* Get previous Rx sync timestamp */
extern uint64_t synctimer_getRxTimeStamp()
{
	return ((uint64_t) OverflowCNT << 32 | nrf_timer_cc_get(synctimer, NRF_TIMER_CC_CHANNEL2));
}

/* Synchronise the timer offset with the received offset Timestamp */
extern void synctimer_setSync(uint64_t TxMasterTimeStamp)
{
	Timestamp_Slave = ((uint64_t) OverflowCNT << 32 | nrf_timer_cc_get(synctimer, NRF_TIMER_CC_CHANNEL2)) - RxChainDelay_us;
	Timestamp_Master = TxMasterTimeStamp;
	if (Timestamp_Slave > Timestamp_Master)
	{
		Timestamp_Diff = Timestamp_Slave - Timestamp_Master;
	}
	else if ((Timestamp_Master > Timestamp_Slave))
	{
		Timestamp_Diff = Timestamp_Master - Timestamp_Slave;
	}
	else
	{
		Timestamp_Diff = 0;
	}
}

/* Get Synchronised Timestamp */
extern uint64_t synctimer_getSyncTime()
{
	if (Timestamp_Slave > Timestamp_Master)
	{
		nrf_timer_task_trigger(synctimer,nrf_timer_capture_task_get(NRF_TIMER_CC_CHANNEL0));
		return (((uint64_t) OverflowCNT << 32 | nrf_timer_cc_get(synctimer, NRF_TIMER_CC_CHANNEL0)) - Timestamp_Diff);
	}
	else if ((Timestamp_Master > Timestamp_Slave))
	{
		nrf_timer_task_trigger(synctimer,nrf_timer_capture_task_get(NRF_TIMER_CC_CHANNEL0));
		return (((uint64_t) OverflowCNT << 32 | nrf_timer_cc_get(synctimer, NRF_TIMER_CC_CHANNEL0)) + Timestamp_Diff);
	}
	else
	{
		nrf_timer_task_trigger(synctimer,nrf_timer_capture_task_get(NRF_TIMER_CC_CHANNEL0));
		return ((uint64_t) OverflowCNT << 32 | nrf_timer_cc_get(synctimer, NRF_TIMER_CC_CHANNEL0));
	}
}

/* Sets a synced Time Compare Interrupt (with respect of Synced Time) */
extern void synctimer_setSyncTimeCompareInt(uint64_t ts ,void (*cc_cb)())
{
	//printk("%llu\n",ts- synctimer_getSyncTime());
	if (Timestamp_Slave > Timestamp_Master)
	{
		OverflowCNT_int_synced_ts = (uint32_t)(ts>>32) + (uint32_t)(Timestamp_Diff>>32); 
		synctimer->CC[4] = (uint32_t)ts + (uint32_t)Timestamp_Diff; 
	}
	else if ((Timestamp_Master > Timestamp_Slave))
	{
		OverflowCNT_int_synced_ts = (uint32_t)(ts>>32) - (uint32_t)(Timestamp_Diff>>32); 
		synctimer->CC[4] = (uint32_t)ts - (uint32_t)Timestamp_Diff; 
	}
	else
	{
		OverflowCNT_int_synced_ts = (uint32_t)(ts>>32); 
		synctimer->CC[4] = (uint32_t)ts; 
	}
	//printk("%u\n",synctimer->CC[4]);
	//nrf_timer_task_trigger(synctimer,nrf_timer_capture_task_get(NRF_TIMER_CC_CHANNEL0));
	//printk("%u\n",synctimer->CC[4] - synctimer->CC[0]);
	synctimer->INTENSET |= (uint32_t) NRF_TIMER_INT_COMPARE4_MASK; // Enable Compare Event 4 Interrupt
	sync_compare_callback = cc_cb;
}

void config_debug_ppi_and_gpiote_radio_state()
{
	NRF_P0->PIN_CNF[14] = NRF_P0->PIN_CNF[15]; // Copy Configuration from LED
	NRF_P0->DIRSET |= 1 << 14;
	NRF_P0->DIR |= 1 << 14;
	//Radio Tx
	NRF_GPIOTE->CONFIG[0] = ((GPIOTE_CONFIG_MODE_Task << GPIOTE_CONFIG_MODE_Pos) |
							(14 << GPIOTE_CONFIG_PSEL_Pos) |
							(0 << GPIOTE_CONFIG_PORT_Pos) |
							(GPIOTE_CONFIG_POLARITY_Toggle << GPIOTE_CONFIG_POLARITY_Pos) |
							(GPIOTE_CONFIG_OUTINIT_Low << GPIOTE_CONFIG_OUTINIT_Pos));
	
	//NRF_PPI->CH[7].EEP = (uint32_t) & NRF_RADIO->EVENTS_TXREADY;
	NRF_PPI->CH[7].EEP = (uint32_t) & NRF_TIMER4->EVENTS_COMPARE[4];
	NRF_PPI->CH[7].TEP = (uint32_t) & NRF_GPIOTE->TASKS_OUT[0];
	NRF_PPI->CHENSET |= (PPI_CHENSET_CH7_Set << PPI_CHENSET_CH7_Pos);
	//Radio Rx
	NRF_GPIOTE->CONFIG[1] = ((GPIOTE_CONFIG_MODE_Task << GPIOTE_CONFIG_MODE_Pos) |
							(1 << GPIOTE_CONFIG_PSEL_Pos) |
							(0 << GPIOTE_CONFIG_PORT_Pos) |
							(GPIOTE_CONFIG_POLARITY_Toggle << GPIOTE_CONFIG_POLARITY_Pos) |
							(GPIOTE_CONFIG_OUTINIT_High << GPIOTE_CONFIG_OUTINIT_Pos));
	//NRF_PPI->CH[8].EEP = (uint32_t) & NRF_RADIO->EVENTS_RXREADY;
	NRF_PPI->CH[8].EEP = (uint32_t) & NRF_TIMER4->EVENTS_COMPARE[4];
	NRF_PPI->CH[8].TEP = (uint32_t) & NRF_GPIOTE->TASKS_OUT[1];
	NRF_PPI->CHENSET |= (PPI_CHENSET_CH8_Set << PPI_CHENSET_CH8_Pos);

	//Reset Tx LEDs
	/*
	NRF_GPIOTE->CONFIG[2] = (GPIOTE_CONFIG_MODE_Task << GPIOTE_CONFIG_MODE_Pos) |
							(0 << GPIOTE_CONFIG_PSEL_Pos) |
							(0 << GPIOTE_CONFIG_PORT_Pos) |
							(GPIOTE_CONFIG_POLARITY_LoToHi << GPIOTE_CONFIG_POLARITY_Pos) |
							(GPIOTE_CONFIG_OUTINIT_High << GPIOTE_CONFIG_OUTINIT_Pos);
	NRF_PPI->CH[9].EEP = (uint32_t) & NRF_RADIO->EVENTS_RXREADY;
	NRF_PPI->CH[9].TEP = (uint32_t) & NRF_GPIOTE->TASKS_OUT[2];
	NRF_PPI->CHENSET = (PPI_CHENSET_CH9_Set << PPI_CHENSET_CH9_Pos);
	//Reset Rx LEDs
	NRF_GPIOTE->CONFIG[3] = (GPIOTE_CONFIG_MODE_Task << GPIOTE_CONFIG_MODE_Pos) |
							(1 << GPIOTE_CONFIG_PSEL_Pos) |
							(0 << GPIOTE_CONFIG_PORT_Pos) |
							(GPIOTE_CONFIG_POLARITY_LoToHi << GPIOTE_CONFIG_POLARITY_Pos) |
							(GPIOTE_CONFIG_OUTINIT_High << GPIOTE_CONFIG_OUTINIT_Pos);
	NRF_PPI->CH[10].EEP = (uint32_t) & NRF_RADIO->EVENTS_TXREADY;
	NRF_PPI->CH[10].TEP = (uint32_t) & NRF_GPIOTE->TASKS_OUT[3];
	NRF_PPI->CHENSET = (PPI_CHENSET_CH10_Set << PPI_CHENSET_CH10_Pos);
	*/
}
```

## src/bm_master.cpp
```c
/*
This file is part of P2P-Benchamrk.

P2P-Benchamrk is free software: you can redistribute it and/or modify
it under the terms of the GNU General Public License as published by
the Free Software Foundation, either version 3 of the License, or
(at your option) any later version.

P2P-Benchamrk is distributed in the hope that it will be useful,
but WITHOUT ANY WARRANTY; without even the implied warranty of
MERCHANTABILITY or FITNESS FOR A PARTICULAR PURPOSE.  See the
GNU General Public License for more details.

You should have received a copy of the GNU General Public License
along with P2P-Benchamrk.  If not, see <http://www.gnu.org/licenses/>.
*/
```

## src/nrfx_timer_example_code.cpp
```c
#include <nrfx_timer.h>

/* proj.conf

    
CONFIG_NRFX_TIMER0=y
CONFIG_NRFX_RTC0=y

*/
#include <nrfx_rtc.h>
// For RTC see: https://devzone.nordicsemi.com/f/nordic-q-a/53519/zephyr-rtc


/* Timer used for ... */
static const nrfx_timer_t rtc = NRFX_TIMER_INSTANCE(0);

/* Timer Callback */
static void timer_handler(nrf_timer_event_t event_type, void *context)
{	
	if (event_type == NRF_TIMER_EVENT_COMPARE1) {
		/* For future use */
	}
}
/* Timer init */
static void timer_init()
{
	nrfx_err_t          err;
	// Takes 16.77s to expire
	nrfx_timer_config_t timer_cfg = {
		.frequency = NRF_TIMER_FREQ_1MHz,
		.mode      = NRF_TIMER_MODE_TIMER,
		.bit_width = NRF_TIMER_BIT_WIDTH_24,
		//.p_context = (void *) config, // Callback context
	};

	err = nrfx_timer_init(&timer, &timer_cfg, timer_handler);
	if (err != NRFX_SUCCESS) {
		printk("nrfx_timer_init failed with: %d\n", err);
	}
}

void main(){

	/* Init Timer0 */	
	timer_init();
	IRQ_CONNECT(TIMER0_IRQn, NRFX_TIMER_DEFAULT_CONFIG_IRQ_PRIORITY,
	nrfx_timer_0_irq_handler, NULL, 0);

}
```
