## prj.conf
```kconfig
#
# Copyright (c) 2020 Nordic Semiconductor ASA
#
# SPDX-License-Identifier: LicenseRef-BSD-5-Clause-Nordic
#

CONFIG_NCS_SAMPLES_DEFAULTS=y

CONFIG_UART_INTERRUPT_DRIVEN=y
CONFIG_SERIAL=y
CONFIG_GPIO=y
CONFIG_PWM=y

# Make sure printk is not printing to the UART console
CONFIG_CONSOLE=y
# CONFIG_UART_CONSOLE=y

CONFIG_HEAP_MEM_POOL_SIZE=2048
CONFIG_MAIN_THREAD_PRIORITY=7

CONFIG_ZIGBEE=y
CONFIG_ZIGBEE_ROLE_ROUTER=y
CONFIG_ZIGBEE_CLI_LOG_LEVEL_INF=y

# Disable ZBOSS trace logs
CONFIG_ZBOSS_TRACE_LOG_LEVEL_OFF=y

# Enable bonding
CONFIG_NVS=y

# Enable DK LED and Buttons library
CONFIG_DK_LIBRARY=y

# This example requires more workqueue stack
CONFIG_SYSTEM_WORKQUEUE_STACK_SIZE=2048

# Enable nRF ECB driver
CONFIG_CRYPTO=y
CONFIG_CRYPTO_NRF_ECB=y

# Cryptocell is not supported through CSPRNG driver API: NCSDK-4813
CONFIG_ENTROPY_CC310=n

# Enable Shell
# CONFIG_SHELL=y

# Enable Logging in Shell
CONFIG_LOG=y
CONFIG_LOG_DEFAULT_LEVEL=3


# Enable RTT Logging
CONFIG_USE_SEGGER_RTT=y
CONFIG_RTT_CONSOLE=y
```

## src/main.c
```c
/*
 * Zigbee Benchmark Server
 * Acting as a Light Bulb
 */

#include <zephyr/types.h>
#include <zephyr.h>
#include <device.h>
#include <devicetree.h>
#include <soc.h>
#include <drivers/pwm.h>
#include <logging/log.h>
#include <dk_buttons_and_leds.h>
#include <drivers/gpio.h>

#include "bm_zigbee.h"

LOG_MODULE_REGISTER(app_bm_main);


void main(void)
{
	LOG_INF("Starting BENCHMARK Server");

	bm_zigbee_init();

	bm_zigbee_enable();
}
```

## include/Timer_sync.h
```c
#ifdef __cplusplus
extern "C" {
#endif

#ifndef TIMER_SYNC_H
#define TIMER_SYNC_H

#include <stdlib.h>
#include <string.h>
#include <zephyr.h>

#include <nrfx_timer.h>
#include <hal/nrf_timer.h>
#include <hal/nrf_radio.h>

#if defined(DPPI_PRESENT) || defined(__NRFX_DOXYGEN__)
#include <nrfx_dppi.h>
#else
#include <nrfx_ppi.h>
/** PreDefined PPI Channel from RADIO->EVENTS_END */
#define nRF52_PreDefinedPPICH_Tx NRF_PPI_CHANNEL27
/** PreDefined PPI Channel from RADIO->EVENTS_ADDRESS */
#define nRF52_PreDefinedPPICH_Rx NRF_PPI_CHANNEL26
#endif // defined(DPPI_PRESENT) || defined(__NRFX_DOXYGEN__)

/* Timer used for Synchronisation */
extern NRF_TIMER_Type * synctimer;
extern uint64_t Timestamp_Slave;
extern uint64_t Timestamp_Master;
extern uint64_t Timestamp_Diff;

/**
* Init the Sync Timer
*
*/
extern void synctimer_init();

/**
* Timestamp Capture clear
*
*/
extern void synctimer_TimeStampCapture_clear();

/**
* Timestamp Capture enable
*
*/
extern void synctimer_TimeStampCapture_enable();
/**
* Timestamp Capture disable
*
*/
extern void synctimer_TimeStampCapture_disable();


/**
* Clears and starts the timer
*/
extern void synctimer_start();

/**
* Stops and clears the timer
*/
extern void synctimer_stop();
/**
* Get previous Tx sync timestamp
*
* @return Latest Tx Timestamp
*/
extern uint64_t synctimer_getTxTimeStamp();
/**
* Get previous Rx sync timestamp
*
* @return Latest Rx Timestamp
*/
extern uint64_t synctimer_getRxTimeStamp();
/**
* Synchronise the timer with the received offset Timestamp
*
* @param TxMasterTimeStamp Latest 
*/
extern void synctimer_setSync(uint64_t TxMasterTimeStamp);
/**
* Get Synchronised Timestamp
*
* @return Synchronised Timestamp
*/
extern uint64_t synctimer_getSyncTime();
/**
* Sets a synced Time Compare Interrupt (with respect of Synced Time)
*
* @param ts Timestamp for Interrupt
* @param cc_cb Callback on Interrupt
*/
extern void synctimer_setSyncTimeCompareInt(uint64_t ts ,void (*cc_cb)());

extern void config_debug_ppi_and_gpiote_radio_state();

#endif

#ifdef __cplusplus
}
#endif
```

## include/bm_zigbee.h
```c
/* TODO: Description */
void bm_zigbee_init(void);

/* TODO: Description */
void bm_zigbee_enable(void);
```

## src/Timer_sync.c
```c
#include "Timer_sync.h"

NRF_TIMER_Type * synctimer = NRF_TIMER4;
uint64_t Timestamp_Slave = 0;
uint64_t Timestamp_Master = 0;
uint64_t Timestamp_Diff = 0;
static uint32_t OverflowCNT = 0;
static uint32_t OverflowCNT_int_synced_ts = 0;
static const uint32_t RxChainDelay_us = 35; // Meassured Chain Delay (40 with IEEE803.4.15)

static void (*sync_compare_callback)();


ISR_DIRECT_DECLARE(timer_handler)
{
		// Overflow Handler
	if (synctimer->EVENTS_COMPARE[5] == true)
	{
		synctimer->EVENTS_COMPARE[5] = false;
		OverflowCNT++;
	}
	if (synctimer->EVENTS_COMPARE[4] == true)
	{
		synctimer->EVENTS_COMPARE[4] = false;
		if ((sync_compare_callback != NULL) && (OverflowCNT == OverflowCNT_int_synced_ts)){
			sync_compare_callback();
		}
	}
	ISR_DIRECT_PM();
	return 1;
}


/*
static void synctimer_handler(){
	// Overflow Handler
	if (synctimer->EVENTS_COMPARE[5] == true)
	{
		synctimer->EVENTS_COMPARE[5] = false;
		OverflowCNT++;
	}
	if (synctimer->EVENTS_COMPARE[4] == true)
	{
		synctimer->EVENTS_COMPARE[4] = false;
		if ((sync_compare_callback != NULL) && (OverflowCNT == OverflowCNT_int_synced_ts)){
			sync_compare_callback();
		}
	}
	printk("hoi\n");
}
*/

/* Timer init */
extern void synctimer_init()
{
	// Takes 4294s / 71min to expire
	nrf_timer_bit_width_set(synctimer,NRF_TIMER_BIT_WIDTH_32);
	nrf_timer_frequency_set(synctimer,NRF_TIMER_FREQ_1MHz);
	nrf_timer_mode_set(synctimer,NRF_TIMER_MODE_TIMER);
	//irq_connect_dynamic(TIMER3_IRQn, 7, synctimer_handler, NULL, 0); 	// Connect Radio ISR
	IRQ_DIRECT_CONNECT(TIMER4_IRQn, 6, timer_handler, 0);
    irq_enable(TIMER4_IRQn);                                        // Enable Radio ISR
	nrf_timer_task_trigger(synctimer, NRF_TIMER_TASK_CLEAR);
	nrf_timer_cc_set(synctimer,NRF_TIMER_CC_CHANNEL1,0);
	nrf_timer_cc_set(synctimer,NRF_TIMER_CC_CHANNEL2,0);
	nrf_timer_cc_set(synctimer,NRF_TIMER_CC_CHANNEL5,0xFFFFFFFF); // For Overflow Detection
	synctimer->INTENSET |= (uint32_t) NRF_TIMER_INT_COMPARE5_MASK; // Enable Compare Event 5 Interrupt
	OverflowCNT = 0;
}

/* Timestamp Capture Clear */
void synctimer_TimeStampCapture_clear()
{
	synctimer->CC[1] = 0;
	synctimer->CC[2] = 0;
}

/* Timestamp Capture Enable */
extern void synctimer_TimeStampCapture_enable()
{
#if defined(DPPI_PRESENT) || defined(__NRFX_DOXYGEN__)
	/* Setup DPPI for Sending and Receiving Timesync Packet */
	NRF_DPPIC->CHEN |= 1 << 0; // Enable Channel 0 DPPI
	NRF_DPPIC->CHEN |= 1 << 1; // Enable Channel 1 DPPI
	nrf_timer_subscribe_set(synctimer.p_reg, NRF_TIMER_TASK_CAPTURE1, 0);
	NRF_RADIO->PUBLISH_END |= 1 << 31; // Enable Publishing on CH0
	nrf_timer_subscribe_set(synctimer.p_reg, NRF_TIMER_TASK_CAPTURE2, 1);
	NRF_RADIO->PUBLISH_CRCOK |= 1 << 31; // Enable Publishing
	NRF_RADIO->PUBLISH_CRCOK |= 1 << 0;	 // Enable Publishing on CH1
#else
	/* Setup PPI for Sending and Receiving Timesync Packet */
	//nrfx_ppi_channel_fork_assign(nRF52_PreDefinedPPICH_Tx, (uint32_t)synctimer.p_reg->TASKS_CAPTURE[1]);
	NRF_PPI->CH[18].EEP = (uint32_t) & (NRF_RADIO->EVENTS_END);
	NRF_PPI->CH[18].TEP = (uint32_t) & (synctimer->TASKS_CAPTURE[1]);
	NRF_PPI->CHENSET |= (PPI_CHENSET_CH18_Set << PPI_CHENSET_CH18_Pos);
	//nrfx_ppi_channel_enable(nRF52_PreDefinedPPICH_Tx);
	//nrfx_ppi_channel_fork_assign(nRF52_PreDefinedPPICH_Rx, (uint32_t)synctimer.p_reg->TASKS_START);
	//nrfx_ppi_channel_enable(nRF52_PreDefinedPPICH_Rx);
	//NRF_PPI->FORK[26].TEP = (uint32_t)&(synctimer.p_reg->TASKS_CAPTURE[1]);
	//NRF_PPI->CHENSET = (PPI_CHENSET_CH26_Set << PPI_CHENSET_CH26_Pos);
	NRF_PPI->CH[19].EEP = (uint32_t) & (NRF_RADIO->EVENTS_CRCOK); // 40us Delay
	NRF_PPI->CH[19].TEP = (uint32_t) & (synctimer->TASKS_CAPTURE[2]);
	NRF_PPI->CHENSET |= (PPI_CHENSET_CH19_Set << PPI_CHENSET_CH19_Pos);
#endif // defined(DPPI_PRESENT) || defined(__NRFX_DOXYGEN__)
}

/* Timestamp Capture Disable */
extern void synctimer_TimeStampCapture_disable()
{
#if defined(DPPI_PRESENT) || defined(__NRFX_DOXYGEN__)
	/* Setup DPPI for Sending and Receiving Timesync Packet */
	nrf_timer_subscribe_clear(synctimer.p_reg, NRF_TIMER_TASK_CAPTURE1);
	NRF_RADIO->PUBLISH_END &= ~(1 << 31); // Disable Publishing on CH0
	nrf_timer_subscribe_clear(synctimer.p_reg, NRF_TIMER_TASK_CAPTURE2);
	NRF_RADIO->PUBLISH_CRCOK &= ~(1 << 31); // Disable Publishing
	NRF_RADIO->PUBLISH_CRCOK &= ~(1 << 0);	 // Disable Publishing on CH1
	NRF_DPPIC->CHEN &= ~(1 << 0);			 // Disable Channel 0 DPPI
	NRF_DPPIC->CHEN &= ~(1 << 1);			 // Disable Channel 1 DPPI
#else
	/* Reset PPI for Sending and Receiving Timesync Packet */
	NRF_PPI->CH[18].EEP = 0;
	NRF_PPI->CH[18].TEP = 0;
	NRF_PPI->CHENSET &= ~(1 << PPI_CHENSET_CH18_Pos);
	NRF_PPI->CH[19].EEP = 0;
	NRF_PPI->CH[19].TEP = 0;
	NRF_PPI->CHENSET &= ~(1 << PPI_CHENSET_CH19_Pos);
#endif // defined(DPPI_PRESENT) || defined(__NRFX_DOXYGEN__)
}

/* Clears and starts the timer */
extern void synctimer_start()
{
	// Start the Synctimer
	nrf_timer_task_trigger(synctimer, NRF_TIMER_TASK_CLEAR);
	nrf_timer_task_trigger(synctimer, NRF_TIMER_TASK_START);
	OverflowCNT = 0;
}

/* Stops and clears the timer */
extern void synctimer_stop()
{
	// Stop the Synctimer
	nrf_timer_task_trigger(synctimer, NRF_TIMER_TASK_SHUTDOWN);
	nrf_timer_task_trigger(synctimer, NRF_TIMER_TASK_CLEAR);
	OverflowCNT = 0;
}

/* Get previous Tx sync timestamp */
extern uint64_t synctimer_getTxTimeStamp()
{
	return ((uint64_t) OverflowCNT << 32 | nrf_timer_cc_get(synctimer, NRF_TIMER_CC_CHANNEL1));
}

/* Get previous Rx sync timestamp */
extern uint64_t synctimer_getRxTimeStamp()
{
	return ((uint64_t) OverflowCNT << 32 | nrf_timer_cc_get(synctimer, NRF_TIMER_CC_CHANNEL2));
}

/* Synchronise the timer offset with the received offset Timestamp */
extern void synctimer_setSync(uint64_t TxMasterTimeStamp)
{
	Timestamp_Slave = ((uint64_t) OverflowCNT << 32 | nrf_timer_cc_get(synctimer, NRF_TIMER_CC_CHANNEL2)) - RxChainDelay_us;
	Timestamp_Master = TxMasterTimeStamp;
	if (Timestamp_Slave > Timestamp_Master)
	{
		Timestamp_Diff = Timestamp_Slave - Timestamp_Master;
	}
	else if ((Timestamp_Master > Timestamp_Slave))
	{
		Timestamp_Diff = Timestamp_Master - Timestamp_Slave;
	}
	else
	{
		Timestamp_Diff = 0;
	}
}

/* Get Synchronised Timestamp */
extern uint64_t synctimer_getSyncTime()
{
	if (Timestamp_Slave > Timestamp_Master)
	{
		nrf_timer_task_trigger(synctimer,nrf_timer_capture_task_get(NRF_TIMER_CC_CHANNEL0));
		return (((uint64_t) OverflowCNT << 32 | nrf_timer_cc_get(synctimer, NRF_TIMER_CC_CHANNEL0)) - Timestamp_Diff);
	}
	else if ((Timestamp_Master > Timestamp_Slave))
	{
		nrf_timer_task_trigger(synctimer,nrf_timer_capture_task_get(NRF_TIMER_CC_CHANNEL0));
		return (((uint64_t) OverflowCNT << 32 | nrf_timer_cc_get(synctimer, NRF_TIMER_CC_CHANNEL0)) + Timestamp_Diff);
	}
	else
	{
		nrf_timer_task_trigger(synctimer,nrf_timer_capture_task_get(NRF_TIMER_CC_CHANNEL0));
		return ((uint64_t) OverflowCNT << 32 | nrf_timer_cc_get(synctimer, NRF_TIMER_CC_CHANNEL0));
	}
}

/* Sets a synced Time Compare Interrupt (with respect of Synced Time) */
extern void synctimer_setSyncTimeCompareInt(uint64_t ts ,void (*cc_cb)())
{
	//printk("%llu\n",ts- synctimer_getSyncTime());
	if (Timestamp_Slave > Timestamp_Master)
	{
		OverflowCNT_int_synced_ts = (uint32_t)(ts>>32) + (uint32_t)(Timestamp_Diff>>32); 
		synctimer->CC[4] = (uint32_t)ts + (uint32_t)Timestamp_Diff; 
	}
	else if ((Timestamp_Master > Timestamp_Slave))
	{
		OverflowCNT_int_synced_ts = (uint32_t)(ts>>32) - (uint32_t)(Timestamp_Diff>>32); 
		synctimer->CC[4] = (uint32_t)ts - (uint32_t)Timestamp_Diff; 
	}
	else
	{
		OverflowCNT_int_synced_ts = (uint32_t)(ts>>32); 
		synctimer->CC[4] = (uint32_t)ts; 
	}
	//printk("%u\n",synctimer->CC[4]);
	//nrf_timer_task_trigger(synctimer,nrf_timer_capture_task_get(NRF_TIMER_CC_CHANNEL0));
	//printk("%u\n",synctimer->CC[4] - synctimer->CC[0]);
	synctimer->INTENSET |= (uint32_t) NRF_TIMER_INT_COMPARE4_MASK; // Enable Compare Event 4 Interrupt
	sync_compare_callback = cc_cb;
}

void config_debug_ppi_and_gpiote_radio_state()
{
	NRF_P0->PIN_CNF[14] = NRF_P0->PIN_CNF[15]; // Copy Configuration from LED
	NRF_P0->DIRSET |= 1 << 14;
	NRF_P0->DIR |= 1 << 14;
	//Radio Tx
	NRF_GPIOTE->CONFIG[0] = ((GPIOTE_CONFIG_MODE_Task << GPIOTE_CONFIG_MODE_Pos) |
							(14 << GPIOTE_CONFIG_PSEL_Pos) |
							(0 << GPIOTE_CONFIG_PORT_Pos) |
							(GPIOTE_CONFIG_POLARITY_Toggle << GPIOTE_CONFIG_POLARITY_Pos) |
							(GPIOTE_CONFIG_OUTINIT_Low << GPIOTE_CONFIG_OUTINIT_Pos));
	
	//NRF_PPI->CH[7].EEP = (uint32_t) & NRF_RADIO->EVENTS_TXREADY;
	NRF_PPI->CH[7].EEP = (uint32_t) & NRF_TIMER3->EVENTS_COMPARE[4];
	NRF_PPI->CH[7].TEP = (uint32_t) & NRF_GPIOTE->TASKS_OUT[0];
	NRF_PPI->CHENSET |= (PPI_CHENSET_CH7_Set << PPI_CHENSET_CH7_Pos);
	//Radio Rx
	NRF_GPIOTE->CONFIG[1] = ((GPIOTE_CONFIG_MODE_Task << GPIOTE_CONFIG_MODE_Pos) |
							(1 << GPIOTE_CONFIG_PSEL_Pos) |
							(0 << GPIOTE_CONFIG_PORT_Pos) |
							(GPIOTE_CONFIG_POLARITY_Toggle << GPIOTE_CONFIG_POLARITY_Pos) |
							(GPIOTE_CONFIG_OUTINIT_High << GPIOTE_CONFIG_OUTINIT_Pos));
	//NRF_PPI->CH[8].EEP = (uint32_t) & NRF_RADIO->EVENTS_RXREADY;
	NRF_PPI->CH[8].EEP = (uint32_t) & NRF_TIMER3->EVENTS_COMPARE[4];
	NRF_PPI->CH[8].TEP = (uint32_t) & NRF_GPIOTE->TASKS_OUT[1];
	NRF_PPI->CHENSET |= (PPI_CHENSET_CH8_Set << PPI_CHENSET_CH8_Pos);

	//Reset Tx LEDs
	/*
	NRF_GPIOTE->CONFIG[2] = (GPIOTE_CONFIG_MODE_Task << GPIOTE_CONFIG_MODE_Pos) |
							(0 << GPIOTE_CONFIG_PSEL_Pos) |
							(0 << GPIOTE_CONFIG_PORT_Pos) |
							(GPIOTE_CONFIG_POLARITY_LoToHi << GPIOTE_CONFIG_POLARITY_Pos) |
							(GPIOTE_CONFIG_OUTINIT_High << GPIOTE_CONFIG_OUTINIT_Pos);
	NRF_PPI->CH[9].EEP = (uint32_t) & NRF_RADIO->EVENTS_RXREADY;
	NRF_PPI->CH[9].TEP = (uint32_t) & NRF_GPIOTE->TASKS_OUT[2];
	NRF_PPI->CHENSET = (PPI_CHENSET_CH9_Set << PPI_CHENSET_CH9_Pos);
	//Reset Rx LEDs
	NRF_GPIOTE->CONFIG[3] = (GPIOTE_CONFIG_MODE_Task << GPIOTE_CONFIG_MODE_Pos) |
							(1 << GPIOTE_CONFIG_PSEL_Pos) |
							(0 << GPIOTE_CONFIG_PORT_Pos) |
							(GPIOTE_CONFIG_POLARITY_LoToHi << GPIOTE_CONFIG_POLARITY_Pos) |
							(GPIOTE_CONFIG_OUTINIT_High << GPIOTE_CONFIG_OUTINIT_Pos);
	NRF_PPI->CH[10].EEP = (uint32_t) & NRF_RADIO->EVENTS_TXREADY;
	NRF_PPI->CH[10].TEP = (uint32_t) & NRF_GPIOTE->TASKS_OUT[3];
	NRF_PPI->CHENSET = (PPI_CHENSET_CH10_Set << PPI_CHENSET_CH10_Pos);
	*/
}
```

## src/bm_zigbee.c
```c
/*
 * Copyright (c) 2020 Nordic Semiconductor ASA
 *
 * SPDX-License-Identifier: LicenseRef-BSD-5-Clause-Nordic
 */

/** @file
 *
 * @brief Simple Zigbee light bulb implementation.
 */

#include <zephyr/types.h>
#include <zephyr.h>
#include <device.h>
#include <devicetree.h>
#include <soc.h>
#include <drivers/pwm.h>
#include <logging/log.h>
#include <dk_buttons_and_leds.h>
#include <drivers/gpio.h>

#include <zboss_api.h>
#include <zboss_api_addons.h>
#include <zigbee_helpers.h>
#include <zb_error_handler.h>
#include <zb_nrf_platform.h>
#include <zb_mem_config_med.h>

#include "bm_zigbee.h"

#define BM_STACK_SIZE 500			  /* Benchmark Stack Size */
#define BM_THREAD_PRIO 5			  /* Benchmark Thread Priority */
#define GROUP_ID 0xB331				  /* Group ID which will be used to address a specific group of Benchmark Servers */
#define BENCHMARK_CLIENT_ENDPOINT 1	  /* ZCL Endpoint of the Benchmark Client */
#define BENCHMARK_SERVER_ENDPOINT 10  /* ZCL Endpoint of the Benchmark Server */
#define BENCHMARK_CONTROL_ENDPOINT 11 /* ZCL Endpoint for Benchmark Control */

#define ERASE_PERSISTENT_CONFIG ZB_FALSE		/* Do not erase NVRAM to save the network parameters after device reboot or    \
												 * power-off. NOTE: If this option is set to ZB_TRUE then do full device erase \
												 * for all network devices before running other samples.*/
#define BULB_LED DK_LED4						/* LED immitaing dimmable light bulb */
#define DONGLE_BUTTON DK_BTN1_MSK				/* Button on the Dongle */
#define ZIGBEE_NETWORK_STATE_LED DK_LED1		/* LED indicating that light switch successfully joind Zigbee network. */
#define PWM_DK_LED4_NODE DT_NODELABEL(pwm_led3) /* Use onboard led4 to act as a light bulb. The app.overlay file has this at node label "pwm_led3" in /pwmleds. */

#define MATCH_DESC_REQ_START_DELAY (2 * ZB_TIME_ONE_SECOND) /* Delay between the light switch startup and light bulb finding procedure. */

/* Nordic PWM nodes don't have flags cells in their specifiers, so this is just future-proofing.*/
#define FLAGS_OR_ZERO(node)                         \
	COND_CODE_1(DT_PHA_HAS_CELL(node, pwms, flags), \
				(DT_PWMS_FLAGS(node)), (0))
#if DT_NODE_HAS_STATUS(PWM_DK_LED4_NODE, okay) /* Get the defines from overlay file. */
#define PWM_DK_LED4_DRIVER DT_PWMS_LABEL(PWM_DK_LED4_NODE)
#define PWM_DK_LED4_CHANNEL DT_PWMS_CHANNEL(PWM_DK_LED4_NODE)
#define PWM_DK_LED4_FLAGS FLAGS_OR_ZERO(PWM_DK_LED4_NODE)
#else
#error "Choose supported PWM driver"
#endif

/*
nRF52840-Dongle LEDs and Buttons
DK_LED1 --> green
DK_LED2 --> red
DK_LED3 --> green
DK_LED4 --> blue
DK_BTN1 --> Button 1
*/
#define HA_DIMMABLE_LIGHT_ENDPOINT 10									 /* Device endpoint, used to receive light controlling commands. */
#define BULB_INIT_BASIC_APP_VERSION 01									 /* Version of the application software (1 byte). */
#define BULB_INIT_BASIC_STACK_VERSION 10								 /* Version of the implementation of the Zigbee stack (1 byte). */
#define BULB_INIT_BASIC_HW_VERSION 11									 /* Version of the hardware of the device (1 byte). */
#define BULB_INIT_BASIC_MANUF_NAME "Nordic"								 /* Manufacturer name (32 bytes). */
#define BULB_INIT_BASIC_MODEL_ID "Dimable_Light_v0.1"					 /* Model number assigned by manufacturer (32-bytes long string). */
#define BULB_INIT_BASIC_DATE_CODE "20200329"							 /* First 8 bytes specify the date of manufacturer of the device in ISO 8601 format (YYYYMMDD). The rest (8 bytes) are manufacturer specific.*/
#define BULB_INIT_BASIC_POWER_SOURCE ZB_ZCL_BASIC_POWER_SOURCE_DC_SOURCE /* Type of power sources available for the device. For possible values see section 3.2.2.2.8 of ZCL specification.*/
#define BULB_INIT_BASIC_LOCATION_DESC "Office desk"						 /* Describes the physical location of the device (16 bytes). May be modified during commisioning process.*/
#define BULB_INIT_BASIC_PH_ENV ZB_ZCL_BASIC_ENV_UNSPECIFIED				 /* Describes the type of physical environment. For possible values see section 3.2.2.2.10 of ZCL specification.*/
#define LED_PWM_PERIOD_US (USEC_PER_SEC / 50U)							 /* Led PWM period, calculated for 50 Hz signal - in microseconds. */
#define NUMBER_OF_NETWORK_TIME_ELEMENTS 1000							 /* Size of the Benchmark Reporting Array message_info */

#ifndef ZB_ROUTER_ROLE
#error Define ZB_ROUTER_ROLE to compile router source code.
#endif

LOG_MODULE_REGISTER(app_bm_zigbee);

/* Main application customizable context.
 * Stores all settings and static values.
 */
typedef struct
{
	zb_zcl_basic_attrs_ext_t basic_attr;
	zb_zcl_identify_attrs_t identify_attr;
	zb_zcl_scenes_attrs_t scenes_attr;
	zb_zcl_groups_attrs_t groups_attr;
	zb_zcl_on_off_attrs_t on_off_attr;
	zb_zcl_level_control_attrs_t level_control_attr;
} bulb_device_ctx_t;

/* Zigbee device application context storage. */
static bulb_device_ctx_t dev_ctx;

/* Pointer to PWM device controlling leds with pwm signal. */
static struct device *led_pwm_dev;

ZB_ZCL_DECLARE_IDENTIFY_ATTRIB_LIST(
	identify_attr_list,
	&dev_ctx.identify_attr.identify_time);

ZB_ZCL_DECLARE_GROUPS_ATTRIB_LIST(
	groups_attr_list,
	&dev_ctx.groups_attr.name_support);

ZB_ZCL_DECLARE_SCENES_ATTRIB_LIST(
	scenes_attr_list,
	&dev_ctx.scenes_attr.scene_count,
	&dev_ctx.scenes_attr.current_scene,
	&dev_ctx.scenes_attr.current_group,
	&dev_ctx.scenes_attr.scene_valid,
	&dev_ctx.scenes_attr.name_support);

ZB_ZCL_DECLARE_BASIC_ATTRIB_LIST_EXT(
	basic_attr_list,
	&dev_ctx.basic_attr.zcl_version,
	&dev_ctx.basic_attr.app_version,
	&dev_ctx.basic_attr.stack_version,
	&dev_ctx.basic_attr.hw_version,
	dev_ctx.basic_attr.mf_name,
	dev_ctx.basic_attr.model_id,
	dev_ctx.basic_attr.date_code,
	&dev_ctx.basic_attr.power_source,
	dev_ctx.basic_attr.location_id,
	&dev_ctx.basic_attr.ph_env,
	dev_ctx.basic_attr.sw_ver);

/* On/Off cluster attributes additions data */
ZB_ZCL_DECLARE_ON_OFF_ATTRIB_LIST(
	on_off_attr_list,
	&dev_ctx.on_off_attr.on_off);

ZB_ZCL_DECLARE_LEVEL_CONTROL_ATTRIB_LIST(
	level_control_attr_list,
	&dev_ctx.level_control_attr.current_level,
	&dev_ctx.level_control_attr.remaining_time);

ZB_HA_DECLARE_DIMMABLE_LIGHT_CLUSTER_LIST(
	dimmable_light_clusters,
	basic_attr_list,
	identify_attr_list,
	groups_attr_list,
	scenes_attr_list,
	on_off_attr_list,
	level_control_attr_list);

ZB_HA_DECLARE_DIMMABLE_LIGHT_EP(
	dimmable_light_ep,
	HA_DIMMABLE_LIGHT_ENDPOINT,
	dimmable_light_clusters);

ZB_HA_DECLARE_DIMMABLE_LIGHT_CTX(
	bm_server_ctx,
	dimmable_light_ep);

/* Struct for benchmark message information */
typedef struct
{
	zb_ieee_addr_t ieee_dst_addr;
	zb_uint16_t src_addr;
	zb_uint16_t dst_addr;
	zb_uint16_t group_addr;
	zb_uint64_t net_time;
	zb_uint16_t number_of_hops;
	zb_uint16_t message_id;
	zb_uint8_t RSSI;
	bool data_size;
} bm_message_info;

void bm_save_message_info(bm_message_info message);
static void bm_receive_message(zb_uint8_t param);

zb_uint16_t bm_message_info_nr = 0;
char local_nodel_ieee_addr_buf[17] = {0};
int local_node_addr_len;

zb_ieee_addr_t local_node_ieee_addr;
zb_uint16_t local_node_short_addr;

/* Array of structs to save benchmark message info to */
bm_message_info message_info[NUMBER_OF_NETWORK_TIME_ELEMENTS] = {0};

/**@brief Callback for button events.
 *
 * @param[in]   button_state  Bitmask containing buttons state.
 * @param[in]   has_changed   Bitmask containing buttons
 *                            that have changed their state.
 */
static void button_changed(u32_t button_state, u32_t has_changed)
{

	/* Calculate bitmask of buttons that are pressed
	 * and have changed their state.
	 */
	u32_t buttons = button_state & has_changed;

	if (buttons & DONGLE_BUTTON)
	{
		LOG_INF("Button pressed");
	}
}

/**@brief Function for initializing additional PWM leds. */
static void pwm_led_init(void)
{
	led_pwm_dev = device_get_binding(PWM_DK_LED4_DRIVER);

	if (!led_pwm_dev)
	{
		LOG_ERR("Cannot find %s!", PWM_DK_LED4_DRIVER);
	}
}

/**@brief Function for initializing LEDs and Buttons. */
static void configure_gpio(void)
{
	int err;

	err = dk_buttons_init(button_changed);
	if (err)
	{
		LOG_ERR("Cannot init buttons (err: %d)", err);
	}

	err = dk_leds_init();
	if (err)
	{
		LOG_ERR("Cannot init LEDs (err: %d)", err);
	}

	pwm_led_init();
}

/**@brief Sets brightness of bulb luminous executive element
 *
 * @param[in] brightness_level Brightness level, allowed values 0 ... 255,
 *                             0 - turn off, 255 - full brightness.
 */
static void light_bulb_set_brightness(zb_uint8_t brightness_level)
{
	u32_t pulse = brightness_level * LED_PWM_PERIOD_US / 255U;

	if (pwm_pin_set_usec(led_pwm_dev, PWM_DK_LED4_CHANNEL,
						 LED_PWM_PERIOD_US, pulse, PWM_DK_LED4_FLAGS))
	{
		LOG_ERR("Pwm led 4 set fails:\n");
		return;
	}
}

/**@brief Function for setting the light bulb brightness.
 *
 * @param[in] new_level   Light bulb brightness value.
 */
static void level_control_set_value(zb_uint16_t new_level)
{
	LOG_INF("Set level value: %i", new_level);

	ZB_ZCL_SET_ATTRIBUTE(
		HA_DIMMABLE_LIGHT_ENDPOINT,
		ZB_ZCL_CLUSTER_ID_LEVEL_CONTROL,
		ZB_ZCL_CLUSTER_SERVER_ROLE,
		ZB_ZCL_ATTR_LEVEL_CONTROL_CURRENT_LEVEL_ID,
		(zb_uint8_t *)&new_level,
		ZB_FALSE);

	/* According to the table 7.3 of Home Automation Profile Specification
	 * v 1.2 rev 29, chapter 7.1.3.
	 */
	if (new_level == 0)
	{
		zb_uint8_t value = ZB_FALSE;

		ZB_ZCL_SET_ATTRIBUTE(
			HA_DIMMABLE_LIGHT_ENDPOINT,
			ZB_ZCL_CLUSTER_ID_ON_OFF,
			ZB_ZCL_CLUSTER_SERVER_ROLE,
			ZB_ZCL_ATTR_ON_OFF_ON_OFF_ID,
			&value,
			ZB_FALSE);
	}
	else
	{
		zb_uint8_t value = ZB_TRUE;

		ZB_ZCL_SET_ATTRIBUTE(
			HA_DIMMABLE_LIGHT_ENDPOINT,
			ZB_ZCL_CLUSTER_ID_ON_OFF,
			ZB_ZCL_CLUSTER_SERVER_ROLE,
			ZB_ZCL_ATTR_ON_OFF_ON_OFF_ID,
			&value,
			ZB_FALSE);
	}

	light_bulb_set_brightness(new_level);
}

/**@brief Function for turning ON/OFF the light bulb.
 *
 * @param[in]   on   Boolean light bulb state.
 */
static void on_off_set_value(zb_bool_t on)
{
	LOG_INF("Set ON/OFF value: %i", on);

	ZB_ZCL_SET_ATTRIBUTE(
		HA_DIMMABLE_LIGHT_ENDPOINT,
		ZB_ZCL_CLUSTER_ID_ON_OFF,
		ZB_ZCL_CLUSTER_SERVER_ROLE,
		ZB_ZCL_ATTR_ON_OFF_ON_OFF_ID,
		(zb_uint8_t *)&on,
		ZB_FALSE);

	if (on)
	{
		level_control_set_value(dev_ctx.level_control_attr.current_level);
	}
	else
	{
		light_bulb_set_brightness(0U);
	}
}

/**@brief Function for initializing all clusters attributes.
 */
static void bulb_clusters_attr_init(void)
{
	/* Basic cluster attributes data */
	dev_ctx.basic_attr.zcl_version = ZB_ZCL_VERSION;
	dev_ctx.basic_attr.app_version = BULB_INIT_BASIC_APP_VERSION;
	dev_ctx.basic_attr.stack_version = BULB_INIT_BASIC_STACK_VERSION;
	dev_ctx.basic_attr.hw_version = BULB_INIT_BASIC_HW_VERSION;

	/* Use ZB_ZCL_SET_STRING_VAL to set strings, because the first byte
	 * should contain string length without trailing zero.
	 *
	 * For example "test" string wil be encoded as:
	 *   [(0x4), 't', 'e', 's', 't']
	 */
	ZB_ZCL_SET_STRING_VAL(
		dev_ctx.basic_attr.mf_name,
		BULB_INIT_BASIC_MANUF_NAME,
		ZB_ZCL_STRING_CONST_SIZE(BULB_INIT_BASIC_MANUF_NAME));

	ZB_ZCL_SET_STRING_VAL(
		dev_ctx.basic_attr.model_id,
		BULB_INIT_BASIC_MODEL_ID,
		ZB_ZCL_STRING_CONST_SIZE(BULB_INIT_BASIC_MODEL_ID));

	ZB_ZCL_SET_STRING_VAL(
		dev_ctx.basic_attr.date_code,
		BULB_INIT_BASIC_DATE_CODE,
		ZB_ZCL_STRING_CONST_SIZE(BULB_INIT_BASIC_DATE_CODE));

	dev_ctx.basic_attr.power_source = BULB_INIT_BASIC_POWER_SOURCE;

	ZB_ZCL_SET_STRING_VAL(
		dev_ctx.basic_attr.location_id,
		BULB_INIT_BASIC_LOCATION_DESC,
		ZB_ZCL_STRING_CONST_SIZE(BULB_INIT_BASIC_LOCATION_DESC));

	dev_ctx.basic_attr.ph_env = BULB_INIT_BASIC_PH_ENV;

	/* Identify cluster attributes data. */
	dev_ctx.identify_attr.identify_time =
		ZB_ZCL_IDENTIFY_IDENTIFY_TIME_DEFAULT_VALUE;

	/* On/Off cluster attributes data. */
	dev_ctx.on_off_attr.on_off = (zb_bool_t)ZB_ZCL_ON_OFF_IS_ON;

	dev_ctx.level_control_attr.current_level =
		ZB_ZCL_LEVEL_CONTROL_LEVEL_MAX_VALUE;
	dev_ctx.level_control_attr.remaining_time =
		ZB_ZCL_LEVEL_CONTROL_REMAINING_TIME_DEFAULT_VALUE;

	ZB_ZCL_SET_ATTRIBUTE(
		HA_DIMMABLE_LIGHT_ENDPOINT,
		ZB_ZCL_CLUSTER_ID_ON_OFF,
		ZB_ZCL_CLUSTER_SERVER_ROLE,
		ZB_ZCL_ATTR_ON_OFF_ON_OFF_ID,
		(zb_uint8_t *)&dev_ctx.on_off_attr.on_off,
		ZB_FALSE);

	ZB_ZCL_SET_ATTRIBUTE(
		HA_DIMMABLE_LIGHT_ENDPOINT,
		ZB_ZCL_CLUSTER_ID_LEVEL_CONTROL,
		ZB_ZCL_CLUSTER_SERVER_ROLE,
		ZB_ZCL_ATTR_LEVEL_CONTROL_CURRENT_LEVEL_ID,
		(zb_uint8_t *)&dev_ctx.level_control_attr.current_level,
		ZB_FALSE);
}

static void add_group_id_cb(zb_bufid_t bufid)
{
	zb_get_long_address(local_node_ieee_addr);
	local_node_addr_len = ieee_addr_to_str(local_nodel_ieee_addr_buf, sizeof(local_nodel_ieee_addr_buf), local_node_ieee_addr);

	LOG_INF("Include device 0x%s, ep %d to the group 0x%x", local_nodel_ieee_addr_buf, BENCHMARK_SERVER_ENDPOINT, GROUP_ID);

	ZB_ZCL_GROUPS_SEND_ADD_GROUP_REQ(bufid,
									 local_node_ieee_addr,
									 ZB_APS_ADDR_MODE_64_ENDP_PRESENT,
									 BENCHMARK_SERVER_ENDPOINT,
									 BENCHMARK_CLIENT_ENDPOINT,
									 ZB_AF_HA_PROFILE_ID,
									 ZB_ZCL_DISABLE_DEFAULT_RESPONSE,
									 NULL,
									 GROUP_ID);
}

void bm_save_message_info(bm_message_info message)
{
	message_info[bm_message_info_nr] = message;
	bm_message_info_nr++;
}

/* TODO: Description */
static void bm_receive_message(zb_uint8_t bufid)
{
	zb_zcl_parsed_hdr_t cmd_info;
	ZB_ZCL_COPY_PARSED_HEADER(bufid, &cmd_info);

	LOG_INF("Receiving message");
	bm_message_info message;
	zb_uint8_t lqi = ZB_MAC_LQI_UNDEFINED;
	zb_uint8_t rssi = ZB_MAC_RSSI_UNDEFINED;
	zb_uint8_t addr_type;

	message.message_id = cmd_info.seq_number;
	memcpy(&message.src_addr, &(cmd_info.addr_data.common_data.source.u.short_addr), sizeof(zb_uint16_t));
	addr_type = cmd_info.addr_data.common_data.source.addr_type;

	zb_get_long_address(message.ieee_dst_addr);
	message.dst_addr = zb_address_short_by_ieee(message.ieee_dst_addr);
	message.group_addr = GROUP_ID;

	zb_zdo_get_diag_data(message.src_addr, &lqi, &rssi);
	message.RSSI = rssi;
	message.number_of_hops = 0;
	//message.data_size = ZB_TRUE;
	message.net_time = ZB_TIME_BEACON_INTERVAL_TO_MSEC(ZB_TIMER_GET());

	LOG_INF("Benchmark Packet received with ID: %d from Src Address: 0x%x to Destination 0x%x with RSSI: %d, LQI: %d, Time: %llu", message.message_id, message.src_addr, message.dst_addr, rssi, lqi, message.net_time);

	bm_save_message_info(message);
}

/**@brief Callback function for handling custom ZCL commands.
 *
 * @param[in]   bufid   Reference to Zigbee stack buffer
 *                      used to pass received data.
 */
static zb_uint8_t bm_zcl_handler(zb_bufid_t bufid)
{
	zb_zcl_parsed_hdr_t cmd_info;

	ZB_ZCL_COPY_PARSED_HEADER(bufid, &cmd_info);
	LOG_INF("%s with Endpoint ID: %hd, Cluster ID: %d", __func__, cmd_info.addr_data.common_data.dst_endpoint, cmd_info.cluster_id);

	if (cmd_info.cluster_id == ZB_ZCL_CLUSTER_ID_LEVEL_CONTROL)
	{
		ZB_SCHEDULE_APP_ALARM(bm_receive_message, bufid, 0);
	}
	else
	{
		return ZB_FALSE;
	}

	return ZB_FALSE;
}

/**@brief Callback function for handling standard ZCL commands.
 *
 * @param[in]   bufid   Reference to Zigbee stack buffer
 *                      used to pass received data.
 */
static zb_void_t zcl_device_cb(zb_bufid_t bufid)
{
	zb_uint8_t cluster_id;
	zb_uint8_t attr_id;
	zb_zcl_device_callback_param_t *device_cb_param = ZB_BUF_GET_PARAM(bufid, zb_zcl_device_callback_param_t);
	zb_zcl_device_cmd_generic_param_t *device_cb_param2 = ZB_BUF_GET_PARAM(bufid, zb_zcl_device_cmd_generic_param_t);
	device_cb_param2
	
	LOG_INF("%s id %hd", __func__, device_cb_param->device_cb_id);

	// Set default response value.
	device_cb_param->status = RET_OK;

	switch (device_cb_param->device_cb_id)
	{
	case ZB_ZCL_LEVEL_CONTROL_SET_VALUE_CB_ID:
		LOG_INF("Level control setting to %d", device_cb_param->cb_param.level_control_set_value_param.new_value);
		level_control_set_value(device_cb_param->cb_param.level_control_set_value_param.new_value);

		break;

	case ZB_ZCL_SET_ATTR_VALUE_CB_ID:
		cluster_id = device_cb_param->cb_param.set_attr_value_param.cluster_id;
		attr_id = device_cb_param->cb_param.set_attr_value_param.attr_id;

		if (cluster_id == ZB_ZCL_CLUSTER_ID_ON_OFF)
		{
			u8_t value = device_cb_param->cb_param.set_attr_value_param.values.data8;

			LOG_INF("on/off attribute setting to %hd", value);
			if (attr_id == ZB_ZCL_ATTR_ON_OFF_ON_OFF_ID)
			{
				on_off_set_value((zb_bool_t)value);
			}
		}
		else if (cluster_id == ZB_ZCL_CLUSTER_ID_LEVEL_CONTROL)
		{
			u16_t value = device_cb_param->cb_param.set_attr_value_param.values.data16;

			LOG_INF("level control attribute setting to %hd",
					value);
			if (attr_id ==
				ZB_ZCL_ATTR_LEVEL_CONTROL_CURRENT_LEVEL_ID)
			{
				level_control_set_value(value);
			}
		}
		else
		{
			// Other clusters can be processed here
			LOG_INF("Unhandled cluster attribute id: %d",
					cluster_id);
		}
		break;

	default:
		device_cb_param->status = RET_ERROR;
		break;
	}
}

/**@brief Zigbee stack event handler.
 *
 * @param[in]   bufid   Reference to the Zigbee stack buffer
 *                      used to pass signal.
 */
void zboss_signal_handler(zb_bufid_t bufid)
{
	zb_zdo_app_signal_hdr_t *sig_hndler = NULL;
	zb_zdo_app_signal_type_t sig = zb_get_app_signal(bufid, &sig_hndler);
	zb_ret_t status = ZB_GET_APP_SIGNAL_STATUS(bufid);
	zb_ret_t zb_err_code;

	/* Update network status LED. */
	zigbee_led_status_update(bufid, ZIGBEE_NETWORK_STATE_LED);

	switch (sig)
	{
	case ZB_BDB_SIGNAL_STEERING:
		ZB_ERROR_CHECK(zigbee_default_signal_handler(bufid));
		if (status == RET_OK)
		{
			/* Schedule Add Group ID request */
			zb_err_code = ZB_SCHEDULE_APP_ALARM(add_group_id_cb, bufid, MATCH_DESC_REQ_START_DELAY);
			ZB_ERROR_CHECK(zb_err_code);

			/* Read local node address */
			zb_get_long_address(local_node_ieee_addr);
			local_node_short_addr = zb_address_short_by_ieee(local_node_ieee_addr);
			local_node_addr_len = ieee_addr_to_str(local_nodel_ieee_addr_buf, sizeof(local_nodel_ieee_addr_buf), local_node_ieee_addr);
			LOG_INF("Network Steering finished with Local Node Address: Short: 0x%x, IEEE/Long: 0x%s", local_node_short_addr, local_nodel_ieee_addr_buf);
			bufid = 0; // Do not free buffer - it will be reused by find_light_bulb callback.
		}
	case ZB_BDB_SIGNAL_DEVICE_REBOOT:
		if (status == RET_OK)
		{
			/* Read local node address */
			zb_get_long_address(local_node_ieee_addr);
			local_node_short_addr = zb_address_short_by_ieee(local_node_ieee_addr);
			local_node_addr_len = ieee_addr_to_str(local_nodel_ieee_addr_buf, sizeof(local_nodel_ieee_addr_buf), local_node_ieee_addr);
			LOG_INF("Node restarted with Local Node Address: Short: 0x%x, IEEE/Long: 0x%s", local_node_short_addr, local_nodel_ieee_addr_buf);
		}
		break;
	default:

		ZB_ERROR_CHECK(zigbee_default_signal_handler(bufid));
		break;
	}

	/* All callbacks should either reuse or free passed buffers.
	 * If bufid == 0, the buffer is invalid (not passed).
	 */
	if (bufid)
	{
		zb_buf_free(bufid);
	}
}

void error(void)
{
	dk_set_leds_state(DK_ALL_LEDS_MSK, DK_NO_LEDS_MSK);

	while (true)
	{
		/* Spin forever */
		k_sleep(K_MSEC(1000));
	}
}

void bm_zigbee_init(void)
{
	/* Configure GPIOs LEDs and Buttons for Zigbee */
	configure_gpio();

	/* Erase persistent Config at startup */
	zigbee_erase_persistent_storage(ERASE_PERSISTENT_CONFIG);

	/* Register dimmer switch device context (endpoints). */
	ZB_AF_REGISTER_DEVICE_CTX(&bm_server_ctx);

	/* Register callback for handling ZCL commands. */
	ZB_AF_SET_ENDPOINT_HANDLER(BENCHMARK_SERVER_ENDPOINT, bm_zcl_handler);
	ZB_ZCL_REGISTER_DEVICE_CB(zcl_device_cb);

	bulb_clusters_attr_init();
	level_control_set_value(dev_ctx.level_control_attr.current_level);
}

void bm_zigbee_enable(void)
{
	/* Start Zigbee default thread */
	zigbee_enable();

	LOG_INF("BENCHMARK Client ready");
}
```
