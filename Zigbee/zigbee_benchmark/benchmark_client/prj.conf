## CMakeLists.txt
```
#
# Copyright (c) 2020 Nordic Semiconductor ASA
#
# SPDX-License-Identifier: LicenseRef-BSD-5-Clause-Nordic
#

#Board selection
set(BOARD nrf52840dk_nrf52840)
#set(BOARD nrf5340_dk_nrf5340_cpunet)
#set(BOARD nrf52840dongle_nrf52840)

cmake_minimum_required(VERSION 3.13.1)

find_package(Zephyr REQUIRED HINTS $ENV{ZEPHYR_BASE})

project("Light Switch")

# NORDIC SDK APP START
target_sources(app PRIVATE
  src/main.c
)
target_include_directories(app PRIVATE include)
# NORDIC SDK APP END

# Include all files in folder src
FILE(GLOB app_sources src/*.c)
target_sources(app PRIVATE ${app_sources})
```

## sample.yaml
```
sample:
  name: Zigbee Light switch
  description: Zigbee dimmable light switch based on ZBOSS stack
tests:
  zigbee.light_switch:
    build_only: true
    build_on_all: true
    platform_whitelist: nrf52840dk_nrf52840 nrf52833dk_nrf52833 nrf52840dongle_nrf52840
    tags: ci_build
```

## prj.conf
```kconfig
#
# Copyright (c) 2020 Nordic Semiconductor ASA
#
# SPDX-License-Identifier: LicenseRef-BSD-5-Clause-Nordic
#

CONFIG_NCS_SAMPLES_DEFAULTS=y

CONFIG_UART_INTERRUPT_DRIVEN=y
CONFIG_SERIAL=y
CONFIG_GPIO=y

# Make sure printk is not printing to the UART console
CONFIG_CONSOLE=y
CONFIG_UART_CONSOLE=n

CONFIG_HEAP_MEM_POOL_SIZE=2048

CONFIG_ZIGBEE=y
CONFIG_ZIGBEE_ROLE_END_DEVICE=y
CONFIG_ZIGBEE_CLI_LOG_LEVEL_INF=y

# Disable ZBOSS trace logs
CONFIG_ZBOSS_TRACE_LOG_LEVEL_OFF=y

# Enable bonding
CONFIG_NVS=y

# Enable DK LED and Buttons library
CONFIG_DK_LIBRARY=y

# This example requires more workqueue stack
CONFIG_SYSTEM_WORKQUEUE_STACK_SIZE=2048

# Enable nRF ECB driver
CONFIG_CRYPTO=y
CONFIG_CRYPTO_NRF_ECB=y

# Cryptocell is not supported through CSPRNG driver API: NCSDK-4813
CONFIG_ENTROPY_CC310=n

# Enable Shell
# CONFIG_SHELL=y

# Enable Logging in Shell
CONFIG_LOG=y
CONFIG_LOG_DEFAULT_LEVEL=3

# Enable RTT Logging
CONFIG_USE_SEGGER_RTT=y
CONFIG_RTT_CONSOLE=y
```

## src/main.c
```c
/*
 * Zigbee Benchmark Client
 * Acting as a Dimmer Light Switch
 */

#include <zephyr/types.h>
#include <zephyr.h>
#include <device.h>
#include <devicetree.h>
#include <soc.h>
#include <logging/log.h>
#include <dk_buttons_and_leds.h>
#include <drivers/gpio.h>

#include "bm_zigbee.h"

#define RUN_STATUS_LED DK_LED1		/* Node Status LED */
#define RUN_LED_BLINK_INTERVAL 1000 /* Blink Interval for the Node Status LED */

LOG_MODULE_REGISTER(app_bm_main);

void main(void)
{
	int blink_status = 0;

	LOG_INF("Starting BENCHMARK Client");

	bm_zigbee_init();

	bm_zigbee_enable();

	while (1)
	{
		dk_set_led(RUN_STATUS_LED, (++blink_status) % 2);
		k_sleep(K_MSEC(RUN_LED_BLINK_INTERVAL));
	}
}
```

## include/bm_config.h
```c
#ifndef BM_CONFIG_H
#define BM_CONFIG_H

#include "stdbool.h"
#include "stdint.h"

// Change the following to switch the Protokoll Stack and SDK
#define NRF_SDK_ZIGBEE
//#define ZEPHYR_BLE_MESH

/* =============== Time Sync ===================== */
#define isTimeMaster 0           // Node is the Master (1) or Slave (0)
extern uint32_t LSB_MAC_Address; // LSB of Randomly Static Assigned MAC Address

/* =============== Benchmark Parameters ===================== */

// Change the following to switch the Protokoll Stack and SDK
//#define BENCHMARK_SERVER                /* Node is Benchmark Server */
#define BENCHMARK_CLIENT /* Node is Benchmark Client */
//#define BENCHMARK_MASTER                /* Node is Benchmark Master */
#define BENCHMARK_DEFAULT_TIME_S 10      // Default Benchmark Time (used when no Parameter available)
#define BENCHMARK_DEFAULT_PACKETS_CNT 10 // Default Benchmark Packet Count (used when no Parameter available)

typedef struct
{
  uint16_t benchmark_time_s;
  uint16_t benchmark_packet_cnt;
  uint8_t GroupAddress;
  uint8_t Node_Id;
  uint16_t AdditionalPayloadSize;
  uint32_t DestMAC_1;                     // Zigbee Directed Destination 1
  uint32_t DestMAC_2;                     // Zigbee Directed Destination 2
  uint32_t DestMAC_3;                     // Zigbee Directed Destination 3
  bool Ack;                               // 0 = Not Acknowledged / 1 = Ack
  bool benchmark_Traffic_Generation_Mode; // 0 = Random, 1 = Sequentialy
} bm_params_t;
extern bm_params_t bm_params, bm_params_buf; // The Buffer store changes while a benchmark is active.

/* =============== Defines for Reporting ===================== */
#define NUMBER_OF_BENCHMARK_REPORT_MESSAGES 3000 /* Size of the Benchmark Reporting Array message_info */

/* =============== BLE MESH Stuff ===================== */
#define BLE_MESH_TTL 7 // Maybee optimize

/* ================= Zigbee Stuff ====================== */
#define DEFFERED_LOGGING false                        /* Activate Deffered logging. Log data is buffered and can be processed in idle via NRF_LOG_PROCESS() or flushed via NRF_LOG_FLUSH(). If set false logs will be written directly but performance is decreased */
#define ZBOSS_MAIN_LOOP_ITERATION_TIME_MARGIN_MS 1000 /* Time Margin needed because zboss can block timecheck. note this time will be added to the Stack Init Time */
#define MAX_CHILDREN 10                               /* The maximum amount of connected devices. Setting this value to 0 disables association to this device.  */

#define IEEE_CHANNEL_MASK (1l << ZIGBEE_CHANNEL) /**< Scan only one, predefined channel to find the coordinator. */
//#define IEEE_CHANNEL_MASK 0x07fff800U
#define STACK_STARTUP_MAX_DELAY 30000
#define NETWORK_FORMATION_DELAY 5000
#define DEFAULT_PAYLOAD 2
#define DUMMY_PAYLOAD 0xFE

#define BENCHMARK_INIT_BASIC_APP_VERSION 01                                   /* Version of the application software (1 byte). */
#define BENCHMARK_INIT_BASIC_STACK_VERSION 10                                 /* Version of the implementation of the Zigbee stack (1 byte). */
#define BENCHMARK_INIT_BASIC_HW_VERSION 11                                    /* Version of the hardware of the device (1 byte). */
#define BENCHMARK_INIT_BASIC_MANUF_NAME "Nordic"                              /* Manufacturer name (32 bytes). */
#define BENCHMARK_INIT_BASIC_MODEL_ID "Dimable_Light_v0.1"                    /* Model number assigned by manufacturer (32-bytes long string). */
#define BENCHMARK_INIT_BASIC_DATE_CODE "20200329"                             /* First 8 bytes specify the date of manufacturer of the device in ISO 8601 format (YYYYMMDD). The rest (8 bytes) are manufacturer specific.*/
#define BENCHMARK_INIT_BASIC_POWER_SOURCE ZB_ZCL_BASIC_POWER_SOURCE_DC_SOURCE /* Type of power sources available for the device. For possible values see section 3.2.2.2.8 of ZCL specification.*/
#define BENCHMARK_INIT_BASIC_LOCATION_DESC "Office desk"                      /* Describes the physical location of the device (16 bytes). May be modified during commisioning process.*/
#define BENCHMARK_INIT_BASIC_PH_ENV ZB_ZCL_BASIC_ENV_UNSPECIFIED

#define BENCHMARK_LEVEL_SEND_TRANSACTION_TIME 0xFFFF /**< Transition time for a single step operation in 0.1 sec units. 0xFFFF - immediate change. */

#define LIGHT_SWITCH_BUTTON_THRESHOLD ZB_TIME_ONE_SECOND                          /**< Number of beacon intervals the button should be pressed to dimm the light bulb. */
#define LIGHT_SWITCH_BUTTON_SHORT_POLL_TMO ZB_MILLISECONDS_TO_BEACON_INTERVAL(50) /**< Delay between button state checks used in order to detect button long press. */
#define LIGHT_SWITCH_BUTTON_LONG_POLL_TMO ZB_MILLISECONDS_TO_BEACON_INTERVAL(300) /**< Time after which the button state is checked again to detect button hold - the dimm command is sent again. */

#define ZIGBEE_NETWORK_STATE_LED BSP_BOARD_LED_0 /**< LED indicating that light switch successfully joind Zigbee network. */

/* Benchmark specific Definitions*/
#define BENCHMARK_CLIENT_ENDPOINT 1  /* ZCL Endpoint of the Benchmark Client */
#define BENCHMARK_SERVER_ENDPOINT 10 /* ZCL Endpoint of the Benchmark Server */
#define GROUP_ID 0xB331              /* Group ID to send Benchmark message to.*/

/* =============== Benchmark Parameters ===================== */
#define BENCHMARK_DEFAULT_TIME_S 10      // Default Benchmark Time (used when no Parameter available)
#define BENCHMARK_DEFAULT_PACKETS_CNT 10 // Default Benchmark Packet Count (used when no Parameter available)

#endif //BM_ZIGBEE_H
```

## include/bm_log.h
```c
#ifdef __cplusplus
extern "C" {
#endif

#ifndef BM_LOG_H
#define BM_LOG_H

#include "bm_config.h"

/* Struct for benchmark message information */
typedef struct
{
  uint16_t message_id;
  uint64_t net_time;
  uint64_t ack_net_time;
  uint8_t number_of_hops;
  uint8_t rssi;
  uint16_t src_addr;
  uint16_t dst_addr;
  uint16_t group_addr;
  uint16_t data_size;
} bm_message_info;

//extern bm_message_info message_info[NUMBER_OF_BENCHMARK_REPORT_MESSAGES];

/* Array of structs to save benchmark message info to */
extern bm_message_info message_info[NUMBER_OF_BENCHMARK_REPORT_MESSAGES];

void bm_log_init();

void bm_log_clear_ram();

void bm_log_append_ram(bm_message_info message);

void bm_log_save_to_flash();

uint16_t bm_log_load_from_flash();

void bm_log_clear_flash();

//void bm_clear_log();
//
//void bm_append_log(bm_message_info msginfo);

#ifdef __cplusplus
}
#endif
#endif
```

## include/bm_mem_config_custom.h
```c
#ifndef ZB_MEM_CONFIG_CUSTOM_H
#define ZB_MEM_CONFIG_CUSTOM_H 1

//#define ZB_CONFIG_ROLE_ZED
#define ZB_CONFIG_ROLE_ZR
//#define ZB_CONFIG_ROLE_ZC

/*#define ZB_CONFIG_OVERALL_NETWORK_SIZE 128*/
/*#define ZB_CONFIG_OVERALL_NETWORK_SIZE 32*/
#define ZB_CONFIG_OVERALL_NETWORK_SIZE 60

/*#define ZB_CONFIG_HIGH_TRAFFIC*/
/*#define ZB_CONFIG_MODERATE_TRAFFIC*/
/**
   Light routing and application traffic from/to that device.
 */
#define ZB_CONFIG_HIGH_TRAFFIC

/*#define ZB_CONFIG_APPLICATION_COMPLEX*/
/*#define ZB_CONFIG_APPLICATION_MODERATE*/
/**
   Simple user's application at that device: not too many relations to other devices.
 */
//#define ZB_CONFIG_APPLICATION_SIMPLE
#define ZB_CONFIG_APPLICATION_COMPLEX

/**
   @}
*/

/* Now common logic derives numerical parameters from the defined configuration. */
#include "zb_mem_config_common.h"

/* Now if you REALLY know what you do, you can study zb_mem_config_common.h and redefine some configuration parameters, like: */
#undef ZB_CONFIG_SCHEDULER_Q_SIZE
#define ZB_CONFIG_SCHEDULER_Q_SIZE 56

#undef ZB_CONFIG_IOBUF_POOL_SIZE
#define ZB_CONFIG_IOBUF_POOL_SIZE 96

#undef ZB_CONFIG_MAC_PENDING_QUEUE_SIZE
#define ZB_CONFIG_MAC_PENDING_QUEUE_SIZE (ZB_CONFIG_IOBUF_POOL_SIZE / 4)

/* Memory context definitions */
#include "zb_mem_config_context.h"

#endif /* ZB_MEM_CONFIG_CUSTOM_H */
```

## include/bm_zigbee.h
```c
#ifndef BM_ZIGBEE_H
#define BM_ZIGBEE_H

#include "zboss_api.h"
#include "zcl/zb_zcl_basic_addons.h"
#include "zcl/zb_zcl_groups_addons.h"
#include "zcl/zb_zcl_level_control_addons.h"
#include "zcl/zb_zcl_on_off_addons.h"
#include "zcl/zb_zcl_scenes_addons.h"

#define max_number_of_nodes 100

typedef struct light_switch_bulb_params_s {
  zb_uint8_t endpoint;
  zb_uint16_t short_addr;
} light_switch_bulb_params_t;

typedef struct light_switch_button_s {
  zb_bool_t in_progress;
  zb_time_t timestamp;
} light_switch_button_t;

typedef struct light_switch_ctx_s {
  light_switch_bulb_params_t bulb_params;
  light_switch_button_t button;
} light_switch_ctx_t;

/* Struct defining Benchmark Device Context structure. */
typedef struct
{
  zb_zcl_basic_attrs_ext_t basic_attr;
  zb_zcl_identify_attrs_t identify_attr;
  zb_zcl_scenes_attrs_t scenes_attr;
  zb_zcl_groups_attrs_t groups_attr;
  zb_zcl_on_off_attrs_t on_off_attr;
  zb_zcl_level_control_attrs_t level_control_attr;
} bm_client_device_ctx_t;

typedef struct
{
  uint16_t src_addr;
  uint8_t last_TID_seen;
  uint8_t TID_OverflowCnt;
} __attribute__((packed)) bm_tid_overflow_handler_t;

void bm_send_dir_message_cb(zb_bufid_t bufid, zb_uint16_t dst_addr_short, zb_uint16_t seq_num);

void bm_send_group_message_cb(zb_bufid_t bufid, zb_uint16_t seq_num);

void bm_send_message(void);

void bm_zigbee_init(void);

void bm_zigbee_enable(void);

#endif //BM_ZIGBEE_H
```

## src/app_timer.c
```c
#include <zephyr.h>
#include <device.h>
#include <logging/log.h>

void my_work_handler(struct k_work *work)
{
    LOG_INF("Test Timer Handler");
    
}

K_WORK_DEFINE(my_work, my_work_handler);

void app_timer_handler(struct k_timer *dummy)
{
    k_work_submit(&my_work);
}
K_TIMER_DEFINE(app_timer, app_timer_handler, NULL);
```

## src/bm_cli.c
```c
#include "bm_cli.h"
#include "bm_config.h"

/* Init the Parameters */
bm_params_t bm_params = {BENCHMARK_DEFAULT_TIME_S,BENCHMARK_DEFAULT_PACKETS_CNT};
bm_params_t bm_params_buf = {BENCHMARK_DEFAULT_TIME_S,BENCHMARK_DEFAULT_PACKETS_CNT};

#ifdef ZEPHYR_BLE_MESH
#include <zephyr.h>
void bm_cli_log(const char *fmt, ...) {
  // Zephyr way to Log info
  printk(fmt);
}
#elif defined NRF_SDK_Zigbee
// function is Define in header file
#endif
```

## src/bm_log.c
```c
#include "bm_log.h"
//#include "bm_cli.h"
#include "bm_config.h"
#include "bm_flash_save.h"

#include "nrf_log.h"
#include "nrf_log_ctrl.h"
#include "nrf_log_default_backends.h"

#include <string.h>

// Save the Loged Data to
bm_message_info message_info[NUMBER_OF_BENCHMARK_REPORT_MESSAGES] = {0};

uint16_t bm_message_cnt; // Count the Log Entry

void bm_log_clear_ram() {
  bm_message_cnt = 0;
  memset(message_info, 0, sizeof(message_info));
}

void bm_log_append_ram(bm_message_info message) {
  if (bm_message_cnt > sizeof(message_info) - 1) {
    NRF_LOG_INFO("Log Buffer Overflow... Ignoring Data\n");
    return;
  }
  message_info[bm_message_cnt] = message;
  bm_message_cnt++;
}

void bm_log_save_to_flash() {
  uint16_t bm_message_cnt_flash = 0;

  while (bm_message_cnt_flash < bm_message_cnt) {

    flash_write(*((Measurement *)&message_info[bm_message_cnt_flash]));
    NRF_LOG_INFO("Message write to Flash Message Number: %d", bm_message_cnt_flash);
    bm_message_cnt_flash++;
  }
  NRF_LOG_INFO("Write to Flash finished. %d data packets saved", bm_message_cnt_flash);
}

/* Callback function to read Benchmark Message Info data from Flash. */
void bm_log_load_from_flash_cb(Measurement *data) {

  message_info[bm_message_cnt] = *((bm_message_info *)data);
  bm_message_cnt++;
}

uint16_t bm_log_load_from_flash() {
  bm_message_cnt = 0;
  flash_read();
  NRF_LOG_INFO("Read data from Flash done");

  return bm_message_cnt;
}

void bm_log_clear_flash() {
  flash_delete();
  NRF_LOG_INFO("Flash Data deleted");
}

void bm_log_init() {
  flash_save_init(bm_log_load_from_flash_cb);
}
```

## src/bm_statemachine.c
```c
#include "bm_cli.h"
#include "bm_config.h"
#include "bm_radio.h"
#include "bm_rand.h"
#include "bm_timesync.h"

#ifdef ZEPHYR_BLE_MESH
#include "bm_blemesh.h"
#include <zephyr.h>
#elif defined NRF_SDK_Zigbee
#include "bm_zigbee.h"
#endif

#include "bm_statemachine.h"

// Wait for Requests to Report or Start the Timesync after Reporting Done
#define ST_IDLE 10
// Master: Broadcast Timesync Packets with Parameters for the Benchmark ---- Slave: Listen for Timesync Broadcast. Relay with random Backof Delay for other Slaves
#define ST_TIMESYNC 50
// Init the Mesh Stack till all Nodes are "comissioned" / "provisioned" or whatever it is called in the current stack... -> Stack should be ready for Benchmark
#define ST_INIT_BENCHMARK 60
/* Benchmark the Mesh Stack: Since the Zigbee stack owns the CPU all the Time, do all the work in the Timer callback.
The Benchmark does simulate a button press, which triggers the sending of a benchmark message. This is done over a Timer interrupt callback (State Transition).
The callback structure should be the same over all Mesh Stacks. The Procedure is: 
I.    Log the button press event 
II.   call the stack specific button pressed callback (bm_simulate_button_press_cb) -> this should send the benchmark message (or schedule in Zigbee)
III.  check if end of benchmark is reached (increment counter)
IV.   if no -> schedule next Timer interrupt callback (aka "button press")
V.    if yess -> change to next state*/
#define ST_BENCHMARK 70
// Save the Logged Data to Flash and Reset Device to shut down the Mesh Stack
#define ST_SAVE_FLASH 80

// Timeslots for the Sates in ms. The Timesync has to be accurate enough.
#define ST_TIMESYNC_TIME_MS 3000          // -> Optimized for 50 Nodes, 3 Channels and BLE LR125kBit
#define ST_INIT_BENCHMARK_TIME_MS 1000000 // Time required to init the Mesh Stack
// The Benchmark time is obtained by the arameters from Timesync
#define ST_SAVE_FLASH_TIME_MS 1000 // Time required to Save Log to Flash

#define ST_MARGIN_TIME_MS 5            // Margin for State Transition (Let the State Terminate)
#define ST_TIMESYNC_BACKOFF_TIME_MS 30 // Backoff time maximal for retransmitt the Timesync Packet -> Should be in good relation to Timesync Timeslot

uint8_t currentState = ST_TIMESYNC; // Init the Statemachine in the Timesync State
bool wait_for_transition = false;   // Signal that a Waiting for a Transition is active
bool transition = false;            // Signal that a Transition has occured
uint64_t st_benchmark_msg_window;   // Timewindow for a Benchmarkmessage = BenchmarkTime / BenchmarkPcktCnt

static void ST_transition_cb(void) {
  bm_cli_log("%u%u\n", (uint32_t)(synctimer_getSyncTime() >> 32), (uint32_t)synctimer_getSyncTime());                       // For Debug
  if ((currentState == ST_TIMESYNC && (bm_state_synced && !isTimeMaster)) || (currentState == ST_TIMESYNC && isTimeMaster)) // Not Synced Slave Nodes stay in Timesync State.
  {
    currentState = ST_INIT_BENCHMARK;
  } else if (currentState == ST_INIT_BENCHMARK) {
    currentState = ST_TIMESYNC;
  }
  if (!wait_for_transition) {
    bm_cli_log("ERROR: Statemachine out of Sync !!!\n");
    bm_cli_log("Please reset Device\n");
  }
  transition = true;
  bm_cli_log("Current State: %d\n", currentState);
}

void ST_TIMESYNC_fn(void) {
  uint64_t next_state_ts_us = (synctimer_getSyncTime() + ST_TIMESYNC_TIME_MS * 1000 + ST_MARGIN_TIME_MS * 1000);
  synctimer_setSyncTimeCompareInt(next_state_ts_us, ST_transition_cb);
  if (isTimeMaster) {
    bm_timesync_Publish(ST_TIMESYNC_TIME_MS, next_state_ts_us, false);
  } else {
    if (bm_timesync_Subscribe(ST_TIMESYNC_TIME_MS, ST_transition_cb)) {
      while (synctimer_getSyncTimeCompareIntTS() > (synctimer_getSyncTime() + ST_MARGIN_TIME_MS * 1000 + ST_TIMESYNC_BACKOFF_TIME_MS * 1000)) { // Check if there is Time Left for Propagating Timesync further
        bm_sleep(bm_rand_32 % ST_TIMESYNC_BACKOFF_TIME_MS);                                                                                     // Sleep from 0 till Random Backoff Time
        bm_timesync_Publish(0, synctimer_getSyncTimeCompareIntTS(), true);                                                                      // Propagate the Timesync further just once for each Channel
      }
    }
  }
  return;
}

void ST_INIT_BENCHMARK_fn(void) {
#ifdef ZEPHYR_BLE_MESH
  uint64_t next_state_ts_us = (synctimer_getSyncTime() + ST_INIT_BENCHMARK_TIME_MS * 1000 + ST_MARGIN_TIME_MS * 1000);
#elif defined NRF_SDK_Zigbee
  uint64_t next_state_ts_us = (synctimer_getSyncTime() + ST_INIT_BENCHMARK_TIME_MS * 1000 + ST_MARGIN_TIME_MS * 1000 + ZBOSS_MAIN_LOOP_ITERATION_TIME_MARGIN_MS * 1000);
#endif
  synctimer_setSyncTimeCompareInt(next_state_ts_us, ST_transition_cb);
  uint64_t start_time_ts_us = synctimer_getSyncTime(); // Get the current Timestamp
  bm_cli_log("HALLO");
#ifdef ZEPHYR_BLE_MESH
  bm_blemesh_enable(); // Will return faster than the Stack is realy ready... keep on waiting in the transition.
#elif defined NRF_SDK_Zigbee
  /* Initialize Zigbee stack. */
  bm_zigbee_init();
  /** Start Zigbee Stack. */
  bm_zigbee_enable();
  /* Zigbee or Zboss has its own RTOS Scheduler. He owns all the CPU so we let him work while we wait. 
  Note that the check for time left slows down the Zboss stack a bit. Since we are still init the stack this shouldnt be a big deal. */
  while ((synctimer_getSyncTime() - start_time_ts_us) < ST_INIT_BENCHMARK_TIME_MS * 1000) {
    zboss_main_loop_iteration();

    UNUSED_RETURN_VALUE(NRF_LOG_PROCESS());
  }
#endif
  return;
}

void ST_BENCHMARK_fn(void) {

#ifdef ZEPHYR_BLE_MESH
  uint64_t next_state_ts_us = (synctimer_getSyncTime() + bm_params.benchmark_time_s * 1e6 + ST_MARGIN_TIME_MS * 1000);
#elif defined NRF_SDK_Zigbee
  uint64_t next_state_ts_us = (synctimer_getSyncTime() + bm_params.benchmark_time_s * 1e6 + ST_MARGIN_TIME_MS * 1000 + ZBOSS_MAIN_LOOP_ITERATION_TIME_MARGIN_MS * 1000);
#endif
  synctimer_setSyncTimeCompareInt(next_state_ts_us, ST_transition_cb);
  uint64_t start_time_ts_us = synctimer_getSyncTime(); // Get the current Timestamp
  /* ========= LOG the Data ====================*/

#ifdef ZEPHYR_BLE_MESH
// The Benchmark is Timer Interrupt Driven. do Nothing here and wait for transition
#elif defined NRF_SDK_Zigbee
  /* Zigbee or Zboss has its own RTOS Scheduler. He owns all the CPU so we let him work while we wait. 
  Note that the check for time left slows down the Zboss stack a bit. Since we are still init the stack this shouldnt be a big deal. */
  while ((synctimer_getSyncTime() - start_time_ts_us) < bm_params.benchmark_time_s * 1e6) {
    zboss_main_loop_iteration();
    UNUSED_RETURN_VALUE(NRF_LOG_PROCESS());
  }
#endif
  return;
}

void ST_WAIT_FOR_TRANSITION_fn() {
  wait_for_transition = true;
  while (!(transition)) {
#ifdef ZEPHYR_BLE_MESH
    k_sleep(K_FOREVER); // Zephyr Way
#elif defined NRF_SDK_Zigbee
    __SEV();
    __WFE();
    __WFE(); // Wait for Timer Interrupt nRF5SDK Way
#endif
  }
  wait_for_transition = false;
  transition = false;
  return;
}

void bm_statemachine() {
  synctimer_init();
  synctimer_start();
  bm_rand_init();
  bm_radio_init();
  while (true) {
    transition = false;
    switch (currentState) {
    case ST_TIMESYNC:
      ST_TIMESYNC_fn();
      break;
    case ST_INIT_BENCHMARK:
      ST_INIT_BENCHMARK_fn();
      break;
    case ST_BENCHMARK:
      ST_BENCHMARK_fn();
      break;
    }
    ST_WAIT_FOR_TRANSITION_fn();
  }
}
```

## src/bm_zigbee.c
```c
/*
This file is part of Zigbee-Benchmark.

Zigbee-Benchmark is free software: you can redistribute it and/or modify
it under the terms of the GNU General Public License as published by
the Free Software Foundation, either version 3 of the License, or
(at your option) any later version.

Zigbee-Benchmark is distributed in the hope that it will be useful,
but WITHOUT ANY WARRANTY; without even the implied warranty of
MERCHANTABILITY or FITNESS FOR A PARTICULAR PURPOSE.  See the
GNU General Public License for more details.

You should have received a copy of the GNU General Public License
along with Zigbee-Benchmark. If not, see <http://www.gnu.org/licenses/>.
*/

/* AUTHOR 	   :    Cyrill Horath      */

#include "nrf_802154.h"
#include "sdk_config.h"
#include "zb_error_handler.h"
#include "zboss_api.h"
#include "zboss_api_addons.h"
#include "zigbee_helpers.h"

#include "bm_mem_config_custom.h"

#include "app_timer.h"
#include "boards.h"
#include "bsp.h"

#include "nrf_log.h"
#include "nrf_log_ctrl.h"
#include "nrf_log_default_backends.h"

#include "bm_cli.h"
#include "bm_config.h"
#include "bm_log.h"
#include "bm_rand.h"
#include "bm_simple_buttons_and_leds.h"
#include "bm_timesync.h"
#include "bm_zigbee.h"

static light_switch_ctx_t m_device_ctx;
static bm_client_device_ctx_t dev_ctx;

/* Declare attribute list for Basic cluster. */
ZB_ZCL_DECLARE_BASIC_ATTRIB_LIST_EXT(
    basic_attr_list,
    &dev_ctx.basic_attr.zcl_version,
    &dev_ctx.basic_attr.app_version,
    &dev_ctx.basic_attr.stack_version,
    &dev_ctx.basic_attr.hw_version,
    dev_ctx.basic_attr.mf_name,
    dev_ctx.basic_attr.model_id,
    dev_ctx.basic_attr.date_code,
    &dev_ctx.basic_attr.power_source,
    dev_ctx.basic_attr.location_id,
    &dev_ctx.basic_attr.ph_env,
    dev_ctx.basic_attr.sw_ver);

/* Declare attribute list for Identify cluster. */
ZB_ZCL_DECLARE_IDENTIFY_ATTRIB_LIST(identify_attr_list, &dev_ctx.identify_attr.identify_time);

/* Declare cluster list for Dimmer Switch device (Identify, Basic, Scenes, Groups, On Off, Level Control). */
/* Only clusters Identify and Basic have attributes. */
ZB_HA_DECLARE_DIMMER_SWITCH_CLUSTER_LIST(dimmer_switch_clusters,
    basic_attr_list,
    identify_attr_list);

/* Declare endpoint for Dimmer Switch device. */
ZB_HA_DECLARE_DIMMER_SWITCH_EP(dimmer_switch_ep,
    BENCHMARK_CLIENT_ENDPOINT,
    dimmer_switch_clusters);

/* Declare application's device context (list of registered endpoints) for Dimmer Switch device. */
ZBOSS_DECLARE_DEVICE_CTX_1_EP(bm_client_ctx, dimmer_switch_ep);

/************************************ Forward Declarations ***********************************************/

void bm_send_message(void);
void bm_read_message_info(zb_uint16_t dst_addr_short, zb_uint16_t tsn);

zb_uint16_t seq_num = 0;
zb_uint16_t msg_sent_cnt = 0;
zb_uint16_t rem_dev_id;

zb_ieee_addr_t local_node_ieee_addr;
zb_uint16_t local_node_short_addr;
char local_nodel_ieee_addr_buf[17] = {0};
int local_node_addr_len;

zb_uint32_t stack_enable_max_delay_ms = STACK_STARTUP_MAX_DELAY;
zb_uint32_t network_formation_delay = NETWORK_FORMATION_DELAY;
zb_uint16_t def_payload_size = DEFAULT_PAYLOAD;

/************************************ Benchmark Client Cluster Attribute Init ***********************************************/

/**@brief Function for initializing all clusters attributes.
 */
static void bm_client_clusters_attr_init(void) {
  /* Basic cluster attributes data */
  dev_ctx.basic_attr.zcl_version = ZB_ZCL_VERSION;
  dev_ctx.basic_attr.app_version = BENCHMARK_INIT_BASIC_APP_VERSION;
  dev_ctx.basic_attr.stack_version = BENCHMARK_INIT_BASIC_STACK_VERSION;
  dev_ctx.basic_attr.hw_version = BENCHMARK_INIT_BASIC_HW_VERSION;

  ZB_ZCL_SET_STRING_VAL(
      dev_ctx.basic_attr.mf_name,
      BENCHMARK_INIT_BASIC_MANUF_NAME,
      ZB_ZCL_STRING_CONST_SIZE(BENCHMARK_INIT_BASIC_MANUF_NAME));

  ZB_ZCL_SET_STRING_VAL(
      dev_ctx.basic_attr.model_id,
      BENCHMARK_INIT_BASIC_MODEL_ID,
      ZB_ZCL_STRING_CONST_SIZE(BENCHMARK_INIT_BASIC_MODEL_ID));

  ZB_ZCL_SET_STRING_VAL(
      dev_ctx.basic_attr.date_code,
      BENCHMARK_INIT_BASIC_DATE_CODE,
      ZB_ZCL_STRING_CONST_SIZE(BENCHMARK_INIT_BASIC_DATE_CODE));

  dev_ctx.basic_attr.power_source = BENCHMARK_INIT_BASIC_POWER_SOURCE;

  ZB_ZCL_SET_STRING_VAL(
      dev_ctx.basic_attr.location_id,
      BENCHMARK_INIT_BASIC_LOCATION_DESC,
      ZB_ZCL_STRING_CONST_SIZE(BENCHMARK_INIT_BASIC_LOCATION_DESC));

  dev_ctx.basic_attr.ph_env = BENCHMARK_INIT_BASIC_PH_ENV;

  /* Identify cluster attributes data. */
  dev_ctx.identify_attr.identify_time =
      ZB_ZCL_IDENTIFY_IDENTIFY_TIME_DEFAULT_VALUE;

  /* On/Off cluster attributes data. */
  dev_ctx.on_off_attr.on_off = (zb_bool_t)ZB_ZCL_ON_OFF_IS_ON;

  dev_ctx.level_control_attr.current_level =
      ZB_ZCL_LEVEL_CONTROL_LEVEL_MAX_VALUE;
  dev_ctx.level_control_attr.remaining_time =
      ZB_ZCL_LEVEL_CONTROL_REMAINING_TIME_DEFAULT_VALUE;
}

/************************************ General Init Functions ***********************************************/

/**@brief Function for the Timer initialization.
 *
 * @details Initializes the timer module. This creates and starts application timers.
 */
static void timers_init(void) {
  ret_code_t err_code;

  // Initialize timer module.
  err_code = app_timer_init();
  APP_ERROR_CHECK(err_code);
}

/* Get device address of the local device.*/
void bm_get_ieee_eui64(zb_ieee_addr_t ieee_eui64) {
  uint64_t factoryAddress;
  factoryAddress = NRF_FICR->DEVICEADDR[0];
  memcpy(ieee_eui64, &factoryAddress, sizeof(factoryAddress));
}

/************************************ Benchmark Functions ***********************************************/

/* Callback function for Benchmark send message status. Free's the used buffer. */
void bm_send_message_status_cb(zb_bufid_t bufid) {
  zb_zcl_command_send_status_t *send_cmd_status = ZB_BUF_GET_PARAM(bufid, zb_zcl_command_send_status_t);
  msg_sent_cnt++;
  bm_cli_log("Message successfully sent: %d, Status Code: %d\n", msg_sent_cnt, send_cmd_status->status);

  if (bufid) {
    zb_buf_free(bufid);
  }
}

/* Function to send Benchmark Message to group destination. */
void bm_send_group_message_cb(zb_bufid_t bufid, zb_uint16_t seq_num) {
  zb_uint16_t groupID = bm_params.GroupAddress + GROUP_ID;
  bm_cli_log("Benchmark send message cb group: 0x%x, Seq Num: %d\n", groupID, seq_num);

  /* Send Move to level request. Added manufacturer specific field in ZCL Header to transmit 16 Bit Benchmark sequence number. */
  zb_uint8_t *cmd_ptr = ZB_ZCL_START_PACKET(bufid);
  ZB_ZCL_CONSTRUCT_GENERAL_COMMAND_REQ_FRAME_CONTROL_A(cmd_ptr, (ZB_ZCL_FRAME_DIRECTION_TO_SRV), (ZB_ZCL_MANUFACTURER_SPECIFIC), ZB_ZCL_DISABLE_DEFAULT_RESPONSE);
  ZB_ZCL_CONSTRUCT_COMMAND_HEADER_EXT(cmd_ptr, ZB_ZCL_GET_SEQ_NUM(), (ZB_TRUE), seq_num, (bm_params.AdditionalPayloadSize));
  /* Minimal Payload size defined as 2 Bytes. */
  ZB_ZCL_PACKET_PUT_DATA8(cmd_ptr, (DUMMY_PAYLOAD));
  ZB_ZCL_PACKET_PUT_DATA8(cmd_ptr, (DUMMY_PAYLOAD));
  /* Additional Payload added as 8 Bit Dummy Payload Packets. */
  for (zb_uint8_t i = 0; i < bm_params.AdditionalPayloadSize; i++) {
    ZB_ZCL_PACKET_PUT_DATA8(cmd_ptr, (DUMMY_PAYLOAD));
  }
  ZB_ZCL_FINISH_PACKET(bufid, cmd_ptr)
  ZB_ZCL_SEND_COMMAND_SHORT(bufid, groupID, ZB_APS_ADDR_MODE_16_GROUP_ENDP_NOT_PRESENT, BENCHMARK_SERVER_ENDPOINT, BENCHMARK_CLIENT_ENDPOINT, ZB_AF_HA_PROFILE_ID, ZB_ZCL_CLUSTER_ID_LEVEL_CONTROL, bm_send_message_status_cb);
}

/* Callback function to send direct Benchmark Message.*/
void bm_send_dir_message_cb(zb_bufid_t bufid, zb_uint16_t dst_addr_short, zb_uint16_t seq_num) {
  bm_cli_log("Benchmark send message cb dst: 0x%x, Bufid: %d, Seq Num: %d\n", dst_addr_short, bufid, seq_num);

  /* Send Move to level request. Added manufacturer specific field in ZCL Header to transmit 16 Bit Benchmark sequence number. */
  zb_uint8_t *cmd_ptr = ZB_ZCL_START_PACKET(bufid);
  ZB_ZCL_CONSTRUCT_GENERAL_COMMAND_REQ_FRAME_CONTROL_A(cmd_ptr, (ZB_ZCL_FRAME_DIRECTION_TO_SRV), (ZB_ZCL_MANUFACTURER_SPECIFIC), ZB_ZCL_DISABLE_DEFAULT_RESPONSE);
  ZB_ZCL_CONSTRUCT_COMMAND_HEADER_EXT(cmd_ptr, ZB_ZCL_GET_SEQ_NUM(), (ZB_TRUE), seq_num, (ZB_ZCL_CMD_LEVEL_CONTROL_MOVE_TO_LEVEL));
  /* Minimal Payload size defined as 2 Bytes. */
  ZB_ZCL_PACKET_PUT_DATA8(cmd_ptr, (DUMMY_PAYLOAD));
  ZB_ZCL_PACKET_PUT_DATA8(cmd_ptr, (DUMMY_PAYLOAD));
  /* Additional Payload added as 8 Bit Dummy Payload Packets. */
  for (zb_uint8_t i = 0; i < bm_params.AdditionalPayloadSize; i++) {
    ZB_ZCL_PACKET_PUT_DATA8(cmd_ptr, (DUMMY_PAYLOAD));
  }
  ZB_ZCL_FINISH_PACKET(bufid, cmd_ptr)
  ZB_ZCL_SEND_COMMAND_SHORT(bufid, dst_addr_short, ZB_APS_ADDR_MODE_16_ENDP_PRESENT, BENCHMARK_SERVER_ENDPOINT, BENCHMARK_CLIENT_ENDPOINT, ZB_AF_HA_PROFILE_ID, ZB_ZCL_CLUSTER_ID_LEVEL_CONTROL, bm_send_message_status_cb);
}

/* Benchmark send message function. Function will be called from BENCHMARK state in bm_statemachine.c */
void bm_send_message(void) {
  zb_ret_t zb_err_code;
  zb_bufid_t bufid;
  zb_uint16_t dst_addr_short;
  uint64_t dst_addr_conf[3] = {bm_params.DestMAC_1, bm_params.DestMAC_2, bm_params.DestMAC_3};
  zb_ieee_addr_t dst_ieee_addr;
  char ieee_addr_buf[17] = {0};
  int addr_len;
  seq_num++;

  /* Check directional mac address fields in config message whether there is any address defined.
  If not, call bm_send_group_message_cb for group addressing. */
  if ((dst_addr_conf[0] == 0) && (dst_addr_conf[1] == 0) && (dst_addr_conf[2] == 0)) {
    bm_cli_log("Benchmark send message to group address: 0x%x\n", bm_params.GroupAddress + GROUP_ID);
    bm_read_message_info(dst_addr_short, seq_num);
    zb_err_code = zb_buf_get_out_delayed_ext(bm_send_group_message_cb, seq_num, 0);
    ZB_ERROR_CHECK(zb_err_code);

  } else {
    for (uint8_t i = 0; i < 3; i++) {
      memcpy(dst_ieee_addr, &dst_addr_conf[i], sizeof(dst_addr_conf[i]));
      if (dst_addr_conf[i]) {
        dst_addr_short = zb_address_short_by_ieee(dst_ieee_addr);
        if (dst_addr_short != 0xFFFF) {
          addr_len = ieee_addr_to_str(ieee_addr_buf, sizeof(ieee_addr_buf), dst_ieee_addr);
          bm_cli_log("Benchmark send direct message to address: 0x%x, Index: %d\n", dst_addr_short, i);
          bm_read_message_info(dst_addr_short, seq_num);
          bufid = zb_buf_get_out();
          bm_send_dir_message_cb(bufid, dst_addr_short, seq_num);
        } else {
          bm_cli_log("Error read short address of destination\n");
        }
      }
    }
  }
}

/* Benchmark read message info function. Reads Benchmark data from message.*/
void bm_read_message_info(zb_uint16_t dst_addr_short, zb_uint16_t tsn) {
  bm_message_info message;
  zb_ieee_addr_t ieee_src_addr;
  zb_bool_t led_toggle;

  message.number_of_hops = 0;                                             /* TODO: Number of hops is not yet available from the ZBOSS API */
  message.data_size = bm_params.AdditionalPayloadSize + def_payload_size; /* Payload Size is default payload size plus additional payload size from config message. */
  message.rssi = 0;
  message.ack_net_time = 0;

  zb_get_long_address(ieee_src_addr);
  message.src_addr = zb_address_short_by_ieee(ieee_src_addr);
  message.group_addr = bm_params.GroupAddress + GROUP_ID;
  message.dst_addr = message.group_addr;

  message.message_id = tsn;
  message.net_time = synctimer_getSyncTime();

  bm_cli_log("Benchmark read message data: Destination Address: 0x%x TimeStamp: %lld, MessageID: %d (%d)\n", message.dst_addr, message.net_time, message.message_id, seq_num);
  bm_log_append_ram(message);

  /* Toggle blue LED to indicate  */
  led_toggle = (zb_bool_t)seq_num % 2;
  if (led_toggle) {
    bm_led2_set(true);
  } else {
    bm_led2_set(false);
  }
}

/************************************ Zigbee event handler ***********************************************/

/**@brief Callback function for handling ZCL commands.
 *
 * @param[in]   bufid   Reference to Zigbee stack buffer
 *                      used to pass received data.
 */
static zb_void_t zcl_device_cb(zb_bufid_t bufid) {
  zb_zcl_device_callback_param_t *device_cb_param = ZB_BUF_GET_PARAM(bufid, zb_zcl_device_callback_param_t);
  bm_cli_log("%s id %hd\n", __func__, device_cb_param->device_cb_id);

  /* Set default response value. */
  device_cb_param->status = RET_OK;
}

/************************************ ZBOSS signal handler ***********************************************/
/**@brief Zigbee stack event handler.
 *
 * @param[in]   bufid   Reference to the Zigbee stack buffer used to pass signal.
 */
void zboss_signal_handler(zb_bufid_t bufid) {
  zb_zdo_app_signal_hdr_t *p_sg_p = NULL;
  zb_zdo_app_signal_type_t sig = zb_get_app_signal(bufid, &p_sg_p);
  zb_ret_t status = ZB_GET_APP_SIGNAL_STATUS(bufid);
  zb_ret_t zb_err_code;
  zb_uint32_t active_channel_msk;
  uint8_t active_channel;

  /* Update network status LED */
  zigbee_led_status_update(bufid, ZIGBEE_NETWORK_STATE_LED);

  switch (sig) {
  case ZB_BDB_SIGNAL_STEERING:
    /* Call default signal handler. */
    ZB_ERROR_CHECK(zigbee_default_signal_handler(bufid));
    bm_cli_log("Zigbee Network Steering\n");
    bm_cli_log("Active channel %d\n", nrf_802154_channel_get());

    if (status == RET_OK) {
      /* Read local node address */
      zb_get_long_address(local_node_ieee_addr);
      local_node_short_addr = zb_address_short_by_ieee(local_node_ieee_addr);
      local_node_addr_len = ieee_addr_to_str(local_nodel_ieee_addr_buf, sizeof(local_nodel_ieee_addr_buf), local_node_ieee_addr);
      bm_cli_log("Network Steering finished with Local Node Address: Short: 0x%x, IEEE/Long: 0x%s\n", local_node_short_addr, local_nodel_ieee_addr_buf);
    }
    break;
  case ZB_ZDO_SIGNAL_DEVICE_ANNCE:
    ZB_ERROR_CHECK(zigbee_default_signal_handler(bufid)); /* Call default signal handler. */

    zb_zdo_signal_device_annce_params_t *dev_annce_params = ZB_ZDO_SIGNAL_GET_PARAMS(p_sg_p, zb_zdo_signal_device_annce_params_t);
    rem_dev_id = dev_annce_params->device_short_addr;
    bm_cli_log("New device commissioned or rejoined (short: 0x%04hx)\n", dev_annce_params->device_short_addr);
    break;

  default:
    /* Call default signal handler. */
    ZB_ERROR_CHECK(zigbee_default_signal_handler(bufid));
    break;
  }
  if (bufid) {
    zb_buf_free(bufid);
  }
}

/**************************************** Zigbee Stack Init and Enable ***********************************************/

/** Init Zigbee Stack. */
void bm_zigbee_init(void) {
  zb_ret_t zb_err_code;
  zb_ieee_addr_t ieee_addr;

  /* Initialize timers. */
  timers_init();

  /* Set Zigbee stack logging level and traffic dump subsystem. */
  ZB_SET_TRACE_LEVEL(ZIGBEE_TRACE_LEVEL);
  ZB_SET_TRACE_MASK(ZIGBEE_TRACE_MASK);
  ZB_SET_TRAF_DUMP_OFF();

  /* Initialize Zigbee stack. */
  ZB_INIT("Benchmark Client");

  /* Set device address to the value read from FICR registers. */
  bm_get_ieee_eui64(ieee_addr);
  zb_set_long_address(ieee_addr);

  zb_set_network_router_role(IEEE_CHANNEL_MASK);
  zb_set_max_children(MAX_CHILDREN);

  /* Erase persistent config of the device if ACK Param in config message is set true. Else delete persistent storage at startup. */
  zigbee_erase_persistent_storage(bm_params.Ack);

  /* Initialize application context structure. */
  UNUSED_RETURN_VALUE(ZB_MEMSET(&m_device_ctx, 0, sizeof(light_switch_ctx_t)));

  /* Register dimmer switch device context (endpoints). */
  ZB_AF_REGISTER_DEVICE_CTX(&bm_client_ctx);

  /* Register callback for handling ZCL commands. */
  ZB_ZCL_REGISTER_DEVICE_CB(zcl_device_cb);

  /* Initialize Cluster Attributes */
  bm_client_clusters_attr_init();
}

/** Start Zigbee Stack. */
void bm_zigbee_enable(void) {
  zb_ret_t zb_err_code;
  zb_uint16_t stack_enable_delay_ms = (bm_rand_32 % stack_enable_max_delay_ms) + network_formation_delay;

  /* Stack Enable Timeout to prevent crash at stack startup in order of too many simultaneous commissioning requests. */
  bm_cli_log("Zigbee Stack starts in: %d milliseconds\n", stack_enable_delay_ms);
  bm_sleep(stack_enable_delay_ms);
  zb_err_code = zboss_start_no_autostart();
  ZB_ERROR_CHECK(zb_err_code);
  bm_led2_set(true);
  bm_cli_log("BENCHMARK Client ready\n");
}
```
