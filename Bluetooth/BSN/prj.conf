## CMakeLists.txt
```
#
# Copyright (c) 2019 Nordic Semiconductor ASA
#
# SPDX-License-Identifier: LicenseRef-BSD-5-Clause-Nordic
#
cmake_minimum_required(VERSION 3.8.2)

#Board selection
set(BOARD nrf52840dk_nrf52840)
#set(BOARD nrf5340pdk_nrf5340_cpunet)
#set(BOARD nrf5340pdk_nrf5340_cpuapp)
#set(BOARD nrf52840dongle_nrf52840)

find_package(Zephyr REQUIRED HINTS $ENV{ZEPHYR_BASE})
project(NONE)

# Include all files in folder src
FILE(GLOB app_sources_c src/*.c)
FILE(GLOB app_sources_cpp src/*.cpp)

FILE(GLOB shared_sources_c ../../SharedLib/*.c)
FILE(GLOB shared_sources_cpp ../../SharedLib/*.cpp)

target_sources(app PRIVATE
	${app_sources_c}
	${app_sources_cpp}
	${shared_sources_c}
	${shared_sources_cpp})
target_include_directories(app PRIVATE include ../../SharedLib)
```

## prj.conf
```kconfig
#
# Copyright (c) 2019 Nordic Semiconductor ASA
#
# SPDX-License-Identifier: LicenseRef-BSD-5-Clause-Nordic
#
CONFIG_NCS_SAMPLES_DEFAULTS=y

# General configuration
CONFIG_MAIN_STACK_SIZE=4096
CONFIG_SYSTEM_WORKQUEUE_STACK_SIZE=4096
CONFIG_FLASH=y
CONFIG_FLASH_MAP=y
CONFIG_FCB=y
CONFIG_SETTINGS=y
CONFIG_HWINFO=y
CONFIG_LOG=y
CONFIG_LOG_MINIMAL=y
CONFIG_LOG_PRINTK=y

# For UART Log
CONFIG_SHELL=y
CONFIG_UART_CONSOLE=y
#CONFIG_LOG_BACKEND_RTT=y

#CONFIG_LOG=y
#CONFIG_SERIAL=y
#CONFIG_STDOUT_CONSOLE=y
#CONFIG_UART_INTERRUPT_DRIVEN=y
#CONFIG_PRINTK=y
#CONFIG_CONSOLE=y
#CONFIG_DK_LIBRARY=y
#CONFIG_BT_MESH_DK_PROV=n

# Bluetooth configuration
CONFIG_BT=y
CONFIG_BT_COMPANY_ID=0x0059
CONFIG_BT_DEVICE_NAME="BSN BT"
CONFIG_BT_L2CAP_RX_MTU=69
CONFIG_BT_L2CAP_TX_MTU=69
CONFIG_BT_L2CAP_TX_BUF_COUNT=8
CONFIG_BT_LL_SW_SPLIT=y
CONFIG_BT_OBSERVER=y
CONFIG_BT_PERIPHERAL=y
CONFIG_BT_SETTINGS=y
CONFIG_BT_DEBUG_LOG=y
CONFIG_BT_LL_SW_SPLIT=y
#CONFIG_BT_LLL_VENDOR_NORDIC=y
#CONFIG_BT_DEBUG_HCI_CORE=y

# Disable unused Bluetooth features
CONFIG_BT_CTLR_DUP_FILTER_LEN=0
CONFIG_BT_CTLR_LE_ENC=n
CONFIG_BT_DATA_LEN_UPDATE=n
CONFIG_BT_PHY_UPDATE=n
CONFIG_BT_CTLR_CHAN_SEL_2=n
CONFIG_BT_CTLR_MIN_USED_CHAN=n
CONFIG_BT_CTLR_PRIVACY=n

CONFIG_BT_CTLR_ADVANCED_FEATURES=y

CONFIG_BT_HCI_TX_STACK_SIZE=1024
#CONFIG_NO_OPTIMIZATIONS=y

#CONFIG_BT_CTLR_TX_BUFFER_SIZE=74
#CONFIG_BT_CTLR_DATA_LENGTH_MAX=74

# Bluetooth Mesh configuration
CONFIG_BT_MESH=y
CONFIG_BT_MESH_RELAY=y
CONFIG_BT_MESH_FRIEND=y
CONFIG_BT_MESH_LOW_POWER=n
CONFIG_BT_MESH_LPN_AUTO=n
CONFIG_BT_MESH_LPN_ESTABLISHMENT=n
#LPN Nodes Count bound to a Friend
CONFIG_BT_MESH_FRIEND_LPN_COUNT=5
CONFIG_BT_MESH_FRIEND_SEG_RX=5
#Must be at least tree times CONFIG_BT_MESH_TX_SEG_MAX Def = 30
CONFIG_BT_MESH_ADV_BUF_COUNT=96
# Default 10 -> Max Message Segments = 32 (32 * 12 = 432 - 8 = 424)
CONFIG_BT_MESH_TX_SEG_MAX=32
# Default 10 -> Max Message Segments = 32 (32 * 12 = 432 - 8 = 424)
CONFIG_BT_MESH_RX_SEG_MAX=32
CONFIG_BT_MESH_TX_SEG_MSG_COUNT=10
# Buffer to Store Incoming and Outgoing Segments (Each Buffer is 12Byte)
CONFIG_BT_MESH_SEG_BUFS=255 
# Replay Protection List Size (Equal to number of NOdes Excpected)
CONFIG_BT_MESH_CRPL=150
# Repay Cache Size (Equal to number of NOdes Excpected)
CONFIG_BT_MESH_MSG_CACHE_SIZE=150
CONFIG_BT_MESH_PB_GATT=n
CONFIG_BT_MESH_GATT_PROXY=n
CONFIG_BT_MESH_DEBUG=y
CONFIG_BT_MESH_DEBUG_FRIEND=n
CONFIG_BT_MESH_DEBUG_LOW_POWER=n
#CONFIG_BT_MESH_DEBUG_CRYPTO=y
#CONFIG_BT_MESH_DEBUG_TRANS=y
#CONFIG_BT_MESH_DEBUG_NET=y
#CONFIG_BT_MESH_DEBUG_ADV=y


# Bluetooth Mesh models
CONFIG_BT_MESH_ONOFF_CLI=y
CONFIG_BT_MESH_ONOFF_SRV=y
CONFIG_BT_MESH_CFG_CLI=y

# Other Peripherals
CONFIG_NRFX_TIMER=y
CONFIG_NRFX_TIMER4=y

# Flash 
CONFIG_FLASH=y
CONFIG_FLASH_PAGE_LAYOUT=y
CONFIG_MPU_ALLOW_FLASH_WRITE=y
CONFIG_SOC_FLASH_NRF_EMULATE_ONE_BYTE_WRITE_ACCESS=y

#Experimantal Settings
#CONFIG_DYNAMIC_INTERRUPTS=y
#CONFIG_ENTROPY_GENERATOR=y
#CONFIG_ENTROPY_DEVICE_RANDOM_GENERATOR=y
```

## src/main.c
```c
#include "bm_config.h"
#include "bm_cli.h"
#include "bm_statemachine.h"


#ifdef NRF_SDK_Zigbee
#include "nrf_log.h"
#include "nrf_log_ctrl.h"
#include "nrf_log_default_backends.h"
#endif

uint32_t LSB_MAC_Address;

/**@brief Function for application main entry.
 */
void main(void) {

 #ifdef NRF_SDK_Zigbee
  // Init the LOG Modul
  // To Enable Loging before the Mesh stack is run change in sdk_config -> NRF_LOG_DEFERRED = 0 (Performance is worse but logging is possibel)
  bm_cli_log_init(); /* Initialize the Zigbee LOG subsystem */
 #endif


  // Init MAC Address
  LSB_MAC_Address = NRF_FICR->DEVICEADDR[1];
  bm_cli_log("Preprogrammed Randomly Static MAC-Address (LSB): %x\n", LSB_MAC_Address);
  

  // Start Benchmark
  bm_cli_log("Starting Benchmark...\n");
  bm_statemachine();

}
```

## include/Timer_sync.h
```c
#ifdef __cplusplus
extern "C" {
#endif

#ifndef TIMER_SYNC_H
#define TIMER_SYNC_H

#include <stdlib.h>
#include <string.h>
#include <zephyr.h>

#include <nrfx_timer.h>
#include <hal/nrf_radio.h>

#if defined(DPPI_PRESENT) || defined(__NRFX_DOXYGEN__)
#include <nrfx_dppi.h>
#else
#include <nrfx_ppi.h>
/** PreDefined PPI Channel from RADIO->EVENTS_END */
#define nRF52_PreDefinedPPICH_Tx NRF_PPI_CHANNEL27
/** PreDefined PPI Channel from RADIO->EVENTS_ADDRESS */
#define nRF52_PreDefinedPPICH_Rx NRF_PPI_CHANNEL26
#endif // defined(DPPI_PRESENT) || defined(__NRFX_DOXYGEN__)

/* Timer used for Synchronisation */
extern nrfx_timer_t synctimer;
extern uint32_t Timestamp_Slave;
extern uint32_t Timestamp_Master;
extern uint32_t Timestamp_Diff;

/**
* Init the Sync Timer
*
*/
extern void synctimer_init();

/**
* Timestamp Capture clear
*
*/
extern void synctimer_TimeStampCapture_clear();

/**
* Timestamp Capture enable
*
*/
extern void synctimer_TimeStampCapture_enable();
/**
* Timestamp Capture disable
*
*/
extern void synctimer_TimeStampCapture_disable();


/**
* Clears and starts the timer
*/
extern void synctimer_start();

/**
* Stops and clears the timer
*/
extern void synctimer_stop();
/**
* Get previous Tx sync timestamp
*
* @return Latest Tx Timestamp
*/
extern uint32_t synctimer_getTxTimeStamp();
/**
* Get previous Rx sync timestamp
*
* @return Latest Rx Timestamp
*/
extern uint32_t synctimer_getRxTimeStamp();
/**
* Synchronise the timer with the received offset Timestamp
*
* @param TxMasterTimeStamp Latest 
*/
extern void synctimer_setSync(uint32_t TxMasterTimeStamp);
/**
* Get Synchronised Timestamp
*
* @return Synchronised Timestamp
*/
extern uint32_t synctimer_getSyncTime();

extern void config_debug_ppi_and_gpiote_radio_state();

#endif

#ifdef __cplusplus
}
#endif
```

## include/bm_blemesh.h
```c
#ifndef BM_BLEMESH_H
#define BM_BLEMESH_H

extern u16_t addr;

/* Init and enable the BLE Mesh Stack 
* 
*	Does Self Provisioning
*/
void bm_blemesh_enable(void);

#endif
```

## include/bm_blemesh_model_handler.h
```c
/*
This file is part of Bluetooth-Benchamrk.

Bluetooth-Benchamrk is free software: you can redistribute it and/or modify
it under the terms of the GNU General Public License as published by
the Free Software Foundation, either version 3 of the License, or
(at your option) any later version.

Bluetooth-Benchamrk is distributed in the hope that it will be useful,
but WITHOUT ANY WARRANTY; without even the implied warranty of
MERCHANTABILITY or FITNESS FOR A PARTICULAR PURPOSE.  See the
GNU General Public License for more details.

You should have received a copy of the GNU General Public License
along with Bluetooth-Benchamrk.  If not, see <http://www.gnu.org/licenses/>.
*/

/* AUTHOR 	 :    Raffael Anklin       */

#ifndef MODEL_HANDLER_H__
#define MODEL_HANDLER_H__

#include "bm_config.h"

#ifdef __cplusplus
extern "C" {
#endif



const struct bt_mesh_comp *bm_blemesh_model_handler_init(void);

/* Trigger the Sending of a Message */
void bm_send_message();

#ifdef __cplusplus
}
#endif

#endif /* MODEL_HANDLER_H__ */
```

## include/bm_cli.h
```c
#ifdef __cplusplus
extern "C" {
#endif

#ifndef BM_CLI_H
#define BM_CLI_H

#include "bm_config.h"

#ifdef ZEPHYR_BLE_MESH
#include <zephyr.h>
// Global Printing Function for Printing Log Info
void bm_cli_log(const char *fmt, ...);
#elif defined NRF_SDK_Zigbee
#include "nrf_log.h"
#include "nrf_log_ctrl.h"
#define bm_cli_log(...)                      NRF_LOG_INFO( __VA_ARGS__)
#endif

// Init th CLI Commands for the Master
#ifdef BENCHMARK_MASTER
#ifdef ZEPHYR_BLE_MESH
typedef struct {
    bool req; // Is true if a cli command was received 
    uint32_t MAC;
} bm_cli_cmd_getNodeReport_t;
extern bm_cli_cmd_getNodeReport_t bm_cli_cmd_getNodeReport;
typedef struct {
    bool req; // Is true if a cli command was received 
    uint32_t MAC;
    uint8_t GroupAddress;
} bm_cli_cmd_setNodeSettings_t;
extern bm_cli_cmd_setNodeSettings_t bm_cli_cmd_setNodeSettings;
typedef struct {
    bool req; // Is true if a cli command was received 
    uint16_t benchmark_time_s;
    uint16_t benchmark_packet_cnt;
} bm_cli_cmd_startBM_t;
extern bm_cli_cmd_startBM_t bm_cli_cmd_startBM;
#elif defined NRF_SDK_Zigbee
#include "nrf_log.h"
#include "nrf_log_ctrl.h"
#define bm_cli_log(...)                      NRF_LOG_INFO( __VA_ARGS__)
#endif
#endif






#ifdef __cplusplus
}
#endif
#endif
```

## include/bm_config.h
```c
#ifdef __cplusplus
extern "C" {
#endif

#ifndef BM_CONFIG_H
#define BM_CONFIG_H

#include <stdint.h>
#include <stdbool.h>

// Change the following to switch the Protokoll Stack and SDK
//#define NRF_SDK_Zigbee
#define ZEPHYR_BLE_MESH

/* =============== Time Sync ===================== */
extern uint32_t LSB_MAC_Address; // LSB of Randomly Static Assigned MAC Address

/* =============== Benchmark Parameters ===================== */
// Change the following to switch the Protokoll Stack and SDK
#define BENCHMARK_SERVER                 /* Node is Benchmark Server */
//#define BENCHMARK_CLIENT                 /* Node is Benchmark Client */
//#define BENCHMARK_MASTER                 /* Node is Benchmark Master and automatically Time Master */
#define BENCHMARK_DEFAULT_TIME_S 10      // Default Benchmark Time (used when no Parameter available)
#define BENCHMARK_DEFAULT_PACKETS_CNT 10 // Default Benchmark Packet Count (used when no Parameter available)

typedef struct
{
  uint16_t benchmark_time_s;
  uint16_t benchmark_packet_cnt;
  uint8_t GroupAddress;
  uint8_t Node_Id;
  uint16_t AdditionalPayloadSize;
  uint32_t DestMAC_1; // Zigbee Directed Destination 1
  uint32_t DestMAC_2; // Zigbee Directed Destination 2
  uint32_t DestMAC_3; // Zigbee Directed Destination 3
  bool Ack; // 0 = Not Acknowledged / 1 = Ack
  bool benchmark_Traffic_Generation_Mode; // 0 = Random, 1 = Sequentialy
} bm_params_t;
extern bm_params_t bm_params, bm_params_buf; // The Buffer store changes while a benchmark is active. 

/* =============== Defines for Reporting ===================== */
#define NUMBER_OF_BENCHMARK_REPORT_MESSAGES 3000 /* Size of the Benchmark Reporting Array message_info */

/* =============== BLE MESH Stuff ===================== */
#define BLE_MESH_TTL 7 // Maybee optimize

/* ================= Zigbee Stuff ====================== */
#define ZBOSS_MAIN_LOOP_ITERATION_TIME_MARGIN_MS 1000 // Time Margin needed because zboss can block timecheck. note this time will be added to the Stack Init Time

#define MAX_CHILDREN 10                          /**< The maximum amount of connected devices. Setting this value to 0 disables association to this device.  */
#define IEEE_CHANNEL_MASK (1l << ZIGBEE_CHANNEL) /**< Scan only one, predefined channel to find the coordinator. */
//#define IEEE_CHANNEL_MASK                 0x07fff800U
#define HA_DIMMABLE_LIGHT_ENDPOINT 10    /**< Device endpoint, used to receive light controlling commands. */
#define ERASE_PERSISTENT_CONFIG ZB_FALSE /**< Do not erase NVRAM to save the network parameters after device reboot or power-off. */
#define BULB_PWM_NAME PWM1               /**< PWM instance used to drive dimmable light bulb. */
#define BULB_PWM_TIMER 2                 /**< Timer number used by PWM. */

/* Basic cluster attributes initial values. */
#define BULB_INIT_BASIC_APP_VERSION 01                                   /**< Version of the application software (1 byte). */
#define BULB_INIT_BASIC_STACK_VERSION 10                                 /**< Version of the implementation of the Zigbee stack (1 byte). */
#define BULB_INIT_BASIC_HW_VERSION 11                                    /**< Version of the hardware of the device (1 byte). */
#define BULB_INIT_BASIC_MANUF_NAME "Nordic"                              /**< Manufacturer name (32 bytes). */
#define BULB_INIT_BASIC_MODEL_ID "Dimable_Light_v0.1"                    /**< Model number assigned by manufacturer (32-bytes long string). */
#define BULB_INIT_BASIC_DATE_CODE "20180416"                             /**< First 8 bytes specify the date of manufacturer of the device in ISO 8601 format (YYYYMMDD). The rest (8 bytes) are manufacturer specific. */
#define BULB_INIT_BASIC_POWER_SOURCE ZB_ZCL_BASIC_POWER_SOURCE_DC_SOURCE /**< Type of power sources available for the device. For possible values see section 3.2.2.2.8 of ZCL specification. */
#define BULB_INIT_BASIC_LOCATION_DESC "Office desk"                      /**< Describes the physical location of the device (16 bytes). May be modified during commisioning process. */
#define BULB_INIT_BASIC_PH_ENV ZB_ZCL_BASIC_ENV_UNSPECIFIED              /**< Describes the type of physical environment. For possible values see section 3.2.2.2.10 of ZCL specification. */

#ifdef BOARD_PCA10059                            /**< If it is Dongle */
#define IDENTIFY_MODE_BSP_EVT BSP_EVENT_KEY_0    /**< Button event used to enter the Bulb into the Identify mode. */
#define ZIGBEE_NETWORK_STATE_LED BSP_BOARD_LED_0 /**< LED indicating that light switch successfully joind Zigbee network. */
#else
#define IDENTIFY_MODE_BSP_EVT BSP_EVENT_KEY_3    /**< Button event used to enter the Bulb into the Identify mode. */
#define ZIGBEE_NETWORK_STATE_LED BSP_BOARD_LED_2 /**< LED indicating that light switch successfully joind Zigbee network. */
#endif
#define BULB_LED BSP_BOARD_LED_3 /**< LED immitaing dimmable light bulb. */

/* Benchmark specific Definitions*/
#define GROUP_ID 0xB331                      /* Group ID which will be used to address a specific group of Benchmark Servers */
#define BENCHMARK_CLIENT_ENDPOINT 1          /* ZCL Endpoint of the Benchmark Client */
#define BENCHMARK_SERVER_ENDPOINT 10         /* ZCL Endpoint of the Benchmark Server */
#define BENCHMARK_CONTROL_ENDPOINT 11        /* ZCL Endpoint for Benchmark Control */
#define BENCHMARK_REPORTING_ENDPOINT 12      /* ZCL Endpoint for Benchmark Reporting Message */
#define NUMBER_OF_NETWORK_TIME_ELEMENTS 1000 /* Size of the Benchmark Reporting Array message_info */
#define DONGLE_BUTTON_BSP_EVT BSP_EVENT_KEY_0

#define BENCHMARK_CUSTOM_CMD_ID 0x00 /* Custom Benchmark Command ID */

#ifdef __cplusplus
}
#endif
#endif //BM_ZIGBEE_H
```

## include/bm_log.h
```c
#ifdef __cplusplus
extern "C" {
#endif

#ifndef BM_LOG_H
#define BM_LOG_H

#include "bm_config.h"

/* Struct for benchmark message information */
typedef struct
{
  uint16_t message_id; 
  uint64_t net_time;
  uint64_t ack_net_time;
  uint8_t number_of_hops;
  uint8_t rssi;
  uint16_t src_addr;
  uint16_t dst_addr;
  uint16_t group_addr;
  uint16_t data_size;
} bm_message_info;

/* Array of structs to save benchmark message info to */
extern bm_message_info message_info[NUMBER_OF_BENCHMARK_REPORT_MESSAGES];

void bm_clear_log();

void bm_append_log(bm_message_info msginfo);



#ifdef __cplusplus
}
#endif
#endif
```

## include/bm_rand.h
```c
#ifdef __cplusplus
extern "C" {
#endif

#ifndef BM_RAND_H
#define BM_RAND_H

#include "bm_config.h"

#ifdef ZEPHYR_BLE_MESH
#include <zephyr.h>
#elif defined NRF_SDK_Zigbee
#endif

extern uint32_t bm_rand_32;           // Randomly generated 4 bytes
extern uint32_t * bm_rand_msg_ts;     // Randomly generated Message Timestamps

/* Initialize Random Data */
void bm_rand_init();

/* Function to get Random values */
void bm_rand_get(void *dst, int len);

/* Function to implement bubble sort */
void bm_rand32_bubbleSort(uint32_t arr[], int len);


#ifdef __cplusplus
}
#endif
#endif
```

## include/bm_report.h
```c
#ifdef __cplusplus
extern "C" {
#endif

#ifndef BM_REPORT_H
#define BM_REPORT_H

#include "bm_log.h"


bool bm_report_msg_publish(bm_message_info *message_info);

bool bm_report_msg_subscribe(bm_message_info * bm_message_info);

#endif

#ifdef __cplusplus
}
#endif
```

## include/bm_simple_buttons_and_leds.h
```c
#ifdef __cplusplus
extern "C" {
#endif

#ifndef SIMPLE_BUTTONS_AND_LEDS_H
#define SIMPLE_BUTTONS_AND_LEDS_H

#include <zephyr.h>
#include <device.h>
#include <devicetree.h>
#include <drivers/gpio.h>
#include <sys/util.h>
#include <sys/slist.h>

/*
 * Devicetree helper macro which gets the 'flags' cell from a 'gpios'
 * property, or returns 0 if the property has no 'flags' cell.
 */

#define FLAGS_OR_ZERO(node)						\
	COND_CODE_1(DT_PHA_HAS_CELL(node, gpios, flags),		\
		    (DT_GPIO_FLAGS(node, gpios)),			\
		    (0))



/* The devicetree node identifier for the "led0" alias. */
#define LED0_NODE DT_ALIAS(led0)

#if DT_NODE_HAS_STATUS(LED0_NODE, okay)
#define LED0	DT_GPIO_LABEL(LED0_NODE, gpios)
#define PIN_LED0	DT_GPIO_PIN(LED0_NODE, gpios)
#if DT_PHA_HAS_CELL(LED0_NODE, gpios, flags)
#define FLAGS_LED0	DT_GPIO_FLAGS(LED0_NODE, gpios)
#endif
#else
/* A build error here means your board isn't set up to blink an LED. */
#error "Unsupported board: led0 devicetree alias is not defined"
#define LED0	""
#define PIN_LED0	0
#endif

#ifndef FLAGS_LED0
#define FLAGS_LED0	0
#endif

/*
 * Get button configuration from the devicetree sw0 alias.
 *
 * At least a GPIO device and pin number must be provided. The 'flags'
 * cell is optional.
 */

#define SW0_NODE	DT_ALIAS(sw0)

#if DT_NODE_HAS_STATUS(SW0_NODE, okay)
#define SW0_GPIO_LABEL	DT_GPIO_LABEL(SW0_NODE, gpios)
#define SW0_GPIO_PIN	DT_GPIO_PIN(SW0_NODE, gpios)
#define SW0_GPIO_FLAGS	(GPIO_INPUT | FLAGS_OR_ZERO(SW0_NODE) | GPIO_INT_DEBOUNCE)
#else
#error "Unsupported board: sw0 devicetree alias is not defined"
#define SW0_GPIO_LABEL	""
#define SW0_GPIO_PIN	0
#define SW0_GPIO_FLAGS	0
#endif




/**
* Init the Leds and Buttons
*
*/
extern void init_leds_buttons();

/**
* Set the LED0 State
*
* @param State to set the LED0 to (0/1)
*/
extern void led0_set(bool state);

/**
* Get the LED0 State
*
* @return State of the LED0 (0/1)
*/
extern bool led0_get();

/**
* Get the BUTTON0 Toggled State
*
* @return State of the BUTTON0 Toggled State (0/1)
*/
extern bool button0_toggle_state_get();

void button0_toggle_state_set(bool newstate);


#endif

#ifdef __cplusplus
}
#endif
```

## include/bm_statemachine.h
```c
#ifdef __cplusplus
extern "C" {
#endif

#ifndef BM_STATEMCHINE_H
#define BM_STATEMCHINE_H

/* Statemachine Process... normaly doesnt exit */
void bm_statemachine();


#ifdef __cplusplus
}
#endif
#endif
```

## include/bm_timesync.h
```c
#ifdef __cplusplus
extern "C" {
#endif

#ifndef BM_TIMESYNC_H
#define BM_TIMESYNC_H

extern bool bm_state_synced; // Signal the Synced State of the Timesync
extern bool bm_synctimer_timeout_compare_int; // Signal that a Timeout Compare Interrupt on Synctimer is Occured

/**
* Init the Sync Timer
*
*/
extern void synctimer_init();

/**
* Timestamp Capture clear
*
*/
extern void synctimer_TimeStampCapture_clear();

/**
* Timestamp Capture enable
*
*/
extern void synctimer_TimeStampCapture_enable();
/**
* Timestamp Capture disable
*
*/
extern void synctimer_TimeStampCapture_disable();


/**
* Clears and starts the timer
*/
extern void synctimer_start();

/**
* Stops and clears the timer
*/
extern void synctimer_stop();
/**
* Get previous Tx sync timestamp
*
* @return Latest Tx Timestamp
*/
extern uint64_t synctimer_getTxTimeStamp();
/* Get previous Tx sync timestamp with respect to Timediff to Master */
extern uint64_t synctimer_getSyncedTxTimeStamp();
/**
* Get previous Rx sync timestamp
*
* @return Latest Rx Timestamp
*/
extern uint64_t synctimer_getRxTimeStamp();
/**
* Synchronise the timer with the received offset Timestamp
*
* @param TxMasterTimeStamp Latest 
*/
extern void synctimer_setSync(uint64_t TxMasterTimeStamp);
/**
* Get Synchronised Timestamp
*
* @return Synchronised Timestamp
*/
extern uint64_t synctimer_getSyncTime();
/**
* Sets a synced Time Compare Interrupt (with respect of Synced Time)
*
* @param ts Timestamp for Interrupt
* @param cc_cb Callback on Interrupt
*/
extern void synctimer_setSyncTimeCompareInt(uint64_t ts ,void (*cc_cb)());

/* Gets a synced Time Compare Interrupt Timestamp (with respect of Synced Time) */
extern uint64_t synctimer_getSyncTimeCompareIntTS();

/* Sets a Compare Interrupt which occurs after the specified time in us */
void synctimer_setCompareInt(uint32_t timeout_ms);

/* Sleeps for the given Timeout in ms */
void bm_sleep(uint32_t timeout_ms);

extern void config_debug_ppi_and_gpiote_radio_state();

void bm_radio_init();

void bm_timesync_Publish(uint32_t timeout_ms, uint64_t ST_INIT_MESH_STACK_TS, bool Just_Once);

bool bm_timesync_Subscribe(uint32_t timeout_ms, void (*cc_cb)());

#endif

#ifdef __cplusplus
}
#endif
```

## include/simple_buttons_and_leds.h
```c
#ifdef __cplusplus
extern "C" {
#endif

#ifndef SIMPLE_BUTTONS_AND_LEDS_H
#define SIMPLE_BUTTONS_AND_LEDS_H

#include <zephyr.h>
#include <device.h>
#include <devicetree.h>
#include <drivers/gpio.h>
#include <sys/util.h>
#include <sys/slist.h>

/*
 * Devicetree helper macro which gets the 'flags' cell from a 'gpios'
 * property, or returns 0 if the property has no 'flags' cell.
 */

#define FLAGS_OR_ZERO(node)						\
	COND_CODE_1(DT_PHA_HAS_CELL(node, gpios, flags),		\
		    (DT_GPIO_FLAGS(node, gpios)),			\
		    (0))



/* The devicetree node identifier for the "led0" alias. */
#define LED0_NODE DT_ALIAS(led0)

#if DT_NODE_HAS_STATUS(LED0_NODE, okay)
#define LED0	DT_GPIO_LABEL(LED0_NODE, gpios)
#define PIN_LED0	DT_GPIO_PIN(LED0_NODE, gpios)
#if DT_PHA_HAS_CELL(LED0_NODE, gpios, flags)
#define FLAGS_LED0	DT_GPIO_FLAGS(LED0_NODE, gpios)
#endif
#else
/* A build error here means your board isn't set up to blink an LED. */
#error "Unsupported board: led0 devicetree alias is not defined"
#define LED0	""
#define PIN_LED0	0
#endif

#ifndef FLAGS_LED0
#define FLAGS_LED0	0
#endif

/*
 * Get button configuration from the devicetree sw0 alias.
 *
 * At least a GPIO device and pin number must be provided. The 'flags'
 * cell is optional.
 */

#define SW0_NODE	DT_ALIAS(sw0)

#if DT_NODE_HAS_STATUS(SW0_NODE, okay)
#define SW0_GPIO_LABEL	DT_GPIO_LABEL(SW0_NODE, gpios)
#define SW0_GPIO_PIN	DT_GPIO_PIN(SW0_NODE, gpios)
#define SW0_GPIO_FLAGS	(GPIO_INPUT | FLAGS_OR_ZERO(SW0_NODE) | GPIO_INT_DEBOUNCE)
#else
#error "Unsupported board: sw0 devicetree alias is not defined"
#define SW0_GPIO_LABEL	""
#define SW0_GPIO_PIN	0
#define SW0_GPIO_FLAGS	0
#endif




/**
* Init the Leds and Buttons
*
*/
extern void init_leds_buttons();

/**
* Set the LED0 State
*
* @param State to set the LED0 to (0/1)
*/
extern void led0_set(bool state);

/**
* Get the LED0 State
*
* @return State of the LED0 (0/1)
*/
extern bool led0_get();

/**
* Get the BUTTON0 Toggled State
*
* @return State of the BUTTON0 Toggled State (0/1)
*/
extern bool button0_toggle_state_get();


#endif

#ifdef __cplusplus
}
#endif
```
