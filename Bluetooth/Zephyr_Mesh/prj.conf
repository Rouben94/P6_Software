## prj.conf
```kconfig
#
# Copyright (c) 2019 Nordic Semiconductor ASA
#
# SPDX-License-Identifier: LicenseRef-BSD-5-Clause-Nordic
#
CONFIG_NCS_SAMPLES_DEFAULTS=y

# General configuration
CONFIG_MAIN_STACK_SIZE=4096
CONFIG_SYSTEM_WORKQUEUE_STACK_SIZE=4096
CONFIG_FLASH=y
CONFIG_FLASH_MAP=y
CONFIG_FCB=y
CONFIG_SETTINGS=y
CONFIG_HWINFO=y
CONFIG_LOG=y
CONFIG_LOG_MINIMAL=y
CONFIG_LOG_PRINTK=y

# For UART Log
CONFIG_SHELL=y
CONFIG_UART_CONSOLE=y
#CONFIG_LOG_BACKEND_RTT=y

#CONFIG_LOG=y
#CONFIG_SERIAL=y
#CONFIG_STDOUT_CONSOLE=y
#CONFIG_UART_INTERRUPT_DRIVEN=y
#CONFIG_PRINTK=y
#CONFIG_CONSOLE=y
#CONFIG_DK_LIBRARY=y
#CONFIG_BT_MESH_DK_PROV=n

# Bluetooth configuration
CONFIG_BT=y
CONFIG_BT_COMPANY_ID=0x0059
CONFIG_BT_DEVICE_NAME="BSN BT"
CONFIG_BT_L2CAP_RX_MTU=69
CONFIG_BT_L2CAP_TX_MTU=69
CONFIG_BT_L2CAP_TX_BUF_COUNT=8
CONFIG_BT_LL_SW_SPLIT=y
CONFIG_BT_OBSERVER=y
CONFIG_BT_PERIPHERAL=y
CONFIG_BT_SETTINGS=y
CONFIG_BT_DEBUG_LOG=y
CONFIG_BT_LL_SW_SPLIT=y
#CONFIG_BT_LLL_VENDOR_NORDIC=y
#CONFIG_BT_DEBUG_HCI_CORE=y

# Disable unused Bluetooth features
CONFIG_BT_CTLR_DUP_FILTER_LEN=0
CONFIG_BT_CTLR_LE_ENC=n
CONFIG_BT_DATA_LEN_UPDATE=n
CONFIG_BT_PHY_UPDATE=n
CONFIG_BT_CTLR_CHAN_SEL_2=n
CONFIG_BT_CTLR_MIN_USED_CHAN=n
CONFIG_BT_CTLR_PRIVACY=n

CONFIG_BT_CTLR_ADVANCED_FEATURES=y

CONFIG_BT_HCI_TX_STACK_SIZE=1024
#CONFIG_NO_OPTIMIZATIONS=y

#CONFIG_BT_CTLR_TX_BUFFER_SIZE=74
#CONFIG_BT_CTLR_DATA_LENGTH_MAX=74

# Bluetooth Mesh configuration
CONFIG_BT_MESH=y
CONFIG_BT_MESH_RELAY=y
CONFIG_BT_MESH_FRIEND=y
CONFIG_BT_MESH_LOW_POWER=n
CONFIG_BT_MESH_LPN_AUTO=n
CONFIG_BT_MESH_LPN_ESTABLISHMENT=n
#LPN Nodes Count bound to a Friend
CONFIG_BT_MESH_FRIEND_LPN_COUNT=5
CONFIG_BT_MESH_FRIEND_SEG_RX=5
#Must be at least tree times CONFIG_BT_MESH_TX_SEG_MAX Def = 30
CONFIG_BT_MESH_ADV_BUF_COUNT=256
# Default 10 -> Max Message Segments = 32 (32 * 12 = 432 - 8 = 424)
CONFIG_BT_MESH_TX_SEG_MAX=32
# Default 10 -> Max Message Segments = 32 (32 * 12 = 432 - 8 = 424)
CONFIG_BT_MESH_RX_SEG_MAX=32
CONFIG_BT_MESH_TX_SEG_MSG_COUNT=32
# Buffer to Store Incoming and Outgoing Segments (Each Buffer is 12Byte)
CONFIG_BT_MESH_SEG_BUFS=255 
# Replay Protection List Size (Equal to number of NOdes Excpected)
CONFIG_BT_MESH_CRPL=1024
# Repay Cache Size (Equal to number of NOdes Excpected)
CONFIG_BT_MESH_MSG_CACHE_SIZE=1024
# Reply Store in Flash
CONFIG_BT_MESH_RPL_STORE_TIMEOUT=600
# Store SEQ in Flash after ... entries
CONFIG_BT_MESH_SEQ_STORE_RATE=1000
CONFIG_BT_MESH_PB_GATT=n
CONFIG_BT_MESH_GATT_PROXY=n
CONFIG_BT_MESH_DEBUG=y
CONFIG_BT_MESH_DEBUG_FRIEND=n
CONFIG_BT_MESH_DEBUG_LOW_POWER=n
#CONFIG_BT_MESH_DEBUG_CRYPTO=y
#CONFIG_BT_MESH_DEBUG_TRANS=y
#CONFIG_BT_MESH_DEBUG_NET=y
#CONFIG_BT_MESH_DEBUG_ADV=y


# Bluetooth Mesh models
CONFIG_BT_MESH_ONOFF_CLI=y
CONFIG_BT_MESH_ONOFF_SRV=y
CONFIG_BT_MESH_CFG_CLI=y

# Other Peripherals
CONFIG_LEGACY_DEVICETREE_MACROS=y
CONFIG_CLOCK_CONTROL_NRF_K32SRC_RC=n
CONFIG_CLOCK_CONTROL_NRF_K32SRC_XTAL=y
CONFIG_NRFX_TIMER=y
CONFIG_NRFX_TIMER4=y

# Flash 
CONFIG_FLASH=y
CONFIG_FLASH_PAGE_LAYOUT=y
CONFIG_MPU_ALLOW_FLASH_WRITE=y
CONFIG_SOC_FLASH_NRF_EMULATE_ONE_BYTE_WRITE_ACCESS=y

#Experimantal Settings
#CONFIG_DYNAMIC_INTERRUPTS=y
#CONFIG_ENTROPY_GENERATOR=y
#CONFIG_ENTROPY_DEVICE_RANDOM_GENERATOR=y
```

## src/main.c
```c
#include "bm_config.h"
#include "bm_cli.h"
#include "bm_statemachine.h"


#ifdef NRF_SDK_Zigbee
#include "nrf_log.h"
#include "nrf_log_ctrl.h"
#include "nrf_log_default_backends.h"
#endif

/**@brief Function for application main entry.
 */
void main(void) {

 #ifdef NRF_SDK_Zigbee
  // Init the LOG Modul
  // To Enable Loging before the Mesh stack is run change in sdk_config -> NRF_LOG_DEFERRED = 0 (Performance is worse but logging is possibel)
  bm_cli_log_init(); /* Initialize the Zigbee LOG subsystem */
 #endif  

  // Start Benchmark
  bm_cli_log("Starting Benchmark...\n");
  bm_statemachine();

}
```

## include/bm_blemesh.h
```c
/*
This file is part of Bluetooth-Benchamrk.

Bluetooth-Benchamrk is free software: you can redistribute it and/or modify
it under the terms of the GNU General Public License as published by
the Free Software Foundation, either version 3 of the License, or
(at your option) any later version.

Bluetooth-Benchamrk is distributed in the hope that it will be useful,
but WITHOUT ANY WARRANTY; without even the implied warranty of
MERCHANTABILITY or FITNESS FOR A PARTICULAR PURPOSE.  See the
GNU General Public License for more details.

You should have received a copy of the GNU General Public License
along with Bluetooth-Benchamrk.  If not, see <http://www.gnu.org/licenses/>.
*/

/* AUTHOR 	 :    Raffael Anklin       */

#ifndef BM_BLEMESH_H
#define BM_BLEMESH_H

extern u16_t addr;

/* Init and enable the BLE Mesh Stack 
* 
*	Does Self Provisioning
*/
void bm_blemesh_enable(void);

#endif
```

## include/bm_gen_onoff.h
```c
/*
 * Copyright (c) 2019 Nordic Semiconductor ASA
 *
 * SPDX-License-Identifier: LicenseRef-BSD-5-Clause-Nordic
 */

/**
 * @file
 * @defgroup bt_mesh_onoff Generic OnOff Models
 * @{
 * @brief Common API for the Generic OnOff models.
 */

#ifndef BT_MESH_GEN_ONOFF_H__
#define BT_MESH_GEN_ONOFF_H__

#define MaxAdditionalPayloadLen 420

#include <bluetooth/mesh/model_types.h>

#ifdef __cplusplus
extern "C" {
#endif

/** @cond INTERNAL_HIDDEN */
#define BT_MESH_ONOFF_OP_GET BT_MESH_MODEL_OP_2(0x82, 0x01)
#define BT_MESH_ONOFF_OP_SET BT_MESH_MODEL_OP_2(0x82, 0x02)
#define BT_MESH_ONOFF_OP_SET_UNACK BT_MESH_MODEL_OP_2(0x82, 0x03)
#define BT_MESH_ONOFF_OP_STATUS BT_MESH_MODEL_OP_2(0x82, 0x04)

#define BT_MESH_ONOFF_MSG_LEN_GET 0
#define BT_MESH_ONOFF_MSG_MINLEN_SET 2
#define BT_MESH_ONOFF_MSG_MAXLEN_SET (4 + MaxAdditionalPayloadLen)
#define BT_MESH_ONOFF_MSG_MINLEN_STATUS 1
#define BT_MESH_ONOFF_MSG_MAXLEN_STATUS 3
/** @endcond */

/** Mandatory parameters for the Generic OnOff Set message. */
struct bt_mesh_onoff_set {
	/** State to set. */
	bool on_off;
	/** Transition parameters. */
	const struct bt_mesh_model_transition *transition;
};

/** Parameters for the Generic OnOff Status message. */
struct bt_mesh_onoff_status {
	/** The present value of the Generic OnOff state. */
	bool present_on_off;
	/** The target value of the Generic OnOff state (optional). */
	bool target_on_off;
	/** Remaining time value in milliseconds. */
	s32_t remaining_time;
};

#ifdef __cplusplus
}
#endif

#endif /* BT_MESH_GEN_ONOFF_H__ */

/** @} */
```

## include/bm_gen_onoff_srv.h
```c
/*
 * Copyright (c) 2019 Nordic Semiconductor ASA
 *
 * SPDX-License-Identifier: LicenseRef-BSD-5-Clause-Nordic
 */

/**
 * @file
 * @defgroup bt_mesh_onoff_srv Generic OnOff Server model
 * @ingroup bt_mesh_onoff
 * @{
 * @brief API for the Generic OnOff Server model.
 */

#ifndef BT_MESH_GEN_ONOFF_SRV_H__
#define BT_MESH_GEN_ONOFF_SRV_H__

#include "bm_gen_onoff.h"

#ifdef __cplusplus
extern "C" {
#endif

extern uint16_t bm_last_rx_msg_buf_len;

struct bt_mesh_onoff_srv;

/** @def BT_MESH_ONOFF_SRV_INIT
 *
 * @brief Init parameters for a @ref bt_mesh_onoff_srv instance.
 *
 * @param[in] _handlers State access handlers to use in the model instance.
 */
#define BT_MESH_ONOFF_SRV_INIT(_handlers)                                      \
	{                                                                      \
		.handlers = _handlers,                                         \
		.pub = {                                                       \
			.update = _bt_mesh_onoff_srv_update_handler,           \
			.msg = NET_BUF_SIMPLE(BT_MESH_MODEL_BUF_LEN(           \
				BT_MESH_ONOFF_OP_STATUS,                       \
				BT_MESH_ONOFF_MSG_MAXLEN_STATUS)),             \
		},                                                             \
	}

/** @def BT_MESH_MODEL_ONOFF_SRV
 *
 * @brief Generic OnOff Server model composition data entry.
 *
 * @param[in] _srv Pointer to a @ref bt_mesh_onoff_srv instance.
 */
#define BT_MESH_MODEL_ONOFF_SRV(_srv)                                          \
	BT_MESH_MODEL_CB(BT_MESH_MODEL_ID_GEN_ONOFF_SRV,                       \
			 _bm_bt_mesh_onoff_srv_op, &(_srv)->pub,                  \
			 BT_MESH_MODEL_USER_DATA(struct bt_mesh_onoff_srv,     \
						 _srv),                        \
			 &_bt_mesh_onoff_srv_cb)

/** Generic OnOff Server state access handlers. */
struct bt_mesh_onoff_srv_handlers {
	/** @brief Set the OnOff state.
	 *
	 * @note This handler is mandatory.
	 *
	 * @param[in] srv Server instance to set the state of.
	 * @param[in] ctx Message context for the message that triggered the
	 * change, or NULL if the change is not coming from a message.
	 * @param[in] set Parameters of the state change.
	 * @param[out] rsp Response structure to be filled, or NULL if no
	 * response is required.
	 */
	void (*const set)(struct bt_mesh_onoff_srv *srv,
			  struct bt_mesh_msg_ctx *ctx,
			  const struct bt_mesh_onoff_set *set,
			  struct bt_mesh_onoff_status *rsp);

	/** @brief Get the OnOff state.
	 *
	 * @note This handler is mandatory.
	 *
	 * @param[in] srv Server instance to get the state of.
	 * @param[in] ctx Message context for the message that triggered the
	 * change, or NULL if the change is not coming from a message.
	 * @param[out] rsp Response structure to be filled.
	 */
	void (*const get)(struct bt_mesh_onoff_srv *srv,
			  struct bt_mesh_msg_ctx *ctx,
			  struct bt_mesh_onoff_status *rsp);
};

/**
 * Generic OnOff Server instance. Should primarily be initialized with the
 * @ref BT_MESH_ONOFF_SRV_INIT macro.
 */
struct bt_mesh_onoff_srv {
	/** Transaction ID tracker. */
	struct bt_mesh_tid_ctx prev_transaction;
	/** Handler function structure. */
	const struct bt_mesh_onoff_srv_handlers *handlers;
	/** Access model pointer. */
	struct bt_mesh_model *model;
	/** Publish parameters. */
	struct bt_mesh_model_pub pub;
};

/** @brief Publish the Generic OnOff Server model status.
 *
 * Asynchronously publishes a Generic OnOff status message with the configured
 * publish parameters.
 *
 * @note This API is only used publishing unprompted status messages. Response
 * messages for get and set messages are handled internally.
 *
 * @param[in] srv Server instance to publish on.
 * @param[in] ctx Message context to send with, or NULL to send with the
 * default publish parameters.
 * @param[in] status Current status.
 *
 * @retval 0 Successfully published a Generic OnOff Status message.
 * @retval -ENOTSUP A message context was not provided and publishing is not
 * supported.
 * @retval -EADDRNOTAVAIL A message context was not provided and publishing is
 * not configured.
 * @retval -EAGAIN The device has not been provisioned.
 */
s32_t bt_mesh_onoff_srv_pub(struct bt_mesh_onoff_srv *srv,
			    struct bt_mesh_msg_ctx *ctx,
			    const struct bt_mesh_onoff_status *status);

/** @cond INTERNAL_HIDDEN */
extern const struct bt_mesh_model_op _bm_bt_mesh_onoff_srv_op[];
extern const struct bt_mesh_model_cb _bt_mesh_onoff_srv_cb;
int _bt_mesh_onoff_srv_update_handler(struct bt_mesh_model *model);
/** @endcond */

#ifdef __cplusplus
}
#endif

#endif /* BT_MESH_GEN_ONOFF_SRV_H__ */

/** @} */
```
